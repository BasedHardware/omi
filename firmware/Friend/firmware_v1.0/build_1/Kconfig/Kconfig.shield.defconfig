## firmware/Friend/firmware_v1.0/build_1/Kconfig/Kconfig.sysbuild.modules
```kconfig
menu "nrf (/opt/nordic/ncs/v2.6.99-cs1/nrf)"
osource "/opt/nordic/ncs/v2.6.99-cs1/nrf/sysbuild/Kconfig.sysbuild"
config ZEPHYR_NRF_MODULE
	bool
	default y
endmenu
```

## firmware/Friend/firmware_v1.5/Kconfig
```kconfig
mainmenu "Bubble Firmware"

config BUBBLE_SOFT_BUTTON
    bool "Enable soft mute button"
    default y
    help
        Enable or disable soft mute button

choice BUBBLE_CODEC
    bool "Foo choice"
    default BUBBLE_CODEC_OPUS

config BUBBLE_CODEC_OPUS
    bool "Opus Codec"

config BUBBLE_CODEC_PCM
    bool "PCM Codec"

config BUBBLE_CODEC_MULAW
    bool "Mu-law Codec"

endchoice

source "Kconfig.zephyr"
```

## omi/firmware/boards/omi/Kconfig
```kconfig
# Omi board configuration

# Copyright (c) 2024 Based Hardware
# SPDX-License-Identifier: MIT

config IPM_NRFX
	default IPM

config MBOX_NRFX_IPC
	default MBOX

if BOARD_OMI_NRF5340_CPUAPP || BOARD_OMI_NRF5340_CPUAPP_NS

config BOARD_ENABLE_DCDC_APP
	bool "Enable Application MCU DCDC converter"
	select SOC_DCDC_NRF53X_APP
	default y

config BOARD_ENABLE_DCDC_NET
	bool "Enable Network MCU DCDC converter"
	select SOC_DCDC_NRF53X_NET
	default y

endif # BOARD_OMI_NRF5340_CPUAPP || BOARD_OMI_NRF5340_CPUAPP_NS
```

## omi/firmware/boards/omi/Kconfig.omi
```kconfig
config BOARD_OMI
	select SOC_NRF5340_CPUAPP_QKAA if BOARD_OMI_NRF5340_CPUAPP
	select SOC_NRF5340_CPUAPP_QKAA if BOARD_OMI_NRF5340_CPUAPP_NS
	select SOC_NRF5340_CPUNET_QKAA if BOARD_OMI_NRF5340_CPUNET
```

## omi/firmware/boards/omi/board.yml
```yaml
board:
  name: omi
  vendor: omi
  socs:
  - name: nrf5340
    variants:
    - name: ns
      cpucluster: cpuapp
```

## omi/firmware/boards/omi/omi_nrf5340_cpunet_defconfig
```kconfig
CONFIG_ARM_MPU=y
CONFIG_HW_STACK_PROTECTION=y
CONFIG_BT_CTLR=y
CONFIG_BT_CTLR_TX_PWR_PLUS_3=y
CONFIG_BT_CTLR_TX_PWR_DYNAMIC_CONTROL=y
```

## omi/firmware/deprecated/omi2-app/Kconfig
```kconfig
source "Kconfig.zephyr"

menu "Omi Features Configuration"

config OMI_CODEC_OPUS
    bool "Opus Audio Codec"
    help
        "Enable the Opus audio codec support."
    default n

config OMI_ENABLE_OFFLINE_STORAGE
	bool "Offline SD Card Storage"
    select DISK_ACCESS
    select FILE_SYSTEM
    select FAT_FILESYSTEM_ELM
    select FS_FATFS_MOUNT_MKFS
    select FS_FATFS_EXFAT
    help
        "Enable the offline storage support. Requires a SD Card."
	default n

config OMI_ENABLE_ACCELEROMETER
    bool "Accelerometer Support"
    help
        "Enable the accelerometer support."
    default n

config OMI_ENABLE_BUTTON
    bool "Button support"
    help
        "Enable the software button support."
    default n

config OMI_ENABLE_SPEAKER
    bool "Enable the speaker"
    help
        "Enable the speaker support."
    default n

config OMI_ENABLE_BATTERY
    bool "Enable the battery"
    help
        "Enable the battery support."
    default n

config OMI_ENABLE_USB
    bool "Enable the usb"
    help
        "Enable the USB power check support."
    default n

config OMI_ENABLE_HAPTIC
    bool "Enable the haptic"
    help
        "Enable the haptic support."
    default n

config OMI_ENABLE_IMU
    bool "Enable the IMU"
    help
        "Enable the IMU support."
    default n

config APP_LED_PIN
    int "LED pin number"
    default 13 # Default to LED1 on nRF5340 DK

# Microphone Configuration Symbols
config MIC_SAMPLE_RATE
	int "Microphone Sample Rate (Hz)"
	default 16000
	help
		Sample rate for the digital microphone.

config MIC_THREAD_STACK_SIZE
	int "Microphone Thread Stack Size"
	default 1024
	help
		Stack size allocated for the microphone reading thread.

config MIC_THREAD_PRIORITY
	int "Microphone Thread Priority"
	default 5
	help
		Priority for the microphone reading thread.

endmenu
```

## omi/firmware/firmware/boards/omi/omi2/Kconfig.omi2
```kconfig
config BOARD_OMI2
	select SOC_NRF5340_CPUAPP_QKAA if BOARD_OMI2_NRF5340_CPUAPP
	select SOC_NRF5340_CPUAPP_QKAA if BOARD_OMI2_NRF5340_CPUAPP_NS
	select SOC_NRF5340_CPUNET_QKAA if BOARD_OMI2_NRF5340_CPUNET
```

## omi/firmware/firmware/boards/omi/omi2/board.yml
```yaml
board:
  name: omi2
  vendor: omi2
  socs:
  - name: nrf5340
    variants:
    - name: ns
      cpucluster: cpuapp
```

## omi/firmware/firmware/boards/omi/omi2/omi2_nrf5340_cpuapp_defconfig
```kconfig
CONFIG_ARM_MPU=y
CONFIG_HW_STACK_PROTECTION=y
CONFIG_PM_DEVICE=y
CONFIG_GPIO=y
CONFIG_PINCTRL=y
CONFIG_ARM_TRUSTZONE_M=y
CONFIG_NFCT_PINS_AS_GPIOS=y

CONFIG_SERIAL=y
CONFIG_CONSOLE=y
CONFIG_UART_CONSOLE=y
```

## omi/firmware/firmware/boards/omi_nrf5340/omi_nrf5340/Kconfig.omi_nrf5340
```kconfig
config BOARD_OMI_NRF5340
	select SOC_NRF5340_CPUAPP_QKAA if BOARD_OMI_NRF5340_NRF5340_CPUAPP
	select SOC_NRF5340_CPUAPP_QKAA if BOARD_OMI_NRF5340_NRF5340_CPUAPP_NS
	select SOC_NRF5340_CPUNET_QKAA if BOARD_OMI_NRF5340_NRF5340_CPUNET
```

## omi/firmware/firmware/boards/omi_nrf5340/omi_nrf5340/board.yml
```yaml
board:
  name: omi_nrf5340
  vendor: omi_nrf5340
  socs:
  - name: nrf5340
    variants:
    - name: ns
      cpucluster: cpuapp
```

## omi/firmware/firmware/boards/omi_nrf5340/omi_nrf5340/omi_nrf5340_nrf5340_cpuapp_defconfig
```kconfig
CONFIG_ARM_MPU=y
CONFIG_HW_STACK_PROTECTION=y
CONFIG_PM_DEVICE=y

CONFIG_ARM_TRUSTZONE_M=y
```

## omi/firmware/firmware/boards/omi_nrf5340/omi_nrf5340/omi_nrf5340_nrf5340_cpuapp_ns_defconfig
```kconfig
CONFIG_ARM_MPU=y
CONFIG_HW_STACK_PROTECTION=y

CONFIG_ARM_TRUSTZONE_M=y
CONFIG_TRUSTED_EXECUTION_NONSECURE=y
```

## omi/firmware/firmware/omi2/build_1/Kconfig/boards/Kconfig.defconfig
```kconfig
# Load Zephyr board defconfig descriptions.
osource "/opt/nordic/ncs/v2.9.0/zephyr/boards/nordic/nrf52840dk/Kconfig.defconfig"
```

## omi/firmware/firmware/omi2/build_1/mcuboot/Kconfig/soc/Kconfig.defconfig
```kconfig
# Load Zephyr SoC defconfig descriptions.
osource "/opt/nordic/ncs/v2.9.0/zephyr/soc/xlnx/zynqmp/Kconfig.defconfig"
osource "/opt/nordic/ncs/v2.9.0/zephyr/soc/xlnx/zynq7000/Kconfig.defconfig"
osource "/opt/nordic/ncs/v2.9.0/zephyr/soc/xen/Kconfig.defconfig"
osource "/opt/nordic/ncs/v2.9.0/zephyr/soc/ti/simplelink/Kconfig.defconfig"
osource "/opt/nordic/ncs/v2.9.0/zephyr/soc/ti/lm3s6965/Kconfig.defconfig"
osource "/opt/nordic/ncs/v2.9.0/zephyr/soc/ti/k3/Kconfig.defconfig"
osource "/opt/nordic/ncs/v2.9.0/zephyr/soc/telink/tlsr/Kconfig.defconfig"
osource "/opt/nordic/ncs/v2.9.0/zephyr/soc/starfive/jh71xx/Kconfig.defconfig"
osource "/opt/nordic/ncs/v2.9.0/zephyr/soc/st/stm32/Kconfig.defconfig"
osource "/opt/nordic/ncs/v2.9.0/zephyr/soc/snps/qemu_arc/Kconfig.defconfig"
osource "/opt/nordic/ncs/v2.9.0/zephyr/soc/snps/nsim/arc_v/Kconfig.defconfig"
osource "/opt/nordic/ncs/v2.9.0/zephyr/soc/snps/nsim/arc_classic/Kconfig.defconfig"
osource "/opt/nordic/ncs/v2.9.0/zephyr/soc/snps/hsdk4xd/Kconfig.defconfig"
osource "/opt/nordic/ncs/v2.9.0/zephyr/soc/snps/hsdk/Kconfig.defconfig"
osource "/opt/nordic/ncs/v2.9.0/zephyr/soc/snps/emsk/Kconfig.defconfig"
osource "/opt/nordic/ncs/v2.9.0/zephyr/soc/snps/emsdp/Kconfig.defconfig"
osource "/opt/nordic/ncs/v2.9.0/zephyr/soc/snps/arc_iot/Kconfig.defconfig"
osource "/opt/nordic/ncs/v2.9.0/zephyr/soc/silabs/Kconfig.defconfig"
osource "/opt/nordic/ncs/v2.9.0/zephyr/soc/sifive/sifive_freedom/Kconfig.defconfig"
osource "/opt/nordic/ncs/v2.9.0/zephyr/soc/sensry/Kconfig.defconfig"
osource "/opt/nordic/ncs/v2.9.0/zephyr/soc/rockchip/Kconfig.defconfig"
osource "/opt/nordic/ncs/v2.9.0/zephyr/soc/renode/riscv_virtual/Kconfig.defconfig"
osource "/opt/nordic/ncs/v2.9.0/zephyr/soc/renode/cortex_r8_virtual/Kconfig.defconfig"
osource "/opt/nordic/ncs/v2.9.0/zephyr/soc/renesas/smartbond/Kconfig.defconfig"
osource "/opt/nordic/ncs/v2.9.0/zephyr/soc/renesas/rzt2m/Kconfig.defconfig"
osource "/opt/nordic/ncs/v2.9.0/zephyr/soc/renesas/rcar/Kconfig.defconfig"
osource "/opt/nordic/ncs/v2.9.0/zephyr/soc/renesas/ra/Kconfig.defconfig"
osource "/opt/nordic/ncs/v2.9.0/zephyr/soc/raspberrypi/Kconfig.defconfig"
osource "/opt/nordic/ncs/v2.9.0/zephyr/soc/quicklogic/eos_s3/Kconfig.defconfig"
osource "/opt/nordic/ncs/v2.9.0/zephyr/soc/qemu/virt_riscv/Kconfig.defconfig"
osource "/opt/nordic/ncs/v2.9.0/zephyr/soc/qemu/malta/Kconfig.defconfig"
osource "/opt/nordic/ncs/v2.9.0/zephyr/soc/openisa/rv32m1/Kconfig.defconfig"
osource "/opt/nordic/ncs/v2.9.0/zephyr/soc/nxp/s32/Kconfig.defconfig"
osource "/opt/nordic/ncs/v2.9.0/zephyr/soc/nxp/rw/Kconfig.defconfig"
osource "/opt/nordic/ncs/v2.9.0/zephyr/soc/nxp/mcx/Kconfig.defconfig"
osource "/opt/nordic/ncs/v2.9.0/zephyr/soc/nxp/lpc/Kconfig.defconfig"
osource "/opt/nordic/ncs/v2.9.0/zephyr/soc/nxp/layerscape/Kconfig.defconfig"
osource "/opt/nordic/ncs/v2.9.0/zephyr/soc/nxp/kinetis/Kconfig.defconfig"
osource "/opt/nordic/ncs/v2.9.0/zephyr/soc/nxp/imxrt/Kconfig.defconfig"
osource "/opt/nordic/ncs/v2.9.0/zephyr/soc/nxp/imx/Kconfig.defconfig"
osource "/opt/nordic/ncs/v2.9.0/zephyr/soc/nuvoton/numicro/Kconfig.defconfig"
osource "/opt/nordic/ncs/v2.9.0/zephyr/soc/nuvoton/numaker/Kconfig.defconfig"
osource "/opt/nordic/ncs/v2.9.0/zephyr/soc/nuvoton/npcx/Kconfig.defconfig"
osource "/opt/nordic/ncs/v2.9.0/zephyr/soc/nuvoton/npcm/Kconfig.defconfig"
osource "/opt/nordic/ncs/v2.9.0/zephyr/soc/nordic/Kconfig.defconfig"
osource "/opt/nordic/ncs/v2.9.0/zephyr/soc/neorv32/Kconfig.defconfig"
osource "/opt/nordic/ncs/v2.9.0/zephyr/soc/native/inf_clock/Kconfig.defconfig"
osource "/opt/nordic/ncs/v2.9.0/zephyr/soc/microchip/miv/Kconfig.defconfig"
osource "/opt/nordic/ncs/v2.9.0/zephyr/soc/microchip/mec/Kconfig.defconfig"
osource "/opt/nordic/ncs/v2.9.0/zephyr/soc/mediatek/mtk_adsp/Kconfig.defconfig"
osource "/opt/nordic/ncs/v2.9.0/zephyr/soc/lowrisc/opentitan/Kconfig.defconfig"
osource "/opt/nordic/ncs/v2.9.0/zephyr/soc/litex/litex_vexriscv/Kconfig.defconfig"
osource "/opt/nordic/ncs/v2.9.0/zephyr/soc/ite/ec/Kconfig.defconfig"
osource "/opt/nordic/ncs/v2.9.0/zephyr/soc/intel/raptor_lake/Kconfig.defconfig"
osource "/opt/nordic/ncs/v2.9.0/zephyr/soc/intel/lakemont/Kconfig.defconfig"
osource "/opt/nordic/ncs/v2.9.0/zephyr/soc/intel/intel_socfpga_std/Kconfig.defconfig"
osource "/opt/nordic/ncs/v2.9.0/zephyr/soc/intel/intel_socfpga/Kconfig.defconfig"
osource "/opt/nordic/ncs/v2.9.0/zephyr/soc/intel/intel_niosv/Kconfig.defconfig"
osource "/opt/nordic/ncs/v2.9.0/zephyr/soc/intel/intel_ish/Kconfig.defconfig"
osource "/opt/nordic/ncs/v2.9.0/zephyr/soc/intel/intel_adsp/Kconfig.defconfig"
osource "/opt/nordic/ncs/v2.9.0/zephyr/soc/intel/elkhart_lake/Kconfig.defconfig"
osource "/opt/nordic/ncs/v2.9.0/zephyr/soc/intel/atom/Kconfig.defconfig"
osource "/opt/nordic/ncs/v2.9.0/zephyr/soc/intel/apollo_lake/Kconfig.defconfig"
osource "/opt/nordic/ncs/v2.9.0/zephyr/soc/intel/alder_lake/Kconfig.defconfig"
osource "/opt/nordic/ncs/v2.9.0/zephyr/soc/infineon/cat3/Kconfig.defconfig"
osource "/opt/nordic/ncs/v2.9.0/zephyr/soc/infineon/cat1b/Kconfig.defconfig"
osource "/opt/nordic/ncs/v2.9.0/zephyr/soc/infineon/cat1a/Kconfig.defconfig"
osource "/opt/nordic/ncs/v2.9.0/zephyr/soc/gd/gd32/Kconfig.defconfig"
osource "/opt/nordic/ncs/v2.9.0/zephyr/soc/gaisler/leon3/Kconfig.defconfig"
osource "/opt/nordic/ncs/v2.9.0/zephyr/soc/gaisler/gr716a/Kconfig.defconfig"
osource "/opt/nordic/ncs/v2.9.0/zephyr/soc/espressif/Kconfig.defconfig"
osource "/opt/nordic/ncs/v2.9.0/zephyr/soc/ene/kb1200/Kconfig.defconfig"
osource "/opt/nordic/ncs/v2.9.0/zephyr/soc/efinix/sapphire/Kconfig.defconfig"
osource "/opt/nordic/ncs/v2.9.0/zephyr/soc/cdns/xtensa_sample_controller/Kconfig.defconfig"
osource "/opt/nordic/ncs/v2.9.0/zephyr/soc/cdns/dc233c/Kconfig.defconfig"
osource "/opt/nordic/ncs/v2.9.0/zephyr/soc/brcm/bcmvk/Kconfig.defconfig"
osource "/opt/nordic/ncs/v2.9.0/zephyr/soc/brcm/bcm2712/Kconfig.defconfig"
osource "/opt/nordic/ncs/v2.9.0/zephyr/soc/brcm/bcm2711/Kconfig.defconfig"
osource "/opt/nordic/ncs/v2.9.0/zephyr/soc/atmel/sam0/Kconfig.defconfig"
osource "/opt/nordic/ncs/v2.9.0/zephyr/soc/atmel/sam/Kconfig.defconfig"
osource "/opt/nordic/ncs/v2.9.0/zephyr/soc/aspeed/Kconfig.defconfig"
osource "/opt/nordic/ncs/v2.9.0/zephyr/soc/arm/Kconfig.defconfig"
osource "/opt/nordic/ncs/v2.9.0/zephyr/soc/arm/beetle/Kconfig.defconfig"
osource "/opt/nordic/ncs/v2.9.0/zephyr/soc/andestech/Kconfig.defconfig"
osource "/opt/nordic/ncs/v2.9.0/zephyr/soc/ambiq/Kconfig.defconfig"
osource "/opt/nordic/ncs/v2.9.0/zephyr/soc/altr/zephyr_nios2f/Kconfig.defconfig"
osource "/opt/nordic/ncs/v2.9.0/zephyr/soc/altr/qemu_nios2/Kconfig.defconfig"
osource "/opt/nordic/ncs/v2.9.0/zephyr/soc/adi/max32/Kconfig.defconfig"
```
