## CMakeLists.txt
```
# SPDX-License-Identifier: Apache-2.0

cmake_minimum_required(VERSION 3.20.0)
find_package(Zephyr REQUIRED HINTS $ENV{ZEPHYR_BASE})
project(nrf52840_nordic)
enable_language(C ASM)

target_sources(app PRIVATE
    src/main.c
    src/transport.c
    src/mic.c
    src/led.c
    src/audio.c
    src/codec.c
    src/lib/battery/battery.c
)

target_sources_ifdef(CONFIG_CODEC_OPUS app PRIVATE
    src/lib/opus-1.2.1/A2NLSF.c
    src/lib/opus-1.2.1/CNG.c
    src/lib/opus-1.2.1/HP_variable_cutoff.c
    src/lib/opus-1.2.1/LPC_analysis_filter.c
    src/lib/opus-1.2.1/LPC_fit.c
    src/lib/opus-1.2.1/LPC_inv_pred_gain.c
    src/lib/opus-1.2.1/LP_variable_cutoff.c
    src/lib/opus-1.2.1/LTP_analysis_filter_FIX.c
    src/lib/opus-1.2.1/LTP_scale_ctrl_FIX.c
    src/lib/opus-1.2.1/NLSF2A.c
    src/lib/opus-1.2.1/NLSF_VQ.c
    src/lib/opus-1.2.1/NLSF_VQ_weights_laroia.c
    src/lib/opus-1.2.1/NLSF_decode.c
    src/lib/opus-1.2.1/NLSF_del_dec_quant.c
    src/lib/opus-1.2.1/NLSF_encode.c
    src/lib/opus-1.2.1/NLSF_stabilize.c
    src/lib/opus-1.2.1/NLSF_unpack.c
    src/lib/opus-1.2.1/NSQ.c
    src/lib/opus-1.2.1/NSQ_del_dec.c
    src/lib/opus-1.2.1/PLC.c
    src/lib/opus-1.2.1/VAD.c
    src/lib/opus-1.2.1/VQ_WMat_EC.c
    src/lib/opus-1.2.1/ana_filt_bank_1.c
    src/lib/opus-1.2.1/analysis.c
    src/lib/opus-1.2.1/apply_sine_window_FIX.c
    src/lib/opus-1.2.1/autocorr_FIX.c
    src/lib/opus-1.2.1/bands.c
    src/lib/opus-1.2.1/biquad_alt.c
    src/lib/opus-1.2.1/burg_modified_FIX.c
    src/lib/opus-1.2.1/bwexpander.c
    src/lib/opus-1.2.1/bwexpander_32.c
    src/lib/opus-1.2.1/celt.c
    src/lib/opus-1.2.1/celt_decoder.c
    src/lib/opus-1.2.1/celt_encoder.c
    src/lib/opus-1.2.1/celt_lpc.c
    src/lib/opus-1.2.1/arm/celt_pitch_xcorr_arm_gcc.s
    src/lib/opus-1.2.1/check_control_input.c
    src/lib/opus-1.2.1/code_signs.c
    src/lib/opus-1.2.1/control_SNR.c
    src/lib/opus-1.2.1/control_audio_bandwidth.c
    src/lib/opus-1.2.1/control_codec.c
    src/lib/opus-1.2.1/corrMatrix_FIX.c
    src/lib/opus-1.2.1/cwrs.c
    src/lib/opus-1.2.1/debug.c
    src/lib/opus-1.2.1/dec_API.c
    src/lib/opus-1.2.1/decode_core.c
    src/lib/opus-1.2.1/decode_frame.c
    src/lib/opus-1.2.1/decode_indices.c
    src/lib/opus-1.2.1/decode_parameters.c
    src/lib/opus-1.2.1/decode_pitch.c
    src/lib/opus-1.2.1/decode_pulses.c
    src/lib/opus-1.2.1/decoder_set_fs.c
    src/lib/opus-1.2.1/enc_API.c
    src/lib/opus-1.2.1/encode_frame_FIX.c
    src/lib/opus-1.2.1/encode_indices.c
    src/lib/opus-1.2.1/encode_pulses.c
    src/lib/opus-1.2.1/entcode.c
    src/lib/opus-1.2.1/entdec.c
    src/lib/opus-1.2.1/entenc.c
    src/lib/opus-1.2.1/find_LPC_FIX.c
    src/lib/opus-1.2.1/find_LTP_FIX.c
    src/lib/opus-1.2.1/find_pitch_lags_FIX.c
    src/lib/opus-1.2.1/find_pred_coefs_FIX.c
    src/lib/opus-1.2.1/gain_quant.c
    src/lib/opus-1.2.1/init_decoder.c
    src/lib/opus-1.2.1/init_encoder.c
    src/lib/opus-1.2.1/inner_prod_aligned.c
    src/lib/opus-1.2.1/interpolate.c
    src/lib/opus-1.2.1/k2a_FIX.c
    src/lib/opus-1.2.1/k2a_Q16_FIX.c
    src/lib/opus-1.2.1/kiss_fft.c
    src/lib/opus-1.2.1/laplace.c
    src/lib/opus-1.2.1/lin2log.c
    src/lib/opus-1.2.1/log2lin.c
    src/lib/opus-1.2.1/mathops.c
    src/lib/opus-1.2.1/mdct.c
    src/lib/opus-1.2.1/mlp.c
    src/lib/opus-1.2.1/mlp_data.c
    src/lib/opus-1.2.1/modes.c
    src/lib/opus-1.2.1/noise_shape_analysis_FIX.c
    src/lib/opus-1.2.1/opus.c
    src/lib/opus-1.2.1/opus_decoder.c
    src/lib/opus-1.2.1/opus_encoder.c
    src/lib/opus-1.2.1/opus_multistream.c
    src/lib/opus-1.2.1/opus_multistream_decoder.c
    src/lib/opus-1.2.1/opus_multistream_encoder.c
    src/lib/opus-1.2.1/pitch.c
    src/lib/opus-1.2.1/pitch_analysis_core_FIX.c
    src/lib/opus-1.2.1/pitch_est_tables.c
    src/lib/opus-1.2.1/process_NLSFs.c
    src/lib/opus-1.2.1/process_gains_FIX.c
    src/lib/opus-1.2.1/quant_LTP_gains.c
    src/lib/opus-1.2.1/quant_bands.c
    src/lib/opus-1.2.1/rate.c
    src/lib/opus-1.2.1/regularize_correlations_FIX.c
    src/lib/opus-1.2.1/repacketizer.c
    src/lib/opus-1.2.1/resampler.c
    src/lib/opus-1.2.1/resampler_down2.c
    src/lib/opus-1.2.1/resampler_down2_3.c
    src/lib/opus-1.2.1/resampler_private_AR2.c
    src/lib/opus-1.2.1/resampler_private_IIR_FIR.c
    src/lib/opus-1.2.1/resampler_private_down_FIR.c
    src/lib/opus-1.2.1/resampler_private_up2_HQ.c
    src/lib/opus-1.2.1/resampler_rom.c
    src/lib/opus-1.2.1/residual_energy16_FIX.c
    src/lib/opus-1.2.1/residual_energy_FIX.c
    src/lib/opus-1.2.1/schur64_FIX.c
    src/lib/opus-1.2.1/schur_FIX.c
    src/lib/opus-1.2.1/shell_coder.c
    src/lib/opus-1.2.1/sigm_Q15.c
    src/lib/opus-1.2.1/sort.c
    src/lib/opus-1.2.1/stereo_LR_to_MS.c
    src/lib/opus-1.2.1/stereo_MS_to_LR.c
    src/lib/opus-1.2.1/stereo_decode_pred.c
    src/lib/opus-1.2.1/stereo_encode_pred.c
    src/lib/opus-1.2.1/stereo_find_predictor.c
    src/lib/opus-1.2.1/stereo_quant_pred.c
    src/lib/opus-1.2.1/sum_sqr_shift.c
    src/lib/opus-1.2.1/table_LSF_cos.c
    src/lib/opus-1.2.1/tables_LTP.c
    src/lib/opus-1.2.1/tables_NLSF_CB_NB_MB.c
    src/lib/opus-1.2.1/tables_NLSF_CB_WB.c
    src/lib/opus-1.2.1/tables_gain.c
    src/lib/opus-1.2.1/tables_other.c
    src/lib/opus-1.2.1/tables_pitch_lag.c
    src/lib/opus-1.2.1/tables_pulses_per_block.c
    src/lib/opus-1.2.1/vector_ops_FIX.c
    src/lib/opus-1.2.1/vq.c
    src/lib/opus-1.2.1/warped_autocorrelation_FIX.c
    src/lib/opus-1.2.1/arm/celt_pitch_xcorr_arm_gcc.s
)

set(CMAKE_C_FLAGS "${CMAKE_C_FLAGS} -DARM_MATH_CM4")
# set(CMAKE_C_FLAGS "${CMAKE_C_FLAGS} -DVAR_ARRAYS")
set(CMAKE_C_FLAGS "${CMAKE_C_FLAGS} -DOPUS_ARM_ASM")
set(CMAKE_C_FLAGS "${CMAKE_C_FLAGS} -DOPUS_ARM_INLINE_ASM")
set(CMAKE_C_FLAGS "${CMAKE_C_FLAGS} -DOPUS_ARM_INLINE_EDSP")
set(CMAKE_C_FLAGS "${CMAKE_C_FLAGS} -DOPUS_ARM_INLINE_MEDIA")
set(CMAKE_C_FLAGS "${CMAKE_C_FLAGS} -DOPUS_ARM_MAY_HAVE_EDSP")
set(CMAKE_C_FLAGS "${CMAKE_C_FLAGS} -DOPUS_ARM_PRESUME_EDSP")
set(CMAKE_C_FLAGS "${CMAKE_C_FLAGS} -DOPUS_BUILD")
set(CMAKE_C_FLAGS "${CMAKE_C_FLAGS} -DUSE_ALLOCA")
set(CMAKE_C_FLAGS "${CMAKE_C_FLAGS} -DFIXED_POINT -DDISABLE_FLOAT_API")
set(CMAKE_C_FLAGS "${CMAKE_C_FLAGS} -DHAVE_CONFIG_H")
set(CMAKE_C_FLAGS "${CMAKE_C_FLAGS} -DHAVE_ALLOCA_H")
set(CMAKE_C_FLAGS "${CMAKE_C_FLAGS} -fsingle-precision-constant") # A lot of constants are written as doubles
set(CMAKE_C_FLAGS "${CMAKE_C_FLAGS} -DHAVE_LRINT -DHAVE_LRINTF")
```

## prj.conf
```kconfig
#
# Hardware settings
#

CONFIG_GPIO=y
CONFIG_NRFX_PDM=y

# To flash via dev board
#CONFIG_BUILD_OUTPUT_UF2=n
#CONFIG_USE_DT_CODE_PARTITION=n

#
# Bluetooth settings
#

CONFIG_BT=y
CONFIG_BT_PERIPHERAL=y
CONFIG_BT_DEVICE_NAME="Friend"
CONFIG_BT_MAX_CONN=1
CONFIG_BT_MAX_PAIRED=1
CONFIG_BT_DEVICE_APPEARANCE=22
CONFIG_BT_GATT_DYNAMIC_DB=y
# CONFIG_BT_L2CAP_DYNAMIC_CHANNEL=y
# CONFIG_BT_SMP=y
# CONFIG_BT_LL_SW_SPLIT=y # Alternative implementation

# Large packets
CONFIG_BT_L2CAP_TX_MTU=498
CONFIG_BT_L2CAP_TX_BUF_COUNT=10
# CONFIG_BT_ATT_TX_COUNT=10
CONFIG_BT_CONN_TX_MAX=30
CONFIG_BT_BUF_ACL_RX_SIZE=2048
CONFIG_BT_BUF_ACL_TX_SIZE=2048
CONFIG_BT_CTLR_DATA_LENGTH_MAX=251

CONFIG_BT_USER_DATA_LEN_UPDATE=y
CONFIG_BT_AUTO_DATA_LEN_UPDATE=y
CONFIG_BT_USER_PHY_UPDATE=y
CONFIG_BT_AUTO_PHY_UPDATE=y

# Codecs
# CONFIG_LIBLC3=y

# Debug
# CONFIG_DEBUG=y
# CONFIG_ASSERT=y
# CONFIG_LOG=y
# CONFIG_LOG_PRINTK=y
# CONFIG_LOG_BUFFER_SIZE=4096
# CONFIG_LOG_PROCESS_THREAD_STACK_SIZE=4096
# CONFIG_LOG_MODE_IMMEDIATE=y

# Log Levels
# CONFIG_BT_DEBUG_LOG=y
# CONFIG_BT_L2CAP_LOG_LEVEL_DBG=y
# CONFIG_BT_LOG_LEVEL_DBG=y

# CONFIG_LOG_PROCESS_THREAD_STACK_SIZE=4096
# CONFIG_BT_RX_STACK_SIZE=4096
# CONFIG_BT_CTLR_RX_PRIO_STACK_SIZE=4096
# CONFIG_BT_DEBUG_LOG=y
# CONFIG_LOG_BUFFER_SIZE=32000
# CONFIG_LOG_OVERRIDE_LEVEL=4
# CONFIG_LOG_PROCESS_THREAD_STACK_SIZE=4096
# CONFIG_BT_RX_STACK_SIZE=4096
# CONFIG_BT_CTLR_RX_PRIO_STACK_SIZE=4096

# RTT
# CONFIG_UART_CONSOLE=n
# CONFIG_SEGGER_RTT_BUFFER_SIZE_UP=2048
# CONFIG_RTT_CONSOLE=y
# CONFIG_LOG_BACKEND_RTT=y
```

## src/codec.c
```c
#include <zephyr/sys/ring_buffer.h>
#include "codec.h"
#include "audio.h"
#include "config.h"
#include "utils.h"
#ifdef CODEC_OPUS
#include "lib/pus-1.2.1/opus.h"
#endif

//
// Output
//

static volatile codec_callback _callback = NULL;

void set_codec_callback(codec_callback callback)
{
    _callback = callback;
}

//
// Input
//

uint8_t codec_ring_buffer_data[AUDIO_BUFFER_SAMPLES * 2]; // 2 bytes per sample
struct ring_buf codec_ring_buf;

int codec_receive_pcm(int16_t *data, size_t len)
{
    int written = ring_buf_put(&codec_ring_buf, (uint8_t *)data, len * 2);
    if (written != len * 2)
    {
        printk("Failed to write %d bytes to codec ring buffer\n", len * 2);
        return -1;
    }
    return 0;
}

//
// Thread
//

int16_t codec_input_samples[CODEC_PACKAGE_SAMPLES];
uint8_t codec_output_bytes[CODEC_OUTPUT_MAX_BYTES];
K_THREAD_STACK_DEFINE(codec_stack, 32000);
static struct k_thread codec_thread;
uint16_t execute_codec();

#if CODEC_OPUS
#if (CONFIG_OPUS_MODE == CONFIG_OPUS_MODE_CELT)
#define OPUS_ENCODER_SIZE 7180
#endif
#if (CONFIG_OPUS_MODE == CONFIG_OPUS_MODE_HYBRID)
#define OPUS_ENCODER_SIZE 10916
#endif
__ALIGN(4)
static uint8_t m_opus_encoder[OPUS_ENCODER_SIZE];
static OpusEncoder *const m_opus_state = (OpusEncoder *)m_opus_encoder;
#endif

void codec_entry()
{
    uint16_t output_size;
    while (1)
    {

        // Check if we have enough data
        if (ring_buf_size_get(&codec_ring_buf) < CODEC_PACKAGE_SAMPLES * 2)
        {
            k_sleep(K_MSEC(10));
            continue;
        }

        // Read package
        ring_buf_get(&codec_ring_buf, (uint8_t *)codec_input_samples, CODEC_PACKAGE_SAMPLES * 2);

        // Run Codec
        output_size = execute_codec();

        // Notify
        if (_callback)
        {
            _callback(codec_output_bytes, output_size);
        }

        // Yield
        k_yield();
    }
}

int codec_start()
{
    
// OPUS
#if CODEC_OPUS
    ASSERT_TRUE(opus_encoder_get_size(1) == sizeof(m_opus_encoder));
    ASSERT_TRUE(opus_encoder_init(m_opus_state, 16000, 1, CODEC_OPUS_APPLICATION) == OPUS_OK);
    ASSERT_TRUE(opus_encoder_ctl(m_opus_state, OPUS_SET_BITRATE(CODEC_OPUS_BITRATE)) == OPUS_OK);
    ASSERT_TRUE(opus_encoder_ctl(m_opus_state, OPUS_SET_VBR(CODEC_OPUS_VBR)) == OPUS_OK);
    ASSERT_TRUE(opus_encoder_ctl(m_opus_state, OPUS_SET_VBR_CONSTRAINT(0)) == OPUS_OK);
    ASSERT_TRUE(opus_encoder_ctl(m_opus_state, OPUS_SET_COMPLEXITY(CODEC_OPUS_COMPLEXITY)) == OPUS_OK);
    ASSERT_TRUE(opus_encoder_ctl(m_opus_state, OPUS_SET_SIGNAL(OPUS_SIGNAL_VOICE)) == OPUS_OK);
    ASSERT_TRUE(opus_encoder_ctl(m_opus_state, OPUS_SET_LSB_DEPTH(16)) == OPUS_OK);
    ASSERT_TRUE(opus_encoder_ctl(m_opus_state, OPUS_SET_DTX(0)) == OPUS_OK);
    ASSERT_TRUE(opus_encoder_ctl(m_opus_state, OPUS_SET_INBAND_FEC(0)) == OPUS_OK);
    ASSERT_TRUE(opus_encoder_ctl(m_opus_state, OPUS_SET_PACKET_LOSS_PERC(0)) == OPUS_OK);
#endif

    // Thread
    ring_buf_init(&codec_ring_buf, sizeof(codec_ring_buffer_data), codec_ring_buffer_data);
    k_thread_create(&codec_thread, codec_stack, K_THREAD_STACK_SIZEOF(codec_stack), (k_thread_entry_t)codec_entry, NULL, NULL, NULL, K_PRIO_PREEMPT(4), 0, K_NO_WAIT);

    // Success
    return 0;
}

//
// MU-Law codec
//

#if CODEC_MU_LAW

uint16_t execute_codec()
{
    for (int i = 0; i < CODEC_PACKAGE_SAMPLES / CODEC_DIVIDER; i++)
    {
        codec_output_bytes[i] = linear2ulaw(codec_input_samples[i * CODEC_DIVIDER]);
    }
    return CODEC_PACKAGE_SAMPLES / CODEC_DIVIDER;
}

#endif

//
// PCM codec
//

#if CODEC_PCM

uint16_t execute_codec()
{
    for (int i = 0; i < CODEC_PACKAGE_SAMPLES / CODEC_DIVIDER; i++)
    {
        codec_output_bytes[i * 2] = codec_input_samples[i * CODEC_DIVIDER] & 0xFF;
        codec_output_bytes[i * 2 + 1] = (codec_input_samples[i * CODEC_DIVIDER] >> 8) & 0xFF;
    }
    return (CODEC_PACKAGE_SAMPLES / CODEC_DIVIDER) * 2;
}
#endif

//
// Opus codec
//

#if CODEC_OPUS

uint16_t execute_codec()
{
    opus_int32 size = opus_encode(m_opus_state, codec_input_samples, CODEC_PACKAGE_SAMPLES, codec_output_bytes, sizeof(codec_output_bytes));
    if (size < 0)
    {
        printk("Opus encoding failed: %d\n", size);
        return 0;
    }
    // printk("Opus encoding success: %i\n", size);
    return size;
}

#endif
```

## src/transport.c
```c
#include <zephyr/kernel.h>
#include <zephyr/logging/log.h>
#include <zephyr/sys/ring_buffer.h>
#include <zephyr/bluetooth/bluetooth.h>
#include <zephyr/bluetooth/uuid.h>
#include <zephyr/bluetooth/gatt.h>
#include <zephyr/bluetooth/l2cap.h>
#include <zephyr/sys/atomic.h>
#include "transport.h"
#include "config.h"
#include "utils.h"

//
// Internal
//

static struct bt_conn_cb _callback_references;
static ssize_t audio_characteristic_read(struct bt_conn *conn, const struct bt_gatt_attr *attr, void *buf, uint16_t len, uint16_t offset);
static ssize_t audio_characteristic_format_read(struct bt_conn *conn, const struct bt_gatt_attr *attr, void *buf, uint16_t len, uint16_t offset);
static void ccc_config_changed_handler(const struct bt_gatt_attr *attr, uint16_t value);

//
// Service and Characteristic
//

static struct bt_uuid_128 audio_service_uuid = BT_UUID_INIT_128(BT_UUID_128_ENCODE(0x19B10000, 0xE8F2, 0x537E, 0x4F6C, 0xD104768A1214));
static struct bt_uuid_128 audio_characteristic_uuid = BT_UUID_INIT_128(BT_UUID_128_ENCODE(0x19B10001, 0xE8F2, 0x537E, 0x4F6C, 0xD104768A1214));
static struct bt_uuid_128 audio_characteristic_format_uuid = BT_UUID_INIT_128(BT_UUID_128_ENCODE(0x19B10002, 0xE8F2, 0x537E, 0x4F6C, 0xD104768A1214));
static struct bt_gatt_attr attrs[] = {
    BT_GATT_PRIMARY_SERVICE(&audio_service_uuid),
    BT_GATT_CHARACTERISTIC(&audio_characteristic_uuid.uuid, BT_GATT_CHRC_READ | BT_GATT_CHRC_NOTIFY, BT_GATT_PERM_READ, audio_characteristic_read, NULL, NULL),
    BT_GATT_CCC(ccc_config_changed_handler, BT_GATT_PERM_READ | BT_GATT_PERM_WRITE),
    BT_GATT_CHARACTERISTIC(&audio_characteristic_format_uuid.uuid, BT_GATT_CHRC_READ, BT_GATT_PERM_READ, audio_characteristic_format_read, NULL, NULL),
};
static struct bt_gatt_service audio_service = BT_GATT_SERVICE(attrs);

// Advertisement data
static const struct bt_data bt_ad[] = {
    BT_DATA_BYTES(BT_DATA_FLAGS, (BT_LE_AD_GENERAL | BT_LE_AD_NO_BREDR)),
    BT_DATA(BT_DATA_NAME_COMPLETE, "Friend", sizeof("Friend") - 1),
};

// Scan response data
static const struct bt_data bt_sd[] = {
    BT_DATA(BT_DATA_UUID128_ALL, audio_service_uuid.val, sizeof(audio_service_uuid.val)),
};

//
// State and Characteristics
//

struct bt_conn *current_connection = NULL;
uint16_t current_mtu = 0;
uint16_t current_package_index = 0;

static ssize_t audio_characteristic_read(struct bt_conn *conn, const struct bt_gatt_attr *attr, void *buf, uint16_t len, uint16_t offset)
{
    printk("audio_characteristic_read\n");
    return bt_gatt_attr_read(conn, attr, buf, len, offset, NULL, 0);
}

static ssize_t audio_characteristic_format_read(struct bt_conn *conn, const struct bt_gatt_attr *attr, void *buf, uint16_t len, uint16_t offset)
{
    printk("audio_characteristic_format_read\n");
    uint8_t value[1] = {CODEC_ID};
    return bt_gatt_attr_read(conn, attr, buf, len, offset, value, sizeof(value));
}

static void ccc_config_changed_handler(const struct bt_gatt_attr *attr, uint16_t value)
{
    if (value == BT_GATT_CCC_NOTIFY)
    {
        printk("Client subscribed for notifications\n");
    }
    else if (value == 0)
    {
        printk("Client unsubscribed from notifications\n");
    }
    else
    {
        printk("Invalid CCC value: %u\n", value);
    }
}

//
// Connection Callbacks
//

static void _transport_connected(struct bt_conn *conn, uint8_t err)
{
    struct bt_conn_info info = {0};
    err = bt_conn_get_info(conn, &info);
    if (err)
    {
        printk("Failed to get connection info (err %d)\n", err);
        return;
    }

    current_connection = bt_conn_ref(conn);
    current_mtu = info.le.data_len->tx_max_len;
    printk("Connected\n");
    printk("Interval: %d, latency: %d, timeout: %d\n", info.le.interval, info.le.latency, info.le.timeout);
    printk("TX PHY %s, RX PHY %s\n", phy2str(info.le.phy->tx_phy), phy2str(info.le.phy->rx_phy));
    printk("LE data len updated: TX (len: %d time: %d) RX (len: %d time: %d)\n", info.le.data_len->tx_max_len, info.le.data_len->tx_max_time, info.le.data_len->rx_max_len, info.le.data_len->rx_max_time);
}

static void _transport_disconnected(struct bt_conn *conn, uint8_t err)
{
    printk("Disconnected\n");
    bt_conn_unref(conn);
    current_connection = NULL;
    current_mtu = 0;
}

static bool _le_param_req(struct bt_conn *conn, struct bt_le_conn_param *param)
{
    printk("Connection parameters update request received.\n");
    printk("Minimum interval: %d, Maximum interval: %d\n",
           param->interval_min, param->interval_max);
    printk("Latency: %d, Timeout: %d\n", param->latency, param->timeout);

    return true;
}

static void _le_param_updated(struct bt_conn *conn, uint16_t interval,
                              uint16_t latency, uint16_t timeout)
{
    printk("Connection parameters updated.\n"
           " interval: %d, latency: %d, timeout: %d\n",
           interval, latency, timeout);
}

static void _le_phy_updated(struct bt_conn *conn,
                            struct bt_conn_le_phy_info *param)
{
    printk("LE PHY updated: TX PHY %s, RX PHY %s\n",
           phy2str(param->tx_phy), phy2str(param->rx_phy));
}

static void _le_data_length_updated(struct bt_conn *conn,
                                    struct bt_conn_le_data_len_info *info)
{
    printk("LE data len updated: TX (len: %d time: %d)"
           " RX (len: %d time: %d)\n",
           info->tx_max_len,
           info->tx_max_time, info->rx_max_len, info->rx_max_time);
    current_mtu = info->tx_max_len;
}

static struct bt_conn_cb _callback_references = {
    .connected = _transport_connected,
    .disconnected = _transport_disconnected,
    .le_param_req = _le_param_req,
    .le_param_updated = _le_param_updated,
    .le_phy_updated = _le_phy_updated,
    .le_data_len_updated = _le_data_length_updated,
};

//
// Ring Buffer
//

#define NET_BUFFER_HEADER_SIZE 3
#define RING_BUFFER_HEADER_SIZE 2
static uint8_t tx_queue[NETWORK_RING_BUF_SIZE * (CODEC_OUTPUT_MAX_BYTES + RING_BUFFER_HEADER_SIZE)];
static uint8_t tx_buffer[CODEC_OUTPUT_MAX_BYTES + RING_BUFFER_HEADER_SIZE];
static uint8_t tx_buffer_2[CODEC_OUTPUT_MAX_BYTES + RING_BUFFER_HEADER_SIZE];
static uint32_t tx_buffer_size = 0;
static struct ring_buf ring_buf;

static bool write_to_tx_queue(uint8_t *data, size_t size)
{
    if (size > CODEC_OUTPUT_MAX_BYTES)
    {
        return false;
    }

    // Copy data (TODO: Avoid this copy)
    tx_buffer_2[0] = size & 0xFF;
    tx_buffer_2[1] = (size >> 8) & 0xFF;
    memcpy(tx_buffer_2 + RING_BUFFER_HEADER_SIZE, data, size);

    // Write to ring buffer
    int written = ring_buf_put(&ring_buf, tx_buffer_2, (CODEC_OUTPUT_MAX_BYTES + RING_BUFFER_HEADER_SIZE)); // It always fits completely or not at all
    if (written != CODEC_OUTPUT_MAX_BYTES + RING_BUFFER_HEADER_SIZE)
    {
        return false;
    }
    else
    {
        return true;
    }
}

static bool read_from_tx_queue()
{

    // Read from ring buffer
    // memset(tx_buffer, 0, sizeof(tx_buffer));
    tx_buffer_size = ring_buf_get(&ring_buf, tx_buffer, (CODEC_OUTPUT_MAX_BYTES + RING_BUFFER_HEADER_SIZE)); // It always fits completely or not at all
    if (tx_buffer_size != (CODEC_OUTPUT_MAX_BYTES + RING_BUFFER_HEADER_SIZE))
    {
        printk("Failed to read from ring buffer %d\n", tx_buffer_size);
        return false;
    }

    // Adjust size
    tx_buffer_size = tx_buffer[0] + (tx_buffer[1] << 8);

    return true;
}

//
// Pusher
//

// Thread
K_THREAD_STACK_DEFINE(pusher_stack, 1024);
static struct k_thread pusher_thread;
static uint16_t packet_next_index = 0;
static uint8_t pusher_temp_data[CODEC_OUTPUT_MAX_BYTES + NET_BUFFER_HEADER_SIZE];

static bool push_to_gatt(struct bt_conn *conn)
{
    // Read data from ring buffer
    if (!read_from_tx_queue())
    {
        return false;
    }

    // Push each frame
    uint8_t *buffer = tx_buffer + RING_BUFFER_HEADER_SIZE;
    uint32_t offset = 0;
    uint8_t index = 0;
    while (offset < tx_buffer_size)
    {
        // Recombine packet
        uint32_t id = packet_next_index++;
        uint32_t packet_size = MIN(current_mtu - NET_BUFFER_HEADER_SIZE, tx_buffer_size - offset);
        pusher_temp_data[0] = id & 0xFF;
        pusher_temp_data[1] = (id >> 8) & 0xFF;
        pusher_temp_data[2] = index;
        memcpy(pusher_temp_data + NET_BUFFER_HEADER_SIZE, buffer + offset, packet_size);
        offset += packet_size;
        index++;

        while (true)
        {

            // Try send notification
            int err = bt_gatt_notify(conn, &audio_service.attrs[1], pusher_temp_data, packet_size + NET_BUFFER_HEADER_SIZE);

            // Log failure
            if (err)
            {
                printk("bt_gatt_notify failed (err %d)\n", err);
                printk("MTU: %d, packet_size: %d\n", current_mtu, packet_size + NET_BUFFER_HEADER_SIZE);
                k_sleep(K_MSEC(1));
            }

            // Try to send more data if possible
            if (err == -EAGAIN || err == -ENOMEM)
            {
                continue;
            }

            // Break if success
            break;
        }
    }

    return true;
}

void pusher(void)
{
    while (1)
    {

        //
        // Load current connection
        //

        struct bt_conn *conn = current_connection;
        bool use_gatt = true;
        if (conn)
        {
            conn = bt_conn_ref(conn);
        }
        bool valid = true;
        if (current_mtu < MINIMAL_PACKET_SIZE)
        {
            valid = false;
        }
        else if (!conn)
        {
            valid = false;
        }
        else
        {
            valid = bt_gatt_is_subscribed(conn, &audio_service.attrs[1], BT_GATT_CCC_NOTIFY); // Check if subscribed
        }

        // If no valid mode exists - discard whole buffer
        if (!valid)
        {
            ring_buf_reset(&ring_buf);
            k_sleep(K_MSEC(10));
        }

        // Handle GATT
        if (use_gatt && valid)
        {
            bool sent = push_to_gatt(conn);
            if (!sent)
            {
                k_sleep(K_MSEC(50));
            }
        }

        if (conn)
        {
            bt_conn_unref(conn);
        }
    }
}

//
// Public functions
//

int transport_start()
{

    // Configure callbacks
    bt_conn_cb_register(&_callback_references);

    // Enable Bluetooth
    int err = bt_enable(NULL);
    if (err)
    {
        printk("Bluetooth init failed (err %d)\n", err);
        return err;
    }
    printk("Bluetooth initialized\n");

    // Start advertising
    bt_gatt_service_register(&audio_service);
    err = bt_le_adv_start(BT_LE_ADV_CONN, bt_ad, ARRAY_SIZE(bt_ad), bt_sd, ARRAY_SIZE(bt_sd));
    if (err)
    {
        printk("Advertising failed to start (err %d)\n", err);
        return err;
    }
    else
    {
        printk("Advertising successfully started\n");
    }

    // Start pusher
    ring_buf_init(&ring_buf, sizeof(tx_queue), tx_queue);
    k_thread_create(&pusher_thread, pusher_stack, K_THREAD_STACK_SIZEOF(pusher_stack), (k_thread_entry_t)pusher, NULL, NULL, NULL, K_PRIO_PREEMPT(7), 0, K_NO_WAIT);

    return 0;
}

struct bt_conn *get_current_connection()
{
    return current_connection;
}

int broadcast_audio_packets(uint8_t *buffer, size_t size)
{
    while (!write_to_tx_queue(buffer, size))
    {
        k_sleep(K_MSEC(1));
    }
    return 0;
}
```

## src/utils.h
```c
#pragma once
#include <zephyr/logging/log.h>
#include <zephyr/bluetooth/gatt.h>

#define ASSERT_OK(result)                                          \
    if ((result) < 0)                                              \
    {                                                              \
        printk("Error at %s:%d:%d\n", __FILE__, __LINE__, result); \
        return (result);                                           \
    }

#define ASSERT_TRUE(result)                                        \
    if (!result)                                                   \
    {                                                              \
        printk("Error at %s:%d:%d\n", __FILE__, __LINE__, result); \
        return -1;                                                 \
    }

static const char *phy2str(uint8_t phy)
{
	switch (phy) {
	case 0: return "No packets";
	case BT_GAP_LE_PHY_1M: return "LE 1M";
	case BT_GAP_LE_PHY_2M: return "LE 2M";
	case BT_GAP_LE_PHY_CODED: return "LE Coded";
	default: return "Unknown";
	}
}

// #define WAIT_LOG k_sleep(K_MSEC(200));
// #define WAIT_LOG do {} while(0);
// #define WAIT_LOG z_impl_log_process()
// #define WAIT_LOG while (z_impl_log_process() == true) { }
```
