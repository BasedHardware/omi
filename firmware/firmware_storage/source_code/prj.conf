## prj.conf
```kconfig
#
# Hardware settings
#

CONFIG_GPIO=y
CONFIG_NRFX_PDM=y
CONFIG_ADC=y


#
# SD Card settings
#

CONFIG_DISK_ACCESS=y
#CONFIG_LOG=y
CONFIG_FILE_SYSTEM=y
CONFIG_FAT_FILESYSTEM_ELM=y
CONFIG_FS_FATFS_MOUNT_MKFS=y
CONFIG_FS_FATFS_EXFAT=y
CONFIG_PRINTK=y
CONFIG_MAIN_STACK_SIZE=2048

CONFIG_DEBUG_OPTIMIZATIONS=y
CONFIG_LOG_PRINTK=y
CONFIG_LOG_MODE_IMMEDIATE=y

CONFIG_LOG_BACKEND_UART=y
CONFIG_LOG_BUFFER_SIZE=4096

CONFIG_DISK_DRIVER_SDMMC=y
CONFIG_SPI=y

CONFIG_HEAP_MEM_POOL_SIZE=512

#
# Bluetooth settings
#

CONFIG_BT=y
CONFIG_BT_PERIPHERAL=y
CONFIG_BT_DEVICE_NAME="Friend"
CONFIG_BT_MAX_CONN=1
CONFIG_BT_MAX_PAIRED=1
CONFIG_BT_DEVICE_APPEARANCE=22
CONFIG_BT_GATT_DYNAMIC_DB=y

# CONFIG_BT_L2CAP_DYNAMIC_CHANNEL=y
# CONFIG_BT_SMP=y
# CONFIG_BT_LL_SW_SPLIT=y # Alternative implementation

# Battery and Device Information services
CONFIG_BT_BAS=y
CONFIG_BT_DIS=y
CONFIG_BT_DIS_PNP=n
CONFIG_BT_DIS_MODEL="Friend"
CONFIG_BT_DIS_MANUF="Based Hardware"
CONFIG_BT_DIS_FW_REV=y
CONFIG_BT_DIS_HW_REV=y
CONFIG_BT_DIS_FW_REV_STR="1.0.3"
CONFIG_BT_DIS_HW_REV_STR="Seeed Xiao BLE Sense"

# Large packets
CONFIG_BT_L2CAP_TX_MTU=498
CONFIG_BT_L2CAP_TX_BUF_COUNT=10
# CONFIG_BT_ATT_TX_COUNT=10
CONFIG_BT_CONN_TX_MAX=30
CONFIG_BT_BUF_ACL_RX_SIZE=2048
CONFIG_BT_BUF_ACL_TX_SIZE=2048
CONFIG_BT_CTLR_DATA_LENGTH_MAX=251

CONFIG_BT_USER_DATA_LEN_UPDATE=y
CONFIG_BT_AUTO_DATA_LEN_UPDATE=y
CONFIG_BT_USER_PHY_UPDATE=y
CONFIG_BT_AUTO_PHY_UPDATE=y

# Codecs
# CONFIG_LIBLC3=y

# Debug
# CONFIG_DEBUG=y
# CONFIG_ASSERT=y
# CONFIG_LOG=y
# CONFIG_LOG_PRINTK=y
# CONFIG_LOG_BUFFER_SIZE=4096
# CONFIG_LOG_PROCESS_THREAD_STACK_SIZE=4096
# CONFIG_LOG_MODE_IMMEDIATE=y

# Log Levels
# CONFIG_BT_DEBUG_LOG=y
# CONFIG_BT_L2CAP_LOG_LEVEL_DBG=y
# CONFIG_BT_LOG_LEVEL_DBG=y

# CONFIG_LOG_PROCESS_THREAD_STACK_SIZE=4096
# CONFIG_BT_RX_STACK_SIZE=4096
# CONFIG_BT_CTLR_RX_PRIO_STACK_SIZE=4096
# CONFIG_BT_DEBUG_LOG=y
# CONFIG_LOG_BUFFER_SIZE=32000
# CONFIG_LOG_OVERRIDE_LEVEL=4
# CONFIG_LOG_PROCESS_THREAD_STACK_SIZE=4096
# CONFIG_BT_RX_STACK_SIZE=4096
# CONFIG_BT_CTLR_RX_PRIO_STACK_SIZE=4096

# RTT
# CONFIG_UART_CONSOLE=n
# CONFIG_SEGGER_RTT_BUFFER_SIZE_UP=2048
# CONFIG_RTT_CONSOLE=y
# CONFIG_LOG_BACKEND_RTT=y
```

## src/main.c
```c
#include <zephyr/kernel.h>
//#include "lib/sdcard/sdcard.h"
#include <zephyr/logging/log.h>
#include "transport.h"
#include "storage.h"
#include "mic.h"
#include "utils.h"
#include "led.h"
#include "config.h"
#include "audio.h"
#include "codec.h"

static void codec_handler(uint8_t *data, size_t len)
{
	broadcast_audio_packets(data, len); // Errors are logged inside
}

static void mic_handler(int16_t *buffer)
{
	codec_receive_pcm(buffer, MIC_BUFFER_SAMPLES); // Errors are logged inside
}

void bt_ctlr_assert_handle(char *name, int type)
{
	if (name != NULL)
	{
		printk("Bt assert-> %s", name);
	}
}

// Main loop
int main(void)
{
	// Led start
	ASSERT_OK(led_start());
	set_led_blue(true);

	// Storage start
	ASSERT_OK(init_storage())

	// Transport start
	ASSERT_OK(transport_start());

	// Codec start
	set_codec_callback(codec_handler);
	ASSERT_OK(codec_start());

	// Mic start
	set_mic_callback(mic_handler);
	ASSERT_OK(mic_start());

	// Blink LED
	bool is_on = true;
	//set_led_blue(false);
	set_led_red(is_on);


	/* SD CARD TEST */
	//int ret = 0;
	/** SD card mount test **/
	/*
	if (mount_sd_card()) {
		printk("Failed to mount SD card\n");
		//return -1;
	} else {
		printk("Successfully mounted SD card\n");
	}

	create_file("audio/test.txt");
	WriteParams params = {"hola", true};
	write_file(params);
	read_file();
	create_file("audio/test1.txt");
	WriteParams params1 = {"mundo", true};
	write_file(params1);
	read_file();
	create_file("audio/test2.txt");
	WriteParams params2 = {"esto es una prueba", true};
	write_file(params2);
	read_file();*/
	/* SD CARD TEST */



	while (1)
	{
		is_on = !is_on;
		set_led_red(is_on);
		k_msleep(500);
	}

	// Unreachable
	return 0;
}
```

## src/storage.c
```c
#include "lib/sdcard/sdcard.h"
#include "storage.h"

static const uint8_t written_max_count = 3000; // number of frames per file
static bool written_concat = true;
static uint8_t written_count = 0;
static char file_path[2048];
static bool verbose = true; // set to true if you want to enable verbose output

static uint8_t file_count = 0;


int init_storage(void)
{
    if(mount_sd_card())
    {
        if(verbose)
        {
            printk("Failed to mount SD card\n");
        }
		return -1;
    }

    if(verbose)
    {
        printk("Successfully mounted SD card\n");
    }
    return 0;    
}

ReadParams verify_info(void)
{
    int status;
    char path[1024];

    ReadParams res = read_file("info.txt");

    if(res.ret < -1)
    {
        create_file("info.txt");
        return res;
    }

    process_file(res.data, path, &status);

    if(status > -1)
    {   
        uint8_t number;
        
        if (extract_number(path, &number) == 0) {
            file_count = number;
        }

        res.ret = status;
        res.data = path;
    }

    return res;
}

int if_file_exist(void)
{
    ReadParams ret = verify_info();

    printk("Ret.data: %s\n",ret.data);

    if(ret.ret < 0)
    {
        create_file("audio/0.txt");
        write_info("audio/0.txt,status:NO");
        return -1;    
    }

    if(written_concat)
    {
        set_path(file_path);
    }
    
    if(ret.ret > -1 && written_concat == false)
    {
        char result[512];
        char new_filename[512];
        static char file_info[2048];

        extract_after(ret.data, result);
        generate_next_filename(result, new_filename, sizeof(new_filename));
        snprintf(file_path, sizeof(file_path), "audio/%s", new_filename);
        snprintf(file_info, sizeof(file_info), "audio/%s,status:NO", new_filename);
        
        create_file(file_path);
        write_info(file_info);

        written_concat = true;

        return 0;
    }

    return 0;
}

int save_audio_in_storage(uint8_t *buffer, uint32_t lenght)
{
    int ret = if_file_exist();

    if(ret > -1)
    {
        bool endBuffer = false;
        
        if(written_count < written_max_count)
        {
            if(written_count == written_max_count - 1)
            {
                endBuffer = true;
            }

            WriteParams params = {buffer, lenght, endBuffer, true};

            write_file(params);

        }
	    
        written_count += 1;

        if(written_count == written_max_count+1)
        {
            char file_info[4096];
            snprintf(file_info, sizeof(file_info), "%s,status:OK", file_path);
            write_info(file_info);

            written_concat = false;
            written_count = 0;
        }

        return 0;
    }

    return -1;
}

//
// Auxiliar fucntions
//

void generate_next_filename(const char *current_filename, char *new_filename, size_t new_filename_size) {
    uint8_t number = file_count;
    file_count = number+1;

    snprintf(new_filename, new_filename_size, "%d.txt", number+1);
}

void process_file(const char *file, char *path, int *status) {
    if (file == NULL || path == NULL || status == NULL) {
        return;
    }
    
    size_t trunc_length = 10;
    size_t file_len = strlen(file);

    if (file_len > trunc_length) {
        if(file_len - trunc_length > 4)
        {
            strncpy(path, file, file_len - trunc_length);
            path[file_len - trunc_length] = '\0';
        } else
        {
            path[0] = '\0';
        }
    } else 
    {
        path[0] = '\0';
    }

    const char *status_str = file + file_len - 2;
    if (strcmp(status_str, "OK") == 0) {
        *status = 0;
    } else if (strcmp(status_str, "NO") == 0) {
        *status = 1;
    } else {
        *status = -1;
    }
}

void extract_after(const char *data, char *result) {
    const char *prefix = "audio/";
    const char *prefix_position = strstr(data, prefix);

    if (prefix_position != NULL) {
        prefix_position += strlen(prefix);

        strcpy(result, prefix_position);
    } else {
        result[0] = '\0';
    }
}

int extract_number(const char *input, uint8_t *number) {
    if (input == NULL || number == NULL) {
        return -1;
    }

    const char *start = strchr(input, '/');
    if (start == NULL) {
        return -1;
    }

    start++;

    const char *end = strchr(start, '.');
    if (end == NULL) {
        return -1;
    }
    
    size_t length = end - start;
    char num_str[10];
    if (length >= sizeof(num_str)) {
        return -1;
    }
    
    strncpy(num_str, start, length);
    num_str[length] = '\0';

    int value = atoi(num_str);
    if (value < 0 || value > 255) {
        return -1;
    }
    
    *number = (uint8_t)value;
    return 0;
}
```

## src/transport.c
```c
#include <zephyr/kernel.h>
#include <zephyr/logging/log.h>
#include <zephyr/sys/ring_buffer.h>
#include <zephyr/bluetooth/bluetooth.h>
#include <zephyr/bluetooth/uuid.h>
#include <zephyr/bluetooth/gatt.h>
#include <zephyr/bluetooth/l2cap.h>
#include <zephyr/bluetooth/services/bas.h>
#include <zephyr/drivers/gpio.h>
#include "lib/battery/battery.h"
#include <zephyr/sys/atomic.h>
#include "transport.h"
#include "config.h"
#include "utils.h"
#include "btutils.h"

static bool isFiles = false;

//
// Internal
//

static struct bt_conn_cb _callback_references;

static void audio_ccc_config_changed_handler(const struct bt_gatt_attr *attr, uint16_t value);
static ssize_t audio_data_read_characteristic(struct bt_conn *conn, const struct bt_gatt_attr *attr, void *buf, uint16_t len, uint16_t offset);
static ssize_t audio_codec_read_characteristic(struct bt_conn *conn, const struct bt_gatt_attr *attr, void *buf, uint16_t len, uint16_t offset);





























static bool notification_enabled = false;









































static void dfu_ccc_config_changed_handler(const struct bt_gatt_attr *attr, uint16_t value);
static ssize_t dfu_control_point_write_handler(struct bt_conn *conn, const struct bt_gatt_attr *attr, const void *buf, uint16_t len, uint16_t offset, uint8_t flags);

//
// Service and Characteristic
//

// Audio service with UUID 19B10000-E8F2-537E-4F6C-D104768A1214
// exposes following characteristics:
// - Audio data (UUID 19B10001-E8F2-537E-4F6C-D104768A1214) to send audio data (read/notify)
// - Audio codec (UUID 19B10002-E8F2-537E-4F6C-D104768A1214) to send audio codec type (read)
// TODO: The current audio service UUID seems to come from old Intel sample code,
// we should change it to UUID 814b9b7c-25fd-4acd-8604-d28877beee6d
static struct bt_uuid_128 audio_service_uuid = BT_UUID_INIT_128(BT_UUID_128_ENCODE(0x19B10000, 0xE8F2, 0x537E, 0x4F6C, 0xD104768A1214));
static struct bt_uuid_128 audio_characteristic_data_uuid = BT_UUID_INIT_128(BT_UUID_128_ENCODE(0x19B10001, 0xE8F2, 0x537E, 0x4F6C, 0xD104768A1214));
static struct bt_uuid_128 audio_characteristic_format_uuid = BT_UUID_INIT_128(BT_UUID_128_ENCODE(0x19B10002, 0xE8F2, 0x537E, 0x4F6C, 0xD104768A1214));























static struct bt_uuid_128 sd_storage_notify_service_uuid = BT_UUID_INIT_128(BT_UUID_128_ENCODE(0x87654321, 0x4321, 0x8765, 0x4321, 0x1234567890ab));
static struct bt_uuid_128 sd_storage_notify_characteristic_uuid = BT_UUID_INIT_128(BT_UUID_128_ENCODE(0x87654321, 0x4321, 0x8765, 0x4321, 0x1234567890ac));


























static struct bt_gatt_attr audio_service_attr[] = {
    BT_GATT_PRIMARY_SERVICE(&audio_service_uuid),
    BT_GATT_CHARACTERISTIC(&audio_characteristic_data_uuid.uuid, BT_GATT_CHRC_READ | BT_GATT_CHRC_NOTIFY, BT_GATT_PERM_READ, audio_data_read_characteristic, NULL, NULL),
    BT_GATT_CCC(audio_ccc_config_changed_handler, BT_GATT_PERM_READ | BT_GATT_PERM_WRITE),
    BT_GATT_CHARACTERISTIC(&audio_characteristic_format_uuid.uuid, BT_GATT_CHRC_READ, BT_GATT_PERM_READ, audio_codec_read_characteristic, NULL, NULL),
};

static struct bt_gatt_service audio_service = BT_GATT_SERVICE(audio_service_attr);

// Nordic Legacy DFU service with UUID 00001530-1212-EFDE-1523-785FEABCD123
// exposes following characteristics:
// - Control point (UUID 00001531-1212-EFDE-1523-785FEABCD123) to start the OTA update process (write/notify)
static struct bt_uuid_128 dfu_service_uuid = BT_UUID_INIT_128(BT_UUID_128_ENCODE(0x00001530, 0x1212, 0xEFDE, 0x1523, 0x785FEABCD123));
static struct bt_uuid_128 dfu_control_point_uuid = BT_UUID_INIT_128(BT_UUID_128_ENCODE(0x00001531, 0x1212, 0xEFDE, 0x1523, 0x785FEABCD123));

static struct bt_gatt_attr dfu_service_attr[] = {
    BT_GATT_PRIMARY_SERVICE(&dfu_service_uuid),
    BT_GATT_CHARACTERISTIC(&dfu_control_point_uuid.uuid, BT_GATT_CHRC_WRITE | BT_GATT_CHRC_NOTIFY, BT_GATT_PERM_WRITE, NULL, dfu_control_point_write_handler, NULL),
    BT_GATT_CCC(dfu_ccc_config_changed_handler, BT_GATT_PERM_READ | BT_GATT_PERM_WRITE),
};

static struct bt_gatt_service dfu_service = BT_GATT_SERVICE(dfu_service_attr);

// Advertisement data
static const struct bt_data bt_ad[] = {
    BT_DATA_BYTES(BT_DATA_FLAGS, (BT_LE_AD_GENERAL | BT_LE_AD_NO_BREDR)),
    BT_DATA(BT_DATA_UUID128_ALL, audio_service_uuid.val, sizeof(audio_service_uuid.val)),
    BT_DATA(BT_DATA_NAME_COMPLETE, "Friend", sizeof("Friend") - 1),
};

// Scan response data
static const struct bt_data bt_sd[] = {
    BT_DATA_BYTES(BT_DATA_UUID16_ALL, BT_UUID_16_ENCODE(BT_UUID_DIS_VAL)),
    BT_DATA(BT_DATA_UUID128_ALL, dfu_service_uuid.val, sizeof(dfu_service_uuid.val)),
};

//
// State and Characteristics
//

struct bt_conn *current_connection = NULL;
uint16_t current_mtu = 0;
uint16_t current_package_index = 0;

static void audio_ccc_config_changed_handler(const struct bt_gatt_attr *attr, uint16_t value)
{
    if (value == BT_GATT_CCC_NOTIFY)
    {
        printk("Client subscribed for notifications\n");
    }
    else if (value == 0)
    {
        printk("Client unsubscribed from notifications\n");
    }
    else
    {
        printk("Invalid CCC value: %u\n", value);
    }
}

static ssize_t audio_data_read_characteristic(struct bt_conn *conn, const struct bt_gatt_attr *attr, void *buf, uint16_t len, uint16_t offset)
{
    printk("audio_data_read_characteristic\n");
    return bt_gatt_attr_read(conn, attr, buf, len, offset, NULL, 0);
}

static ssize_t audio_codec_read_characteristic(struct bt_conn *conn, const struct bt_gatt_attr *attr, void *buf, uint16_t len, uint16_t offset)
{
    printk("audio_codec_read_characteristic\n");
    uint8_t value[1] = {CODEC_ID};
    return bt_gatt_attr_read(conn, attr, buf, len, offset, value, sizeof(value));
}














static void sd_storage_notify_ccc_config_changed_handler(const struct bt_gatt_attr *attr, uint16_t value)
{
    if (value == BT_GATT_CCC_NOTIFY)
    {
        printk("Client subscribed for SD Storage notifications\n");
        notification_enabled = true;
    }
    else if (value == 0)
    {
        printk("Client unsubscribed from SD Storage notifications\n");
        notification_enabled = false;
    }
    else
    {
        printk("Invalid CCC value for SD Storage: %u\n", value);
    }
}

static ssize_t sd_storage_notify_read_characteristic(struct bt_conn *conn, const struct bt_gatt_attr *attr, void *buf, uint16_t len, uint16_t offset)
{
    printk("sd_storage_notify_read_characteristic\n");
    bool notification_value = false; // Cambia esto si quieres devolver otro valor por defecto
    return bt_gatt_attr_read(conn, attr, buf, len, offset, &notification_value, sizeof(notification_value));
}

static struct bt_gatt_attr sd_storage_notify_service_attr[] = {
    BT_GATT_PRIMARY_SERVICE(&sd_storage_notify_service_uuid),
    BT_GATT_CHARACTERISTIC(&sd_storage_notify_characteristic_uuid.uuid, BT_GATT_CHRC_READ | BT_GATT_CHRC_NOTIFY, BT_GATT_PERM_READ, sd_storage_notify_read_characteristic, NULL, NULL),
    BT_GATT_CCC(sd_storage_notify_ccc_config_changed_handler, BT_GATT_PERM_READ | BT_GATT_PERM_WRITE),
};

static void sd_storage_notify_send(bool value)
{
    if (current_connection && notification_enabled)
    {
        int err = bt_gatt_notify(current_connection, &sd_storage_notify_service_attr[1], &value, sizeof(value));
        if (err)
        {
            printk("Failed to send SD Storage notification (err %d)\n", err);
        }
        else
        {
            printk("SD Storage notification sent\n");
        }
    }
    else
    {
        printk("No connection or SD Storage notifications not enabled\n");
    }
}

static struct bt_gatt_service sd_storage_notify_service = BT_GATT_SERVICE(sd_storage_notify_service_attr);































//
// DFU Service Handlers
//

static void dfu_ccc_config_changed_handler(const struct bt_gatt_attr *attr, uint16_t value)
{
    if (value == BT_GATT_CCC_NOTIFY)
    {
        printk("Client subscribed for notifications\n");
    }
    else if (value == 0)
    {
        printk("Client unsubscribed from notifications\n");
    }
    else
    {
        printk("Invalid CCC value: %u\n", value);
    }
}

static ssize_t dfu_control_point_write_handler(struct bt_conn *conn, const struct bt_gatt_attr *attr, const void *buf, uint16_t len, uint16_t offset, uint8_t flags)
{
    printk("dfu_control_point_write_handler\n");
    if (len == 1 && ((uint8_t *)buf)[0] == 0x06)
    {
        NRF_POWER->GPREGRET = 0xA8;
        NVIC_SystemReset();
    }
    else if (len == 2 && ((uint8_t *)buf)[0] == 0x01)
    {
        uint8_t notification_value = 0x10;
        bt_gatt_notify(conn, attr, &notification_value, sizeof(notification_value));

        NRF_POWER->GPREGRET = 0xA8;
        NVIC_SystemReset();
    }
    return len;
}

//
// Battery Service Handlers
//

struct k_work battery_work;

void broadcast_battery_level(struct k_work *work_item) {
    uint16_t battery_millivolt;
    uint8_t battery_percentage;

    if (battery_get_millivolt(&battery_millivolt) == 0 &&
        battery_get_percentage(&battery_percentage, battery_millivolt) == 0) {

        printk("Battery at %d mV (capacity %d%%)\n", battery_millivolt, battery_percentage);

        // Use the Zephyr BAS function to set (and notify) the battery level
        int err = bt_bas_set_battery_level(battery_percentage);
        if (err) {
            printk("Error updating battery level: %d\n", err);
        }
    } else {
        printk("Failed to read battery level\n");
    }
}

//
// Connection Callbacks
//

static void _transport_connected(struct bt_conn *conn, uint8_t err)
{
    struct bt_conn_info info = {0};

    err = bt_conn_get_info(conn, &info);
    if (err)
    {
        printk("Failed to get connection info (err %d)\n", err);
        return;
    }

    current_connection = bt_conn_ref(conn);
    current_mtu = info.le.data_len->tx_max_len;
    printk("Connected\n");
    printk("Interval: %d, latency: %d, timeout: %d\n", info.le.interval, info.le.latency, info.le.timeout);
    printk("TX PHY %s, RX PHY %s\n", phy2str(info.le.phy->tx_phy), phy2str(info.le.phy->rx_phy));
    printk("LE data len updated: TX (len: %d time: %d) RX (len: %d time: %d)\n", info.le.data_len->tx_max_len, info.le.data_len->tx_max_time, info.le.data_len->rx_max_len, info.le.data_len->rx_max_time);

    k_work_submit(&battery_work);
}

static void _transport_disconnected(struct bt_conn *conn, uint8_t err)
{
    printk("Disconnected\n");
    bt_conn_unref(conn);
    current_connection = NULL;
    current_mtu = 0;
}

static bool _le_param_req(struct bt_conn *conn, struct bt_le_conn_param *param)
{
    printk("Connection parameters update request received.\n");
    printk("Minimum interval: %d, Maximum interval: %d\n",
           param->interval_min, param->interval_max);
    printk("Latency: %d, Timeout: %d\n", param->latency, param->timeout);

    return true;
}

static void _le_param_updated(struct bt_conn *conn, uint16_t interval,
                              uint16_t latency, uint16_t timeout)
{
    printk("Connection parameters updated.\n"
           " interval: %d, latency: %d, timeout: %d\n",
           interval, latency, timeout);
}

static void _le_phy_updated(struct bt_conn *conn,
                            struct bt_conn_le_phy_info *param)
{
    printk("LE PHY updated: TX PHY %s, RX PHY %s\n",
           phy2str(param->tx_phy), phy2str(param->rx_phy));
}

static void _le_data_length_updated(struct bt_conn *conn,
                                    struct bt_conn_le_data_len_info *info)
{
    printk("LE data len updated: TX (len: %d time: %d)"
           " RX (len: %d time: %d)\n",
           info->tx_max_len,
           info->tx_max_time, info->rx_max_len, info->rx_max_time);
    current_mtu = info->tx_max_len;
}

static struct bt_conn_cb _callback_references = {
    .connected = _transport_connected,
    .disconnected = _transport_disconnected,
    .le_param_req = _le_param_req,
    .le_param_updated = _le_param_updated,
    .le_phy_updated = _le_phy_updated,
    .le_data_len_updated = _le_data_length_updated,
};

//
// Ring Buffer
//

#define NET_BUFFER_HEADER_SIZE 3
#define RING_BUFFER_HEADER_SIZE 2
static uint8_t tx_queue[NETWORK_RING_BUF_SIZE * (CODEC_OUTPUT_MAX_BYTES + RING_BUFFER_HEADER_SIZE)];
static uint8_t tx_buffer[CODEC_OUTPUT_MAX_BYTES + RING_BUFFER_HEADER_SIZE];
static uint8_t tx_buffer_2[CODEC_OUTPUT_MAX_BYTES + RING_BUFFER_HEADER_SIZE];
static uint32_t tx_buffer_size = 0;
static struct ring_buf ring_buf;

static bool write_to_tx_queue(uint8_t *data, size_t size)
{
    if (size > CODEC_OUTPUT_MAX_BYTES)
    {
        return false;
    }

    // Copy data (TODO: Avoid this copy)
    tx_buffer_2[0] = size & 0xFF;
    tx_buffer_2[1] = (size >> 8) & 0xFF;
    memcpy(tx_buffer_2 + RING_BUFFER_HEADER_SIZE, data, size);

    // Write to ring buffer
    int written = ring_buf_put(&ring_buf, tx_buffer_2, (CODEC_OUTPUT_MAX_BYTES + RING_BUFFER_HEADER_SIZE)); // It always fits completely or not at all
    if (written != CODEC_OUTPUT_MAX_BYTES + RING_BUFFER_HEADER_SIZE)
    {
        return false;
    }
    else
    {
        return true;
    }
}

static bool read_from_tx_queue()
{

    // Read from ring buffer
    // memset(tx_buffer, 0, sizeof(tx_buffer));
    tx_buffer_size = ring_buf_get(&ring_buf, tx_buffer, (CODEC_OUTPUT_MAX_BYTES + RING_BUFFER_HEADER_SIZE)); // It always fits completely or not at all
    if (tx_buffer_size != (CODEC_OUTPUT_MAX_BYTES + RING_BUFFER_HEADER_SIZE))
    {
        printk("Failed to read from ring buffer %d\n", tx_buffer_size);
        return false;
    }

    // Adjust size
    tx_buffer_size = tx_buffer[0] + (tx_buffer[1] << 8);

    return true;
}

//
// Pusher
//

// Thread
K_THREAD_STACK_DEFINE(pusher_stack, 1024);
static struct k_thread pusher_thread;
static uint16_t packet_next_index = 0;
static uint8_t pusher_temp_data[CODEC_OUTPUT_MAX_BYTES + NET_BUFFER_HEADER_SIZE];

static bool push_to_gatt(struct bt_conn *conn)
{
    // Read data from ring buffer
    if (!read_from_tx_queue())
    {
        return false;
    }

    //sd_storage_notify_send(false); // SD STORAGE NOTIFY

    // Push each frame
    uint8_t *buffer = tx_buffer + RING_BUFFER_HEADER_SIZE;
    uint32_t offset = 0;
    uint8_t index = 0;
    while (offset < tx_buffer_size)
    {
        // Recombine packet
        uint32_t id = packet_next_index++;
        uint32_t packet_size = MIN(current_mtu - NET_BUFFER_HEADER_SIZE, tx_buffer_size - offset);
        pusher_temp_data[0] = id & 0xFF;
        pusher_temp_data[1] = (id >> 8) & 0xFF;
        pusher_temp_data[2] = index;
        memcpy(pusher_temp_data + NET_BUFFER_HEADER_SIZE, buffer + offset, packet_size);
        offset += packet_size;
        index++;

        while (true)
        {
            // Try send notification
            int err = bt_gatt_notify(conn, &audio_service.attrs[1], pusher_temp_data, packet_size + NET_BUFFER_HEADER_SIZE);
            
            // Log failure
            if (err)
            {
                printk("bt_gatt_notify failed (err %d)\n", err);
                printk("MTU: %d, packet_size: %d\n", current_mtu, packet_size + NET_BUFFER_HEADER_SIZE);
                k_sleep(K_MSEC(1));
            }

            //int res = save_audio_in_storage(pusher_temp_data[2], packet_size + NET_BUFFER_HEADER_SIZE);

            //printk("Data sended %d", pusher_temp_data[0]);

            // Try to send more data if possible
            if (err == -EAGAIN || err == -ENOMEM)
            {
                continue;
            }

            // Break if success
            break;
        }
    }

    return true;
}

void pusher(void)
{
    while (1)
    {

        //
        // Load current connection
        //

        struct bt_conn *conn = current_connection;
        bool use_gatt = true;
        if (conn)
        {
            conn = bt_conn_ref(conn);
        }
        bool valid = true;
        if (current_mtu < MINIMAL_PACKET_SIZE)
        {
            valid = false;
        }
        else if (!conn)
        {
            valid = false;
        }
        else
        {
            valid = bt_gatt_is_subscribed(conn, &audio_service.attrs[1], BT_GATT_CCC_NOTIFY); // Check if subscribed
        }

        // If no valid mode exists - discard whole buffer
        if (!valid)
        {
            ring_buf_reset(&ring_buf);
            k_sleep(K_MSEC(10));
        }

        // Handle GATT
        if (use_gatt && valid)
        {
            bool sent = push_to_gatt(conn);
            if (!sent)
            {
                k_sleep(K_MSEC(50));
            }
        }

        if (conn)
        {
            bt_conn_unref(conn);
        }
    }
}

//
// Public functions
//

int transport_start()
{
    // Configure callbacks
    bt_conn_cb_register(&_callback_references);

    // Enable Bluetooth
    int err = bt_enable(NULL);
    if (err)
    {
        printk("Bluetooth init failed (err %d)\n", err);
        return err;
    }
    printk("Bluetooth initialized\n");

    // Start advertising
    bt_gatt_service_register(&audio_service);
    bt_gatt_service_register(&dfu_service);
    bt_gatt_service_register(&sd_storage_notify_service);  // Registra el nuevo servicio
    err = bt_le_adv_start(BT_LE_ADV_CONN, bt_ad, ARRAY_SIZE(bt_ad), bt_sd, ARRAY_SIZE(bt_sd));
    if (err)
    {
        printk("Advertising failed to start (err %d)\n", err);
        return err;
    }
    else
    {
        printk("Advertising successfully started\n");
    }

    int battErr = 0;

	battErr |= battery_init();
	battErr |= battery_charge_start();

	if (battErr)
	{
		 printk("Battery init failed (err %d)\n", battErr);
	}
	else
	{
		  printk("Battery initialized\n");
	}

    k_work_init(&battery_work, broadcast_battery_level);

    // Start pusher
    ring_buf_init(&ring_buf, sizeof(tx_queue), tx_queue);
    k_thread_create(&pusher_thread, pusher_stack, K_THREAD_STACK_SIZEOF(pusher_stack), (k_thread_entry_t)pusher, NULL, NULL, NULL, K_PRIO_PREEMPT(7), 0, K_NO_WAIT);

    return 0;
}

struct bt_conn *get_current_connection()
{
    return current_connection;
}

int broadcast_audio_packets(uint8_t *buffer, size_t size)
{
    if(current_connection == NULL)
    {
        int ret = save_audio_in_storage(buffer, size);
    } else
    {
        uint8_t *current_buffer = buffer;
        size_t current_size = size;

        while (!write_to_tx_queue(current_buffer, current_size))
        {
            k_sleep(K_MSEC(1));
        }
    }
    
    return 0;
}
```
