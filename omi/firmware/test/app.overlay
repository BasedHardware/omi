//&uart0 {
// 	current-speed = <115200>;
//};
// Override lsm6dso to use lsm6dsl driver (LSM6DS3TR-C has WHO_AM_I = 0x6A)
// Need to delete accel-pm and gyro-pm properties which are LSM6DSO-specific
&lsm6dso {
	compatible = "st,lsm6dsl";
	/delete-property/ accel-pm;
	/delete-property/ gyro-pm;
	status = "okay";
};