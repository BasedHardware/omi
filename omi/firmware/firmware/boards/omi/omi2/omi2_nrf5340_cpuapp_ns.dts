/dts-v1/;
#include <nordic/nrf5340_cpuappns_qkaa.dtsi>
#include "omi2-pinctrl.dtsi"

/ {
	model = "Custom Board auto generated by nRF Connect for VS Code (CPUAPP Non-Secure)";
	compatible = "omi2,omi2-cpuapp-ns";

	chosen {
		zephyr,sram = &sram0_ns;
		zephyr,flash = &flash0;
		zephyr,code-partition = &slot0_ns_partition;
		zephyr,bt-hci = &bt_hci_ipc0;
		nordic,802154-spinel-ipc = &ipc0;
	};
};

#include "omi2-cpuapp_partitioning.dtsi"
#include "omi2-shared_sram.dtsi"
