/dts-v1/;
#include <nordic/nrf5340_cpuappns_qkaa.dtsi>
#include "omi_nrf5340-pinctrl.dtsi"

/ {
	model = "Custom Board auto generated by nRF Connect for VS Code (CPUAPP Non-Secure)";
	compatible = "omi_nrf5340,omi-nrf5340-cpuapp-ns";

	chosen {
		zephyr,sram = &sram0_ns;
		zephyr,flash = &flash0;
		zephyr,code-partition = &slot0_ns_partition;
		zephyr,bt-hci = &bt_hci_ipc0;
		nordic,802154-spinel-ipc = &ipc0;
	};
};

#include "omi_nrf5340-cpuapp_partitioning.dtsi"
#include "omi_nrf5340-shared_sram.dtsi"
