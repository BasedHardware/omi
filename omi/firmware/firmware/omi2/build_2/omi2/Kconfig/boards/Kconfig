## omi/firmware/firmware/omi2/build_2/omi2/Kconfig/boards/Kconfig
```kconfig
# Load Zephyr board Kconfig descriptions.
osource "/Users/nik/projects/omi/omi/firmware/firmware/boards/omi/omi2/Kconfig"
```

## omi/firmware/firmware/omi2/build_2/omi2/Kconfig/soc/Kconfig
```kconfig
# Load Zephyr SoC Kconfig descriptions.
osource "/opt/nordic/ncs/v2.9.0/zephyr/soc/xlnx/zynqmp/Kconfig"
osource "/opt/nordic/ncs/v2.9.0/zephyr/soc/xlnx/zynq7000/Kconfig"
osource "/opt/nordic/ncs/v2.9.0/zephyr/soc/xen/Kconfig"
osource "/opt/nordic/ncs/v2.9.0/zephyr/soc/ti/simplelink/Kconfig"
osource "/opt/nordic/ncs/v2.9.0/zephyr/soc/ti/lm3s6965/Kconfig"
osource "/opt/nordic/ncs/v2.9.0/zephyr/soc/ti/k3/Kconfig"
osource "/opt/nordic/ncs/v2.9.0/zephyr/soc/telink/tlsr/Kconfig"
osource "/opt/nordic/ncs/v2.9.0/zephyr/soc/starfive/jh71xx/Kconfig"
osource "/opt/nordic/ncs/v2.9.0/zephyr/soc/st/stm32/Kconfig"
osource "/opt/nordic/ncs/v2.9.0/zephyr/soc/snps/qemu_arc/Kconfig"
osource "/opt/nordic/ncs/v2.9.0/zephyr/soc/snps/nsim/arc_v/Kconfig"
osource "/opt/nordic/ncs/v2.9.0/zephyr/soc/snps/nsim/arc_classic/Kconfig"
osource "/opt/nordic/ncs/v2.9.0/zephyr/soc/snps/hsdk4xd/Kconfig"
osource "/opt/nordic/ncs/v2.9.0/zephyr/soc/snps/hsdk/Kconfig"
osource "/opt/nordic/ncs/v2.9.0/zephyr/soc/snps/emsk/Kconfig"
osource "/opt/nordic/ncs/v2.9.0/zephyr/soc/snps/emsdp/Kconfig"
osource "/opt/nordic/ncs/v2.9.0/zephyr/soc/snps/arc_iot/Kconfig"
osource "/opt/nordic/ncs/v2.9.0/zephyr/soc/silabs/Kconfig"
osource "/opt/nordic/ncs/v2.9.0/zephyr/soc/sifive/sifive_freedom/Kconfig"
osource "/opt/nordic/ncs/v2.9.0/zephyr/soc/sensry/Kconfig"
osource "/opt/nordic/ncs/v2.9.0/zephyr/soc/rockchip/Kconfig"
osource "/opt/nordic/ncs/v2.9.0/zephyr/soc/renode/riscv_virtual/Kconfig"
osource "/opt/nordic/ncs/v2.9.0/zephyr/soc/renode/cortex_r8_virtual/Kconfig"
osource "/opt/nordic/ncs/v2.9.0/zephyr/soc/renesas/smartbond/Kconfig"
osource "/opt/nordic/ncs/v2.9.0/zephyr/soc/renesas/rzt2m/Kconfig"
osource "/opt/nordic/ncs/v2.9.0/zephyr/soc/renesas/rcar/Kconfig"
osource "/opt/nordic/ncs/v2.9.0/zephyr/soc/renesas/ra/Kconfig"
osource "/opt/nordic/ncs/v2.9.0/zephyr/soc/raspberrypi/Kconfig"
osource "/opt/nordic/ncs/v2.9.0/zephyr/soc/quicklogic/eos_s3/Kconfig"
osource "/opt/nordic/ncs/v2.9.0/zephyr/soc/qemu/virt_riscv/Kconfig"
osource "/opt/nordic/ncs/v2.9.0/zephyr/soc/qemu/malta/Kconfig"
osource "/opt/nordic/ncs/v2.9.0/zephyr/soc/openisa/rv32m1/Kconfig"
osource "/opt/nordic/ncs/v2.9.0/zephyr/soc/nxp/s32/Kconfig"
osource "/opt/nordic/ncs/v2.9.0/zephyr/soc/nxp/rw/Kconfig"
osource "/opt/nordic/ncs/v2.9.0/zephyr/soc/nxp/mcx/Kconfig"
osource "/opt/nordic/ncs/v2.9.0/zephyr/soc/nxp/lpc/Kconfig"
osource "/opt/nordic/ncs/v2.9.0/zephyr/soc/nxp/layerscape/Kconfig"
osource "/opt/nordic/ncs/v2.9.0/zephyr/soc/nxp/kinetis/Kconfig"
osource "/opt/nordic/ncs/v2.9.0/zephyr/soc/nxp/imxrt/Kconfig"
osource "/opt/nordic/ncs/v2.9.0/zephyr/soc/nxp/imx/Kconfig"
osource "/opt/nordic/ncs/v2.9.0/zephyr/soc/nuvoton/numicro/Kconfig"
osource "/opt/nordic/ncs/v2.9.0/zephyr/soc/nuvoton/numaker/Kconfig"
osource "/opt/nordic/ncs/v2.9.0/zephyr/soc/nuvoton/npcx/Kconfig"
osource "/opt/nordic/ncs/v2.9.0/zephyr/soc/nuvoton/npcm/Kconfig"
osource "/opt/nordic/ncs/v2.9.0/zephyr/soc/nordic/Kconfig"
osource "/opt/nordic/ncs/v2.9.0/zephyr/soc/neorv32/Kconfig"
osource "/opt/nordic/ncs/v2.9.0/zephyr/soc/native/inf_clock/Kconfig"
osource "/opt/nordic/ncs/v2.9.0/zephyr/soc/microchip/miv/Kconfig"
osource "/opt/nordic/ncs/v2.9.0/zephyr/soc/microchip/mec/Kconfig"
osource "/opt/nordic/ncs/v2.9.0/zephyr/soc/mediatek/mtk_adsp/Kconfig"
osource "/opt/nordic/ncs/v2.9.0/zephyr/soc/lowrisc/opentitan/Kconfig"
osource "/opt/nordic/ncs/v2.9.0/zephyr/soc/litex/litex_vexriscv/Kconfig"
osource "/opt/nordic/ncs/v2.9.0/zephyr/soc/ite/ec/Kconfig"
osource "/opt/nordic/ncs/v2.9.0/zephyr/soc/intel/raptor_lake/Kconfig"
osource "/opt/nordic/ncs/v2.9.0/zephyr/soc/intel/lakemont/Kconfig"
osource "/opt/nordic/ncs/v2.9.0/zephyr/soc/intel/intel_socfpga_std/Kconfig"
osource "/opt/nordic/ncs/v2.9.0/zephyr/soc/intel/intel_socfpga/Kconfig"
osource "/opt/nordic/ncs/v2.9.0/zephyr/soc/intel/intel_niosv/Kconfig"
osource "/opt/nordic/ncs/v2.9.0/zephyr/soc/intel/intel_ish/Kconfig"
osource "/opt/nordic/ncs/v2.9.0/zephyr/soc/intel/intel_adsp/Kconfig"
osource "/opt/nordic/ncs/v2.9.0/zephyr/soc/intel/elkhart_lake/Kconfig"
osource "/opt/nordic/ncs/v2.9.0/zephyr/soc/intel/atom/Kconfig"
osource "/opt/nordic/ncs/v2.9.0/zephyr/soc/intel/apollo_lake/Kconfig"
osource "/opt/nordic/ncs/v2.9.0/zephyr/soc/intel/alder_lake/Kconfig"
osource "/opt/nordic/ncs/v2.9.0/zephyr/soc/infineon/cat3/Kconfig"
osource "/opt/nordic/ncs/v2.9.0/zephyr/soc/infineon/cat1b/Kconfig"
osource "/opt/nordic/ncs/v2.9.0/zephyr/soc/infineon/cat1a/Kconfig"
osource "/opt/nordic/ncs/v2.9.0/zephyr/soc/gd/gd32/Kconfig"
osource "/opt/nordic/ncs/v2.9.0/zephyr/soc/gaisler/leon3/Kconfig"
osource "/opt/nordic/ncs/v2.9.0/zephyr/soc/gaisler/gr716a/Kconfig"
osource "/opt/nordic/ncs/v2.9.0/zephyr/soc/espressif/Kconfig"
osource "/opt/nordic/ncs/v2.9.0/zephyr/soc/ene/kb1200/Kconfig"
osource "/opt/nordic/ncs/v2.9.0/zephyr/soc/efinix/sapphire/Kconfig"
osource "/opt/nordic/ncs/v2.9.0/zephyr/soc/cdns/xtensa_sample_controller/Kconfig"
osource "/opt/nordic/ncs/v2.9.0/zephyr/soc/cdns/dc233c/Kconfig"
osource "/opt/nordic/ncs/v2.9.0/zephyr/soc/brcm/bcmvk/Kconfig"
osource "/opt/nordic/ncs/v2.9.0/zephyr/soc/brcm/bcm2712/Kconfig"
osource "/opt/nordic/ncs/v2.9.0/zephyr/soc/brcm/bcm2711/Kconfig"
osource "/opt/nordic/ncs/v2.9.0/zephyr/soc/atmel/sam0/Kconfig"
osource "/opt/nordic/ncs/v2.9.0/zephyr/soc/atmel/sam/Kconfig"
osource "/opt/nordic/ncs/v2.9.0/zephyr/soc/aspeed/Kconfig"
osource "/opt/nordic/ncs/v2.9.0/zephyr/soc/arm/Kconfig"
osource "/opt/nordic/ncs/v2.9.0/zephyr/soc/arm/beetle/Kconfig"
osource "/opt/nordic/ncs/v2.9.0/zephyr/soc/andestech/Kconfig"
osource "/opt/nordic/ncs/v2.9.0/zephyr/soc/ambiq/Kconfig"
osource "/opt/nordic/ncs/v2.9.0/zephyr/soc/altr/zephyr_nios2f/Kconfig"
osource "/opt/nordic/ncs/v2.9.0/zephyr/soc/altr/qemu_nios2/Kconfig"
osource "/opt/nordic/ncs/v2.9.0/zephyr/soc/adi/max32/Kconfig"
```

## omi/firmware/firmware/omi2/build_3/ipc_radio/Kconfig/Kconfig.sysbuild.modules
```kconfig
menu "nrf (/opt/nordic/ncs/v2.9.0/nrf)"
osource "/opt/nordic/ncs/v2.9.0/nrf/sysbuild/Kconfig.sysbuild"
config ZEPHYR_NRF_MODULE
	bool
	default y
endmenu
config ZEPHYR_MCUBOOT_MODULE
   bool
   default y
config ZEPHYR_MBEDTLS_MODULE
   bool
   default y
config ZEPHYR_OBERON_PSA_CRYPTO_MODULE
   bool
   default y
config ZEPHYR_TRUSTED_FIRMWARE_M_MODULE
   bool
   default y
config ZEPHYR_PSA_ARCH_TESTS_MODULE
   bool
   default y
config ZEPHYR_SOC_HWMV1_MODULE
   bool
   default y
config ZEPHYR_CJSON_MODULE
   bool
   default y
config ZEPHYR_AZURE_SDK_FOR_C_MODULE
   bool
   default y
config ZEPHYR_CIRRUS_LOGIC_MODULE
   bool
   default y
config ZEPHYR_OPENTHREAD_MODULE
   bool
   default y
config ZEPHYR_SUIT_GENERATOR_MODULE
   bool
   default y
config ZEPHYR_SUIT_PROCESSOR_MODULE
   bool
   default y
config ZEPHYR_MEMFAULT_FIRMWARE_SDK_MODULE
   bool
   default y
config ZEPHYR_COREMARK_MODULE
   bool
   default y
config ZEPHYR_CANOPENNODE_MODULE
   bool
   default y
config ZEPHYR_CHRE_MODULE
   bool
   default y
config ZEPHYR_LZ4_MODULE
   bool
   default y
config ZEPHYR_NANOPB_MODULE
   bool
   default y
config ZEPHYR_TF_M_TESTS_MODULE
   bool
   default y
config ZEPHYR_ZSCILIB_MODULE
   bool
   default y
config ZEPHYR_CMSIS_MODULE
   bool
   default y
config ZEPHYR_CMSIS_DSP_MODULE
   bool
   default y
config ZEPHYR_CMSIS_NN_MODULE
   bool
   default y
config ZEPHYR_FATFS_MODULE
   bool
   default y
config ZEPHYR_HAL_NORDIC_MODULE
   bool
   default y
config ZEPHYR_HAL_ST_MODULE
   bool
   default y
config ZEPHYR_HAL_WURTHELEKTRONIK_MODULE
   bool
   default y
config ZEPHYR_HOSTAP_MODULE
   bool
   default y
config ZEPHYR_LIBMETAL_MODULE
   bool
   default y
config ZEPHYR_LIBLC3_MODULE
   bool
   default y
config ZEPHYR_LITTLEFS_MODULE
   bool
   default y
config ZEPHYR_LORAMAC_NODE_MODULE
   bool
   default y
config ZEPHYR_LVGL_MODULE
   bool
   default y
config ZEPHYR_MIPI_SYS_T_MODULE
   bool
   default y
config ZEPHYR_NRF_WIFI_MODULE
   bool
   default y
config ZEPHYR_OPEN_AMP_MODULE
   bool
   default y
config ZEPHYR_PICOLIBC_MODULE
   bool
   default y
config ZEPHYR_SEGGER_MODULE
   bool
   default y
config ZEPHYR_TINYCRYPT_MODULE
   bool
   default y
config ZEPHYR_UOSCORE_UEDHOC_MODULE
   bool
   default y
config ZEPHYR_ZCBOR_MODULE
   bool
   default y
config ZEPHYR_NRFXLIB_MODULE
   bool
   default y
config ZEPHYR_NRF_HW_MODELS_MODULE
   bool
   default y
config ZEPHYR_CONNECTEDHOMEIP_MODULE
   bool
   default y
```

## omi/firmware/firmware/omi2/build_3/ipc_radio/Kconfig/soc/Kconfig.sysbuild
```kconfig
# Load Sysbuild SoC Kconfig descriptions.
osource "/opt/nordic/ncs/v2.9.0/zephyr/soc/xlnx/zynqmp/Kconfig.sysbuild"
osource "/opt/nordic/ncs/v2.9.0/zephyr/soc/xlnx/zynq7000/Kconfig.sysbuild"
osource "/opt/nordic/ncs/v2.9.0/zephyr/soc/xen/Kconfig.sysbuild"
osource "/opt/nordic/ncs/v2.9.0/zephyr/soc/ti/simplelink/Kconfig.sysbuild"
osource "/opt/nordic/ncs/v2.9.0/zephyr/soc/ti/lm3s6965/Kconfig.sysbuild"
osource "/opt/nordic/ncs/v2.9.0/zephyr/soc/ti/k3/Kconfig.sysbuild"
osource "/opt/nordic/ncs/v2.9.0/zephyr/soc/telink/tlsr/Kconfig.sysbuild"
osource "/opt/nordic/ncs/v2.9.0/zephyr/soc/starfive/jh71xx/Kconfig.sysbuild"
osource "/opt/nordic/ncs/v2.9.0/zephyr/soc/st/stm32/Kconfig.sysbuild"
osource "/opt/nordic/ncs/v2.9.0/zephyr/soc/snps/qemu_arc/Kconfig.sysbuild"
osource "/opt/nordic/ncs/v2.9.0/zephyr/soc/snps/nsim/arc_v/Kconfig.sysbuild"
osource "/opt/nordic/ncs/v2.9.0/zephyr/soc/snps/nsim/arc_classic/Kconfig.sysbuild"
osource "/opt/nordic/ncs/v2.9.0/zephyr/soc/snps/hsdk4xd/Kconfig.sysbuild"
osource "/opt/nordic/ncs/v2.9.0/zephyr/soc/snps/hsdk/Kconfig.sysbuild"
osource "/opt/nordic/ncs/v2.9.0/zephyr/soc/snps/emsk/Kconfig.sysbuild"
osource "/opt/nordic/ncs/v2.9.0/zephyr/soc/snps/emsdp/Kconfig.sysbuild"
osource "/opt/nordic/ncs/v2.9.0/zephyr/soc/snps/arc_iot/Kconfig.sysbuild"
osource "/opt/nordic/ncs/v2.9.0/zephyr/soc/silabs/Kconfig.sysbuild"
osource "/opt/nordic/ncs/v2.9.0/zephyr/soc/sifive/sifive_freedom/Kconfig.sysbuild"
osource "/opt/nordic/ncs/v2.9.0/zephyr/soc/sensry/Kconfig.sysbuild"
osource "/opt/nordic/ncs/v2.9.0/zephyr/soc/rockchip/Kconfig.sysbuild"
osource "/opt/nordic/ncs/v2.9.0/zephyr/soc/renode/riscv_virtual/Kconfig.sysbuild"
osource "/opt/nordic/ncs/v2.9.0/zephyr/soc/renode/cortex_r8_virtual/Kconfig.sysbuild"
osource "/opt/nordic/ncs/v2.9.0/zephyr/soc/renesas/smartbond/Kconfig.sysbuild"
osource "/opt/nordic/ncs/v2.9.0/zephyr/soc/renesas/rzt2m/Kconfig.sysbuild"
osource "/opt/nordic/ncs/v2.9.0/zephyr/soc/renesas/rcar/Kconfig.sysbuild"
osource "/opt/nordic/ncs/v2.9.0/zephyr/soc/renesas/ra/Kconfig.sysbuild"
osource "/opt/nordic/ncs/v2.9.0/zephyr/soc/raspberrypi/Kconfig.sysbuild"
osource "/opt/nordic/ncs/v2.9.0/zephyr/soc/quicklogic/eos_s3/Kconfig.sysbuild"
osource "/opt/nordic/ncs/v2.9.0/zephyr/soc/qemu/virt_riscv/Kconfig.sysbuild"
osource "/opt/nordic/ncs/v2.9.0/zephyr/soc/qemu/malta/Kconfig.sysbuild"
osource "/opt/nordic/ncs/v2.9.0/zephyr/soc/openisa/rv32m1/Kconfig.sysbuild"
osource "/opt/nordic/ncs/v2.9.0/zephyr/soc/nxp/s32/Kconfig.sysbuild"
osource "/opt/nordic/ncs/v2.9.0/zephyr/soc/nxp/rw/Kconfig.sysbuild"
osource "/opt/nordic/ncs/v2.9.0/zephyr/soc/nxp/mcx/Kconfig.sysbuild"
osource "/opt/nordic/ncs/v2.9.0/zephyr/soc/nxp/lpc/Kconfig.sysbuild"
osource "/opt/nordic/ncs/v2.9.0/zephyr/soc/nxp/layerscape/Kconfig.sysbuild"
osource "/opt/nordic/ncs/v2.9.0/zephyr/soc/nxp/kinetis/Kconfig.sysbuild"
osource "/opt/nordic/ncs/v2.9.0/zephyr/soc/nxp/imxrt/Kconfig.sysbuild"
osource "/opt/nordic/ncs/v2.9.0/zephyr/soc/nxp/imx/Kconfig.sysbuild"
osource "/opt/nordic/ncs/v2.9.0/zephyr/soc/nuvoton/numicro/Kconfig.sysbuild"
osource "/opt/nordic/ncs/v2.9.0/zephyr/soc/nuvoton/numaker/Kconfig.sysbuild"
osource "/opt/nordic/ncs/v2.9.0/zephyr/soc/nuvoton/npcx/Kconfig.sysbuild"
osource "/opt/nordic/ncs/v2.9.0/zephyr/soc/nuvoton/npcm/Kconfig.sysbuild"
osource "/opt/nordic/ncs/v2.9.0/zephyr/soc/nordic/Kconfig.sysbuild"
osource "/opt/nordic/ncs/v2.9.0/zephyr/soc/neorv32/Kconfig.sysbuild"
osource "/opt/nordic/ncs/v2.9.0/zephyr/soc/native/inf_clock/Kconfig.sysbuild"
osource "/opt/nordic/ncs/v2.9.0/zephyr/soc/microchip/miv/Kconfig.sysbuild"
osource "/opt/nordic/ncs/v2.9.0/zephyr/soc/microchip/mec/Kconfig.sysbuild"
osource "/opt/nordic/ncs/v2.9.0/zephyr/soc/mediatek/mtk_adsp/Kconfig.sysbuild"
osource "/opt/nordic/ncs/v2.9.0/zephyr/soc/lowrisc/opentitan/Kconfig.sysbuild"
osource "/opt/nordic/ncs/v2.9.0/zephyr/soc/litex/litex_vexriscv/Kconfig.sysbuild"
osource "/opt/nordic/ncs/v2.9.0/zephyr/soc/ite/ec/Kconfig.sysbuild"
osource "/opt/nordic/ncs/v2.9.0/zephyr/soc/intel/raptor_lake/Kconfig.sysbuild"
osource "/opt/nordic/ncs/v2.9.0/zephyr/soc/intel/lakemont/Kconfig.sysbuild"
osource "/opt/nordic/ncs/v2.9.0/zephyr/soc/intel/intel_socfpga_std/Kconfig.sysbuild"
osource "/opt/nordic/ncs/v2.9.0/zephyr/soc/intel/intel_socfpga/Kconfig.sysbuild"
osource "/opt/nordic/ncs/v2.9.0/zephyr/soc/intel/intel_niosv/Kconfig.sysbuild"
osource "/opt/nordic/ncs/v2.9.0/zephyr/soc/intel/intel_ish/Kconfig.sysbuild"
osource "/opt/nordic/ncs/v2.9.0/zephyr/soc/intel/intel_adsp/Kconfig.sysbuild"
osource "/opt/nordic/ncs/v2.9.0/zephyr/soc/intel/elkhart_lake/Kconfig.sysbuild"
osource "/opt/nordic/ncs/v2.9.0/zephyr/soc/intel/atom/Kconfig.sysbuild"
osource "/opt/nordic/ncs/v2.9.0/zephyr/soc/intel/apollo_lake/Kconfig.sysbuild"
osource "/opt/nordic/ncs/v2.9.0/zephyr/soc/intel/alder_lake/Kconfig.sysbuild"
osource "/opt/nordic/ncs/v2.9.0/zephyr/soc/infineon/cat3/Kconfig.sysbuild"
osource "/opt/nordic/ncs/v2.9.0/zephyr/soc/infineon/cat1b/Kconfig.sysbuild"
osource "/opt/nordic/ncs/v2.9.0/zephyr/soc/infineon/cat1a/Kconfig.sysbuild"
osource "/opt/nordic/ncs/v2.9.0/zephyr/soc/gd/gd32/Kconfig.sysbuild"
osource "/opt/nordic/ncs/v2.9.0/zephyr/soc/gaisler/leon3/Kconfig.sysbuild"
osource "/opt/nordic/ncs/v2.9.0/zephyr/soc/gaisler/gr716a/Kconfig.sysbuild"
osource "/opt/nordic/ncs/v2.9.0/zephyr/soc/espressif/Kconfig.sysbuild"
osource "/opt/nordic/ncs/v2.9.0/zephyr/soc/ene/kb1200/Kconfig.sysbuild"
osource "/opt/nordic/ncs/v2.9.0/zephyr/soc/efinix/sapphire/Kconfig.sysbuild"
osource "/opt/nordic/ncs/v2.9.0/zephyr/soc/cdns/xtensa_sample_controller/Kconfig.sysbuild"
osource "/opt/nordic/ncs/v2.9.0/zephyr/soc/cdns/dc233c/Kconfig.sysbuild"
osource "/opt/nordic/ncs/v2.9.0/zephyr/soc/brcm/bcmvk/Kconfig.sysbuild"
osource "/opt/nordic/ncs/v2.9.0/zephyr/soc/brcm/bcm2712/Kconfig.sysbuild"
osource "/opt/nordic/ncs/v2.9.0/zephyr/soc/brcm/bcm2711/Kconfig.sysbuild"
osource "/opt/nordic/ncs/v2.9.0/zephyr/soc/atmel/sam0/Kconfig.sysbuild"
osource "/opt/nordic/ncs/v2.9.0/zephyr/soc/atmel/sam/Kconfig.sysbuild"
osource "/opt/nordic/ncs/v2.9.0/zephyr/soc/aspeed/Kconfig.sysbuild"
osource "/opt/nordic/ncs/v2.9.0/zephyr/soc/arm/Kconfig.sysbuild"
osource "/opt/nordic/ncs/v2.9.0/zephyr/soc/arm/beetle/Kconfig.sysbuild"
osource "/opt/nordic/ncs/v2.9.0/zephyr/soc/andestech/Kconfig.sysbuild"
osource "/opt/nordic/ncs/v2.9.0/zephyr/soc/ambiq/Kconfig.sysbuild"
osource "/opt/nordic/ncs/v2.9.0/zephyr/soc/altr/zephyr_nios2f/Kconfig.sysbuild"
osource "/opt/nordic/ncs/v2.9.0/zephyr/soc/altr/qemu_nios2/Kconfig.sysbuild"
osource "/opt/nordic/ncs/v2.9.0/zephyr/soc/adi/max32/Kconfig.sysbuild"
```
