## omi/firmware/firmware/omi2/build_3/mcuboot/Kconfig/arch/Kconfig
```kconfig
# Load Zephyr Arch Kconfig descriptions.
osource "/opt/nordic/ncs/v2.9.0/zephyr/arch/x86/Kconfig"
osource "/opt/nordic/ncs/v2.9.0/zephyr/arch/xtensa/Kconfig"
osource "/opt/nordic/ncs/v2.9.0/zephyr/arch/sparc/Kconfig"
osource "/opt/nordic/ncs/v2.9.0/zephyr/arch/riscv/Kconfig"
osource "/opt/nordic/ncs/v2.9.0/zephyr/arch/posix/Kconfig"
osource "/opt/nordic/ncs/v2.9.0/zephyr/arch/nios2/Kconfig"
osource "/opt/nordic/ncs/v2.9.0/zephyr/arch/mips/Kconfig"
osource "/opt/nordic/ncs/v2.9.0/zephyr/arch/arm64/Kconfig"
osource "/opt/nordic/ncs/v2.9.0/zephyr/arch/arm/Kconfig"
osource "/opt/nordic/ncs/v2.9.0/zephyr/arch/arc/Kconfig"
```

## omi/firmware/firmware/omi2/build_3/omi2/Kconfig/soc/Kconfig.soc
```kconfig
# Load SoC Kconfig descriptions.
osource "/opt/nordic/ncs/v2.9.0/zephyr/soc/xlnx/zynqmp/Kconfig.soc"
osource "/opt/nordic/ncs/v2.9.0/zephyr/soc/xlnx/zynq7000/Kconfig.soc"
osource "/opt/nordic/ncs/v2.9.0/zephyr/soc/xen/Kconfig.soc"
osource "/opt/nordic/ncs/v2.9.0/zephyr/soc/ti/simplelink/Kconfig.soc"
osource "/opt/nordic/ncs/v2.9.0/zephyr/soc/ti/lm3s6965/Kconfig.soc"
osource "/opt/nordic/ncs/v2.9.0/zephyr/soc/ti/k3/Kconfig.soc"
osource "/opt/nordic/ncs/v2.9.0/zephyr/soc/telink/tlsr/Kconfig.soc"
osource "/opt/nordic/ncs/v2.9.0/zephyr/soc/starfive/jh71xx/Kconfig.soc"
osource "/opt/nordic/ncs/v2.9.0/zephyr/soc/st/stm32/Kconfig.soc"
osource "/opt/nordic/ncs/v2.9.0/zephyr/soc/snps/qemu_arc/Kconfig.soc"
osource "/opt/nordic/ncs/v2.9.0/zephyr/soc/snps/nsim/arc_v/Kconfig.soc"
osource "/opt/nordic/ncs/v2.9.0/zephyr/soc/snps/nsim/arc_classic/Kconfig.soc"
osource "/opt/nordic/ncs/v2.9.0/zephyr/soc/snps/hsdk4xd/Kconfig.soc"
osource "/opt/nordic/ncs/v2.9.0/zephyr/soc/snps/hsdk/Kconfig.soc"
osource "/opt/nordic/ncs/v2.9.0/zephyr/soc/snps/emsk/Kconfig.soc"
osource "/opt/nordic/ncs/v2.9.0/zephyr/soc/snps/emsdp/Kconfig.soc"
osource "/opt/nordic/ncs/v2.9.0/zephyr/soc/snps/arc_iot/Kconfig.soc"
osource "/opt/nordic/ncs/v2.9.0/zephyr/soc/silabs/Kconfig.soc"
osource "/opt/nordic/ncs/v2.9.0/zephyr/soc/sifive/sifive_freedom/Kconfig.soc"
osource "/opt/nordic/ncs/v2.9.0/zephyr/soc/sensry/Kconfig.soc"
osource "/opt/nordic/ncs/v2.9.0/zephyr/soc/rockchip/Kconfig.soc"
osource "/opt/nordic/ncs/v2.9.0/zephyr/soc/renode/riscv_virtual/Kconfig.soc"
osource "/opt/nordic/ncs/v2.9.0/zephyr/soc/renode/cortex_r8_virtual/Kconfig.soc"
osource "/opt/nordic/ncs/v2.9.0/zephyr/soc/renesas/smartbond/Kconfig.soc"
osource "/opt/nordic/ncs/v2.9.0/zephyr/soc/renesas/rzt2m/Kconfig.soc"
osource "/opt/nordic/ncs/v2.9.0/zephyr/soc/renesas/rcar/Kconfig.soc"
osource "/opt/nordic/ncs/v2.9.0/zephyr/soc/renesas/ra/Kconfig.soc"
osource "/opt/nordic/ncs/v2.9.0/zephyr/soc/raspberrypi/Kconfig.soc"
osource "/opt/nordic/ncs/v2.9.0/zephyr/soc/quicklogic/eos_s3/Kconfig.soc"
osource "/opt/nordic/ncs/v2.9.0/zephyr/soc/qemu/virt_riscv/Kconfig.soc"
osource "/opt/nordic/ncs/v2.9.0/zephyr/soc/qemu/malta/Kconfig.soc"
osource "/opt/nordic/ncs/v2.9.0/zephyr/soc/openisa/rv32m1/Kconfig.soc"
osource "/opt/nordic/ncs/v2.9.0/zephyr/soc/nxp/s32/Kconfig.soc"
osource "/opt/nordic/ncs/v2.9.0/zephyr/soc/nxp/rw/Kconfig.soc"
osource "/opt/nordic/ncs/v2.9.0/zephyr/soc/nxp/mcx/Kconfig.soc"
osource "/opt/nordic/ncs/v2.9.0/zephyr/soc/nxp/lpc/Kconfig.soc"
osource "/opt/nordic/ncs/v2.9.0/zephyr/soc/nxp/layerscape/Kconfig.soc"
osource "/opt/nordic/ncs/v2.9.0/zephyr/soc/nxp/kinetis/Kconfig.soc"
osource "/opt/nordic/ncs/v2.9.0/zephyr/soc/nxp/imxrt/Kconfig.soc"
osource "/opt/nordic/ncs/v2.9.0/zephyr/soc/nxp/imx/Kconfig.soc"
osource "/opt/nordic/ncs/v2.9.0/zephyr/soc/nuvoton/numicro/Kconfig.soc"
osource "/opt/nordic/ncs/v2.9.0/zephyr/soc/nuvoton/numaker/Kconfig.soc"
osource "/opt/nordic/ncs/v2.9.0/zephyr/soc/nuvoton/npcx/Kconfig.soc"
osource "/opt/nordic/ncs/v2.9.0/zephyr/soc/nuvoton/npcm/Kconfig.soc"
osource "/opt/nordic/ncs/v2.9.0/zephyr/soc/nordic/Kconfig.soc"
osource "/opt/nordic/ncs/v2.9.0/zephyr/soc/neorv32/Kconfig.soc"
osource "/opt/nordic/ncs/v2.9.0/zephyr/soc/native/inf_clock/Kconfig.soc"
osource "/opt/nordic/ncs/v2.9.0/zephyr/soc/microchip/miv/Kconfig.soc"
osource "/opt/nordic/ncs/v2.9.0/zephyr/soc/microchip/mec/Kconfig.soc"
osource "/opt/nordic/ncs/v2.9.0/zephyr/soc/mediatek/mtk_adsp/Kconfig.soc"
osource "/opt/nordic/ncs/v2.9.0/zephyr/soc/lowrisc/opentitan/Kconfig.soc"
osource "/opt/nordic/ncs/v2.9.0/zephyr/soc/litex/litex_vexriscv/Kconfig.soc"
osource "/opt/nordic/ncs/v2.9.0/zephyr/soc/ite/ec/Kconfig.soc"
osource "/opt/nordic/ncs/v2.9.0/zephyr/soc/intel/raptor_lake/Kconfig.soc"
osource "/opt/nordic/ncs/v2.9.0/zephyr/soc/intel/lakemont/Kconfig.soc"
osource "/opt/nordic/ncs/v2.9.0/zephyr/soc/intel/intel_socfpga_std/Kconfig.soc"
osource "/opt/nordic/ncs/v2.9.0/zephyr/soc/intel/intel_socfpga/Kconfig.soc"
osource "/opt/nordic/ncs/v2.9.0/zephyr/soc/intel/intel_niosv/Kconfig.soc"
osource "/opt/nordic/ncs/v2.9.0/zephyr/soc/intel/intel_ish/Kconfig.soc"
osource "/opt/nordic/ncs/v2.9.0/zephyr/soc/intel/intel_adsp/Kconfig.soc"
osource "/opt/nordic/ncs/v2.9.0/zephyr/soc/intel/elkhart_lake/Kconfig.soc"
osource "/opt/nordic/ncs/v2.9.0/zephyr/soc/intel/atom/Kconfig.soc"
osource "/opt/nordic/ncs/v2.9.0/zephyr/soc/intel/apollo_lake/Kconfig.soc"
osource "/opt/nordic/ncs/v2.9.0/zephyr/soc/intel/alder_lake/Kconfig.soc"
osource "/opt/nordic/ncs/v2.9.0/zephyr/soc/infineon/cat3/Kconfig.soc"
osource "/opt/nordic/ncs/v2.9.0/zephyr/soc/infineon/cat1b/Kconfig.soc"
osource "/opt/nordic/ncs/v2.9.0/zephyr/soc/infineon/cat1a/Kconfig.soc"
osource "/opt/nordic/ncs/v2.9.0/zephyr/soc/gd/gd32/Kconfig.soc"
osource "/opt/nordic/ncs/v2.9.0/zephyr/soc/gaisler/leon3/Kconfig.soc"
osource "/opt/nordic/ncs/v2.9.0/zephyr/soc/gaisler/gr716a/Kconfig.soc"
osource "/opt/nordic/ncs/v2.9.0/zephyr/soc/espressif/Kconfig.soc"
osource "/opt/nordic/ncs/v2.9.0/zephyr/soc/ene/kb1200/Kconfig.soc"
osource "/opt/nordic/ncs/v2.9.0/zephyr/soc/efinix/sapphire/Kconfig.soc"
osource "/opt/nordic/ncs/v2.9.0/zephyr/soc/cdns/xtensa_sample_controller/Kconfig.soc"
osource "/opt/nordic/ncs/v2.9.0/zephyr/soc/cdns/dc233c/Kconfig.soc"
osource "/opt/nordic/ncs/v2.9.0/zephyr/soc/brcm/bcmvk/Kconfig.soc"
osource "/opt/nordic/ncs/v2.9.0/zephyr/soc/brcm/bcm2712/Kconfig.soc"
osource "/opt/nordic/ncs/v2.9.0/zephyr/soc/brcm/bcm2711/Kconfig.soc"
osource "/opt/nordic/ncs/v2.9.0/zephyr/soc/atmel/sam0/Kconfig.soc"
osource "/opt/nordic/ncs/v2.9.0/zephyr/soc/atmel/sam/Kconfig.soc"
osource "/opt/nordic/ncs/v2.9.0/zephyr/soc/aspeed/Kconfig.soc"
osource "/opt/nordic/ncs/v2.9.0/zephyr/soc/arm/Kconfig.soc"
osource "/opt/nordic/ncs/v2.9.0/zephyr/soc/arm/beetle/Kconfig.soc"
osource "/opt/nordic/ncs/v2.9.0/zephyr/soc/andestech/Kconfig.soc"
osource "/opt/nordic/ncs/v2.9.0/zephyr/soc/ambiq/Kconfig.soc"
osource "/opt/nordic/ncs/v2.9.0/zephyr/soc/altr/zephyr_nios2f/Kconfig.soc"
osource "/opt/nordic/ncs/v2.9.0/zephyr/soc/altr/qemu_nios2/Kconfig.soc"
osource "/opt/nordic/ncs/v2.9.0/zephyr/soc/adi/max32/Kconfig.soc"
```
