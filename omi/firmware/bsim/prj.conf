## CMakeLists.txt
```
cmake_minimum_required(VERSION 3.20.0)
find_package(Zephyr REQUIRED HINTS $ENV{ZEPHYR_BASE})
project(omi_bsim)

set(OMI_SOURCE_DIR ${CMAKE_CURRENT_SOURCE_DIR}/../omi/src)

target_sources(app PRIVATE
    src/main.c
    src/stubs.c
    ${OMI_SOURCE_DIR}/settings.c
    ${OMI_SOURCE_DIR}/lib/core/button_service.c
    ${OMI_SOURCE_DIR}/lib/core/transport.c
)

target_include_directories(app PRIVATE
    ${OMI_SOURCE_DIR}
)
```

## Kconfig
```
rsource "../omi/Kconfig"
```

## Kconfig.sysbuild
```
source "share/sysbuild/Kconfig"

config NET_CORE_BOARD
    string
    default "nrf5340bsim/nrf5340/cpunet" if $(BOARD_TARGET_STRING) = "NRF5340BSIM_NRF5340_CPUAPP"
```

## prj.conf
```kconfig
CONFIG_BT=y
CONFIG_BT_PERIPHERAL=y
CONFIG_BT_DEVICE_NAME="Omi"
CONFIG_BT_MAX_CONN=1
CONFIG_BT_GATT_DYNAMIC_DB=y
CONFIG_BT_GATT_CLIENT=y
CONFIG_BT_L2CAP_TX_MTU=247
CONFIG_BT_CONN_TX_MAX=20
CONFIG_BT_L2CAP_TX_BUF_COUNT=20
CONFIG_BT_BUF_ACL_RX_SIZE=251
CONFIG_BT_BUF_ACL_TX_SIZE=251
CONFIG_BT_BUF_ACL_TX_COUNT=10
CONFIG_BT_ATT_TX_COUNT=20
CONFIG_BT_USER_DATA_LEN_UPDATE=y
CONFIG_BT_USER_PHY_UPDATE=y
CONFIG_BT_AUTO_DATA_LEN_UPDATE=y
CONFIG_BT_AUTO_PHY_UPDATE=y
CONFIG_BT_GATT_AUTO_UPDATE_MTU=y
CONFIG_BT_SETTINGS=y
CONFIG_SETTINGS=y
CONFIG_SETTINGS_NVS=y
CONFIG_NVS=y
CONFIG_FLASH=y
CONFIG_FLASH_MAP=y
CONFIG_RING_BUFFER=y
CONFIG_LOG=y
CONFIG_LOG_DEFAULT_LEVEL=3
CONFIG_PRINTK=y
CONFIG_MAIN_STACK_SIZE=4096
CONFIG_SYSTEM_WORKQUEUE_STACK_SIZE=4096
CONFIG_HEAP_MEM_POOL_SIZE=40000
CONFIG_OMI_CODEC_OPUS=y
CONFIG_OMI_ENABLE_BUTTON=y
CONFIG_OMI_ENABLE_BUTTON_INPUT=n
CONFIG_OMI_ENABLE_RFSW_CTRL=n
```

## src/main.c
```c
#include <zephyr/kernel.h>
#include <zephyr/sys/printk.h>

#include "lib/core/settings.h"
#include "lib/core/transport.h"

int main(void)
{
    int err = app_settings_init();
    if (err) {
        printk("OMI_BSIM_FAIL settings %d\n", err);
        return err;
    }

    err = transport_start();
    if (err) {
        printk("OMI_BSIM_FAIL transport %d\n", err);
        return err;
    }

    printk("OMI_BSIM_READY\n");
    return 0;
}
```

## src/stubs.c
```c
#include <stdbool.h>
#include <stddef.h>
#include <stdint.h>

bool is_connected;
bool is_charging;

uint16_t speak(uint16_t len, const void *buf)
{
    return len;
}

void mic_set_gain(uint8_t gain_level) {}

int rtc_set_utc_time(uint64_t utc_epoch_s)
{
    return 0;
}

uint32_t get_utc_time(void)
{
    return 0;
}

void sd_notify_time_synced(uint32_t utc_time) {}
```
