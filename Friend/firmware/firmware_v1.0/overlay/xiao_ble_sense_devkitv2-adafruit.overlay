&i2s0 {
    status = "okay";
    pinctrl-0 = <&i2s0_default>;
    pinctrl-names = "default";
    label = "I2S_0";
};

&pinctrl {
    i2s0_default: i2s0_default {
        group1 {
            psels = <NRF_PSEL(I2S_SCK_M, 0, 29)>,    // SCK pin (bit clock) A3
                    <NRF_PSEL(I2S_LRCK_M, 0, 28)>,   // LRCK pin (word select clock) A2
                    <NRF_PSEL(I2S_SDOUT, 0, 3)>;    // SDOUT pin (data out) A1
        };
    };
};
