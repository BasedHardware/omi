## CMakeLists.txt
```
# SPDX-License-Identifier: Apache-2.0
# set(BOARD seeed_xiao_nrf52840_sense)
SET(APPLE FALSE)
cmake_minimum_required(VERSION 3.20.0)
find_package(Zephyr REQUIRED HINTS $ENV{ZEPHYR_BASE})

project(nrf52840_nordic)
enable_language(C ASM)

set(CMAKE_SYSTEM_PROCESSOR cortex-m4)
set(CMAKE_C_FLAGS "${CMAKE_C_FLAGS} -mcpu=cortex-m4 -mthumb -mfloat-abi=hard -mfpu=fpv4-sp-d16")

target_sources(app PRIVATE
    src/main.c
    src/transport.c
    src/mic.c
    src/led.c
    src/codec.c
    src/lib/battery/battery.c
    src/button.c
    src/speaker.c
    src/sdcard.c
    src/storage.c
    src/usb.c
	# src/nfc.c future release
)

target_link_libraries(app PRIVATE zephyr)

target_sources_ifdef(CONFIG_OMI_CODEC_OPUS app PRIVATE
    src/lib/opus-1.2.1/A2NLSF.c
    src/lib/opus-1.2.1/CNG.c
    src/lib/opus-1.2.1/HP_variable_cutoff.c
    src/lib/opus-1.2.1/LPC_analysis_filter.c
    src/lib/opus-1.2.1/LPC_fit.c
    src/lib/opus-1.2.1/LPC_inv_pred_gain.c
    src/lib/opus-1.2.1/LP_variable_cutoff.c
    src/lib/opus-1.2.1/LTP_analysis_filter_FIX.c
    src/lib/opus-1.2.1/LTP_scale_ctrl_FIX.c
    src/lib/opus-1.2.1/NLSF2A.c
    src/lib/opus-1.2.1/NLSF_VQ.c
    src/lib/opus-1.2.1/NLSF_VQ_weights_laroia.c
    src/lib/opus-1.2.1/NLSF_decode.c
    src/lib/opus-1.2.1/NLSF_del_dec_quant.c
    src/lib/opus-1.2.1/NLSF_encode.c
    src/lib/opus-1.2.1/NLSF_stabilize.c
    src/lib/opus-1.2.1/NLSF_unpack.c
    src/lib/opus-1.2.1/NSQ.c
    src/lib/opus-1.2.1/NSQ_del_dec.c
    src/lib/opus-1.2.1/PLC.c
    src/lib/opus-1.2.1/VAD.c
    src/lib/opus-1.2.1/VQ_WMat_EC.c
    src/lib/opus-1.2.1/ana_filt_bank_1.c
    src/lib/opus-1.2.1/analysis.c
    src/lib/opus-1.2.1/apply_sine_window_FIX.c
    src/lib/opus-1.2.1/autocorr_FIX.c
    src/lib/opus-1.2.1/bands.c
    src/lib/opus-1.2.1/biquad_alt.c
    src/lib/opus-1.2.1/burg_modified_FIX.c
    src/lib/opus-1.2.1/bwexpander.c
    src/lib/opus-1.2.1/bwexpander_32.c
    src/lib/opus-1.2.1/celt.c
    src/lib/opus-1.2.1/celt_decoder.c
    src/lib/opus-1.2.1/celt_encoder.c
    src/lib/opus-1.2.1/celt_lpc.c
    src/lib/opus-1.2.1/arm/celt_pitch_xcorr_arm_gcc.s
    src/lib/opus-1.2.1/check_control_input.c
    src/lib/opus-1.2.1/code_signs.c
    src/lib/opus-1.2.1/control_SNR.c
    src/lib/opus-1.2.1/control_audio_bandwidth.c
    src/lib/opus-1.2.1/control_codec.c
    src/lib/opus-1.2.1/corrMatrix_FIX.c
    src/lib/opus-1.2.1/cwrs.c
    src/lib/opus-1.2.1/debug.c
    src/lib/opus-1.2.1/dec_API.c
    src/lib/opus-1.2.1/decode_core.c
    src/lib/opus-1.2.1/decode_frame.c
    src/lib/opus-1.2.1/decode_indices.c
    src/lib/opus-1.2.1/decode_parameters.c
    src/lib/opus-1.2.1/decode_pitch.c
    src/lib/opus-1.2.1/decode_pulses.c
    src/lib/opus-1.2.1/decoder_set_fs.c
    src/lib/opus-1.2.1/enc_API.c
    src/lib/opus-1.2.1/encode_frame_FIX.c
    src/lib/opus-1.2.1/encode_indices.c
    src/lib/opus-1.2.1/encode_pulses.c
    src/lib/opus-1.2.1/entcode.c
    src/lib/opus-1.2.1/entdec.c
    src/lib/opus-1.2.1/entenc.c
    src/lib/opus-1.2.1/find_LPC_FIX.c
    src/lib/opus-1.2.1/find_LTP_FIX.c
    src/lib/opus-1.2.1/find_pitch_lags_FIX.c
    src/lib/opus-1.2.1/find_pred_coefs_FIX.c
    src/lib/opus-1.2.1/gain_quant.c
    src/lib/opus-1.2.1/init_decoder.c
    src/lib/opus-1.2.1/init_encoder.c
    src/lib/opus-1.2.1/inner_prod_aligned.c
    src/lib/opus-1.2.1/interpolate.c
    src/lib/opus-1.2.1/k2a_FIX.c
    src/lib/opus-1.2.1/k2a_Q16_FIX.c
    src/lib/opus-1.2.1/kiss_fft.c
    src/lib/opus-1.2.1/laplace.c
    src/lib/opus-1.2.1/lin2log.c
    src/lib/opus-1.2.1/log2lin.c
    src/lib/opus-1.2.1/mathops.c
    src/lib/opus-1.2.1/mdct.c
    src/lib/opus-1.2.1/mlp.c
    src/lib/opus-1.2.1/mlp_data.c
    src/lib/opus-1.2.1/modes.c
    src/lib/opus-1.2.1/noise_shape_analysis_FIX.c
    src/lib/opus-1.2.1/opus.c
    src/lib/opus-1.2.1/opus_decoder.c
    src/lib/opus-1.2.1/opus_encoder.c
    src/lib/opus-1.2.1/opus_multistream.c
    src/lib/opus-1.2.1/opus_multistream_decoder.c
    src/lib/opus-1.2.1/opus_multistream_encoder.c
    src/lib/opus-1.2.1/pitch.c
    src/lib/opus-1.2.1/pitch_analysis_core_FIX.c
    src/lib/opus-1.2.1/pitch_est_tables.c
    src/lib/opus-1.2.1/process_NLSFs.c
    src/lib/opus-1.2.1/process_gains_FIX.c
    src/lib/opus-1.2.1/quant_LTP_gains.c
    src/lib/opus-1.2.1/quant_bands.c
    src/lib/opus-1.2.1/rate.c
    src/lib/opus-1.2.1/regularize_correlations_FIX.c
    src/lib/opus-1.2.1/repacketizer.c
    src/lib/opus-1.2.1/resampler.c
    src/lib/opus-1.2.1/resampler_down2.c
    src/lib/opus-1.2.1/resampler_down2_3.c
    src/lib/opus-1.2.1/resampler_private_AR2.c
    src/lib/opus-1.2.1/resampler_private_IIR_FIR.c
    src/lib/opus-1.2.1/resampler_private_down_FIR.c
    src/lib/opus-1.2.1/resampler_private_up2_HQ.c
    src/lib/opus-1.2.1/resampler_rom.c
    src/lib/opus-1.2.1/residual_energy16_FIX.c
    src/lib/opus-1.2.1/residual_energy_FIX.c
    src/lib/opus-1.2.1/schur64_FIX.c
    src/lib/opus-1.2.1/schur_FIX.c
    src/lib/opus-1.2.1/shell_coder.c
    src/lib/opus-1.2.1/sigm_Q15.c
    src/lib/opus-1.2.1/sort.c
    src/lib/opus-1.2.1/stereo_LR_to_MS.c
    src/lib/opus-1.2.1/stereo_MS_to_LR.c
    src/lib/opus-1.2.1/stereo_decode_pred.c
    src/lib/opus-1.2.1/stereo_encode_pred.c
    src/lib/opus-1.2.1/stereo_find_predictor.c
    src/lib/opus-1.2.1/stereo_quant_pred.c
    src/lib/opus-1.2.1/sum_sqr_shift.c
    src/lib/opus-1.2.1/table_LSF_cos.c
    src/lib/opus-1.2.1/tables_LTP.c
    src/lib/opus-1.2.1/tables_NLSF_CB_NB_MB.c
    src/lib/opus-1.2.1/tables_NLSF_CB_WB.c
    src/lib/opus-1.2.1/tables_gain.c
    src/lib/opus-1.2.1/tables_other.c
    src/lib/opus-1.2.1/tables_pitch_lag.c
    src/lib/opus-1.2.1/tables_pulses_per_block.c
    src/lib/opus-1.2.1/vector_ops_FIX.c
    src/lib/opus-1.2.1/vq.c
    src/lib/opus-1.2.1/warped_autocorrelation_FIX.c
    src/lib/opus-1.2.1/arm/celt_pitch_xcorr_arm_gcc.s
)

set(CMAKE_C_FLAGS "${CMAKE_C_FLAGS} -DARM_MATH_CM4")
# set(CMAKE_C_FLAGS "${CMAKE_C_FLAGS} -DVAR_ARRAYS")
set(CMAKE_C_FLAGS "${CMAKE_C_FLAGS} -DOPUS_ARM_ASM")
set(CMAKE_C_FLAGS "${CMAKE_C_FLAGS} -DOPUS_ARM_INLINE_ASM")
set(CMAKE_C_FLAGS "${CMAKE_C_FLAGS} -DOPUS_ARM_INLINE_EDSP")
set(CMAKE_C_FLAGS "${CMAKE_C_FLAGS} -DOPUS_ARM_INLINE_MEDIA")
set(CMAKE_C_FLAGS "${CMAKE_C_FLAGS} -DOPUS_ARM_MAY_HAVE_EDSP")
set(CMAKE_C_FLAGS "${CMAKE_C_FLAGS} -DOPUS_ARM_PRESUME_EDSP")
set(CMAKE_C_FLAGS "${CMAKE_C_FLAGS} -DOPUS_BUILD")
set(CMAKE_C_FLAGS "${CMAKE_C_FLAGS} -DUSE_ALLOCA")
set(CMAKE_C_FLAGS "${CMAKE_C_FLAGS} -DFIXED_POINT -DDISABLE_FLOAT_API")
set(CMAKE_C_FLAGS "${CMAKE_C_FLAGS} -DHAVE_CONFIG_H")
set(CMAKE_C_FLAGS "${CMAKE_C_FLAGS} -DHAVE_ALLOCA_H")
set(CMAKE_C_FLAGS "${CMAKE_C_FLAGS} -fsingle-precision-constant") # A lot of constants are written as doubles
set(CMAKE_C_FLAGS "${CMAKE_C_FLAGS} -DHAVE_LRINT -DHAVE_LRINTF")
```

## Kconfig
```
source "Kconfig.zephyr"

menu "Friend Configuration"
config CODEC_OPUS
    bool "Opus Audio Codec Support"
    default n

config OFFLINE_STORAGE
	bool "Offline SD Card Storage Support"
	default n
config ACCELEROMETER
    bool "Accelerometer Support"
    default n
config ENABLE_BUTTON
    bool "Button support on Devkit2"
    default n
config ENABLE_SPEAKER
    bool "Enable the speaker!!"
    default n
endmenu

menu "Voice Interaction Options"

config ENABLE_VOICE_INTERACTION
    bool "Enable Voice Interaction"
    default n
    help
      Enable support for push-to-talk (bi-directional) voice interaction.
      This will add extra BLE characteristics and code to support a dedicated voice mode.

endmenu
```

## prj.conf
```kconfig
#
# Hardware settings
#

CONFIG_GPIO=y
CONFIG_NRFX_PDM=y
CONFIG_ADC=y

# To flash via dev board
#CONFIG_BUILD_OUTPUT_UF2=n
#CONFIG_USE_DT_CODE_PARTITION=n

#
# Bluetooth settings
#

CONFIG_BT=y
CONFIG_BT_PERIPHERAL=y
CONFIG_BT_DEVICE_NAME="Friend"
CONFIG_BT_MAX_CONN=1
CONFIG_BT_MAX_PAIRED=1
CONFIG_BT_DEVICE_APPEARANCE=22
CONFIG_BT_GATT_DYNAMIC_DB=y

# Max transmit power supported by nRF52840
CONFIG_BT_CTLR_TX_PWR_ANTENNA=8
CONFIG_BT_PHY_UPDATE=y

# CONFIG_BT_L2CAP_DYNAMIC_CHANNEL=y
# CONFIG_BT_SMP=y
# CONFIG_BT_LL_SW_SPLIT=y # Alternative implementation

# Battery and Device Information services
CONFIG_BT_BAS=y
CONFIG_BT_DIS=y
CONFIG_BT_DIS_PNP=n
CONFIG_BT_DIS_MODEL="Friend"
CONFIG_BT_DIS_MANUF="Based Hardware"
CONFIG_BT_DIS_FW_REV=y
CONFIG_BT_DIS_HW_REV=y
CONFIG_BT_DIS_FW_REV_STR="1.0.5"
CONFIG_BT_DIS_HW_REV_STR="Seeed Xiao BLE Sense"

# Large packets
CONFIG_BT_L2CAP_TX_MTU=498
CONFIG_BT_L2CAP_TX_BUF_COUNT=10
# CONFIG_BT_ATT_TX_COUNT=10
CONFIG_BT_CONN_TX_MAX=30
CONFIG_BT_BUF_ACL_RX_SIZE=2048
CONFIG_BT_BUF_ACL_TX_SIZE=2048
CONFIG_BT_CTLR_DATA_LENGTH_MAX=251

CONFIG_BT_USER_DATA_LEN_UPDATE=y
CONFIG_BT_AUTO_DATA_LEN_UPDATE=y
CONFIG_BT_USER_PHY_UPDATE=y
CONFIG_BT_AUTO_PHY_UPDATE=y

# Codecs
# CONFIG_LIBLC3=y

# Debug
# Enable the lines below to enable debug logs via UART/USB

# CONFIG_DEBUG=y
# CONFIG_LOG=y
# CONFIG_LOG_PRINTK=y
# CONFIG_LOG_MODE_IMMEDIATE=y
# CONFIG_SERIAL=y
# CONFIG_UART_CONSOLE=y
# CONFIG_LOG_BACKEND_UART=y
# CONFIG_LOG_BACKEND_UART_OUTPUT_TEXT=y
# CONFIG_LOG_DEFAULT_LEVEL=3

# Debug (This value breaks some builds)
# CONFIG_ASSERT=y

# Log Levels
# CONFIG_BT_DEBUG_LOG=y
# CONFIG_BT_L2CAP_LOG_LEVEL_DBG=y
# CONFIG_BT_LOG_LEVEL_DBG=y

# CONFIG_LOG_PROCESS_THREAD_STACK_SIZE=4096
# CONFIG_BT_RX_STACK_SIZE=4096
# CONFIG_BT_CTLR_RX_PRIO_STACK_SIZE=4096
# CONFIG_BT_DEBUG_LOG=y
# CONFIG_LOG_BUFFER_SIZE=32000
# CONFIG_LOG_OVERRIDE_LEVEL=4
# CONFIG_LOG_PROCESS_THREAD_STACK_SIZE=4096
# CONFIG_BT_RX_STACK_SIZE=4096
# CONFIG_BT_CTLR_RX_PRIO_STACK_SIZE=4096

# RTT
# CONFIG_UART_CONSOLE=n
# CONFIG_SEGGER_RTT_BUFFER_SIZE_UP=2048
# CONFIG_RTT_CONSOLE=y
# CONFIG_LOG_BACKEND_RTT=y
CONFIG_CODEC_OPUS=y
```

## prj_nrf7002dk_nrf5340_consumerv1.conf
```kconfig
#
# Security and Bootloader (MUST BE FIRST)
#

# Core TF-M config
# CONFIG_BUILD_WITH_TFM=y
# CONFIG_TFM_PROFILE_TYPE_MINIMAL=y
# CONFIG_TFM_IPC=y
# CONFIG_TFM_ISOLATION_LEVEL=1

# Memory partitioning
# CONFIG_PM_PARTITION_SIZE_TFM=0x40000
# CONFIG_PM_PARTITION_SIZE_TFM_SRAM=0x40000

# Disable all secure services
# CONFIG_TFM_PARTITION_PROTECTED_STORAGE=n
# CONFIG_TFM_PARTITION_INTERNAL_TRUSTED_STORAGE=n
# CONFIG_TFM_PARTITION_CRYPTO=n
# CONFIG_TFM_PARTITION_PLATFORM=n
# CONFIG_TFM_PARTITION_INITIAL_ATTESTATION=n

#
# Core Hardware Settings
#
CONFIG_GPIO=y
# CONFIG_ADC=y
# CONFIG_FPU=y
# CONFIG_NORDIC_QSPI_NOR=n
# CONFIG_BOARD_ENABLE_DCDC=y  # Enable DC-DC converter for better power efficiency

#
# I2C Configuration (Required for LSM6DSL)
#
# CONFIG_I2C=y
# CONFIG_NRFX_TWIM0=y
# CONFIG_NRFX_TWIM1=y

#
# Audio Hardware
#
CONFIG_I2S=y
CONFIG_I2S_NRFX=y
CONFIG_SPI_NRFX=y
CONFIG_AUDIO=y
CONFIG_AUDIO_DMIC=y
CONFIG_AUDIO_DMIC_NRFX_PDM=y
CONFIG_NRFX_PDM0=y  # PDM microphone

#
# Bluetooth Core Settings
#
CONFIG_BT=y
CONFIG_BT_HCI=n
CONFIG_BT_PERIPHERAL=y
CONFIG_BT_CENTRAL=y
CONFIG_BT_MAX_CONN=1
CONFIG_BT_MAX_PAIRED=1
CONFIG_BT_DEVICE_NAME="Omi Consumer Version 1"
CONFIG_BT_DEVICE_APPEARANCE=22
CONFIG_BT_GATT_DYNAMIC_DB=y

#
# Bluetooth Performance Settings
#
# CONFIG_BT_CTLR=y
# CONFIG_BT_CTLR_TX_PWR_ANTENNA=8
# CONFIG_BT_PHY_UPDATE=y
# CONFIG_BT_L2CAP_TX_MTU=498
# CONFIG_BT_CTLR_DATA_LENGTH_MAX=251
# CONFIG_BT_CTLR_PHY_2M=y
# CONFIG_BT_CTLR_PHY_CODED=y
# CONFIG_BT_CTLR_SDC_MAX_CONN_EVENT_LEN_DEFAULT=400000

#
# Bluetooth Buffer Configuration
#
# CONFIG_BT_CONN_TX_MAX=20
# CONFIG_BT_BUF_ACL_RX_SIZE=1024
# CONFIG_BT_L2CAP_TX_BUF_COUNT=10
# CONFIG_BT_BUF_ACL_TX_SIZE=2048
CONFIG_BT_DATA_LEN_UPDATE=y
CONFIG_BT_USER_DATA_LEN_UPDATE=y
# CONFIG_BT_AUTO_DATA_LEN_UPDATE=y
CONFIG_BT_USER_PHY_UPDATE=y
# CONFIG_BT_AUTO_PHY_UPDATE=y

#
# Bluetooth Device Information Service
#
CONFIG_BT_BAS=y
CONFIG_BT_DIS=y
CONFIG_BT_DIS_PNP=n
CONFIG_BT_DIS_MODEL="Omi Consumer Version 1"
CONFIG_BT_DIS_MANUF="Based Hardware"
CONFIG_BT_DIS_FW_REV=y
CONFIG_BT_DIS_HW_REV=y
CONFIG_BT_DIS_FW_REV_STR="2.0.9"
CONFIG_BT_DIS_HW_REV_STR="Nordic nRF7002/nRF5340"

#
# Logging and Debug
#
CONFIG_CONSOLE=n
# CONFIG_LOG=y
# CONFIG_LOG_PRINTK=y
# CONFIG_LOG_MODE_IMMEDIATE=y
# CONFIG_LOG_BACKEND_UART=y
# CONFIG_LOG_BACKEND_UART_OUTPUT_TEXT=y
# CONFIG_LOG_BACKEND_UART=n
# CONFIG_USE_SEGGER_RTT=y
# CONFIG_LOG_BACKEND_RTT=y
CONFIG_DEBUG=y
CONFIG_DEBUG_OPTIMIZATIONS=y
CONFIG_DEBUG_COREDUMP=y
CONFIG_DEBUG_COREDUMP_BACKEND_LOGGING=y

#
# Storage and Filesystem
#
CONFIG_DISK_ACCESS=y
CONFIG_FILE_SYSTEM=y
CONFIG_FAT_FILESYSTEM_ELM=y
CONFIG_FS_FATFS_MOUNT_MKFS=y
CONFIG_FS_FATFS_EXFAT=y
CONFIG_HEAP_MEM_POOL_SIZE=4096

#
# Sensors
#
# CONFIG_SENSOR=y
# CONFIG_LSM6DSL=y
# CONFIG_LSM6DSL_ENABLE_TEMP=n

#
# System Configuration
#
# CONFIG_MAIN_STACK_SIZE=2048
CONFIG_RING_BUFFER=y
# CONFIG_PM_DEVICE=y
# CONFIG_USB_DEVICE_STACK=y
# CONFIG_POWEROFF=y

#
# Omi Features
#
CONFIG_OMI_CODEC_OPUS=y
# CONFIG_OMI_ENABLE_OFFLINE_STORAGE=y
# CONFIG_OMI_ENABLE_ACCELEROMETER=y
# CONFIG_OMI_ENABLE_BUTTON=y
# CONFIG_OMI_ENABLE_SPEAKER=y
# CONFIG_OMI_ENABLE_BATTERY=y
# CONFIG_OMI_ENABLE_USB=y
# CONFIG_OMI_ENABLE_HAPTIC=y

CONFIG_OMI_USE_LEGACY_SDK=n
CONFIG_OMI_USE_LEGACY_SOC=n
```

## prj_xiao_ble_sense_devkitv1-spisd.conf
```kconfig
#
# Hardware settings
#

CONFIG_GPIO=y
CONFIG_NRFX_PDM=y
CONFIG_ADC=y

# To flash via dev board
#CONFIG_BUILD_OUTPUT_UF2=n
#CONFIG_USE_DT_CODE_PARTITION=n

#
# Bluetooth settings
#

CONFIG_BT=y
CONFIG_BT_PERIPHERAL=y
CONFIG_BT_DEVICE_NAME="Friend"
CONFIG_BT_MAX_CONN=1
CONFIG_BT_MAX_PAIRED=1
CONFIG_BT_DEVICE_APPEARANCE=22
CONFIG_BT_GATT_DYNAMIC_DB=y

# Max transmit power supported by nRF52840
CONFIG_BT_CTLR_TX_PWR_ANTENNA=8
CONFIG_BT_PHY_UPDATE=y

# CONFIG_BT_L2CAP_DYNAMIC_CHANNEL=y
# CONFIG_BT_SMP=y
# CONFIG_BT_LL_SW_SPLIT=y # Alternative implementation

# Battery and Device Information services
CONFIG_BT_BAS=y
CONFIG_BT_DIS=y
CONFIG_BT_DIS_PNP=n
CONFIG_BT_DIS_MODEL="Friend DevKit 1 SPI SD"
CONFIG_BT_DIS_MANUF="Based Hardware"
CONFIG_BT_DIS_FW_REV=y
CONFIG_BT_DIS_HW_REV=y
CONFIG_BT_DIS_FW_REV_STR="1.0.5"
CONFIG_BT_DIS_HW_REV_STR="Seeed Xiao BLE Sense"

# Large packets
CONFIG_BT_L2CAP_TX_MTU=498
CONFIG_BT_L2CAP_TX_BUF_COUNT=10
# CONFIG_BT_ATT_TX_COUNT=10
CONFIG_BT_CONN_TX_MAX=30
CONFIG_BT_BUF_ACL_RX_SIZE=2048
CONFIG_BT_BUF_ACL_TX_SIZE=2048
CONFIG_BT_CTLR_DATA_LENGTH_MAX=251

CONFIG_BT_USER_DATA_LEN_UPDATE=y
CONFIG_BT_AUTO_DATA_LEN_UPDATE=y
CONFIG_BT_USER_PHY_UPDATE=y
CONFIG_BT_AUTO_PHY_UPDATE=y

# Codecs
# CONFIG_LIBLC3=y

# Debug
# Enable the lines below to enable debug logs via UART/USB

CONFIG_DEBUG=y
CONFIG_DEBUG_OPTIMIZATIONS=y
CONFIG_LOG=y
CONFIG_LOG_PRINTK=y
CONFIG_LOG_MODE_IMMEDIATE=y
CONFIG_SERIAL=y
CONFIG_UART_CONSOLE=y
CONFIG_LOG_BACKEND_UART=y
CONFIG_LOG_BACKEND_UART_OUTPUT_TEXT=y
CONFIG_LOG_DEFAULT_LEVEL=3

# Debug (This value breaks some builds)
# CONFIG_ASSERT=y

# Log Levels
# CONFIG_BT_DEBUG_LOG=y
# CONFIG_BT_L2CAP_LOG_LEVEL_DBG=y
# CONFIG_BT_LOG_LEVEL_DBG=y

# CONFIG_LOG_PROCESS_THREAD_STACK_SIZE=4096
# CONFIG_BT_RX_STACK_SIZE=4096
# CONFIG_BT_CTLR_RX_PRIO_STACK_SIZE=4096
# CONFIG_BT_DEBUG_LOG=y
# CONFIG_LOG_BUFFER_SIZE=32000
# CONFIG_LOG_OVERRIDE_LEVEL=4
# CONFIG_LOG_PROCESS_THREAD_STACK_SIZE=4096
# CONFIG_BT_RX_STACK_SIZE=4096
# CONFIG_BT_CTLR_RX_PRIO_STACK_SIZE=4096

# RTT
# CONFIG_UART_CONSOLE=n
# CONFIG_SEGGER_RTT_BUFFER_SIZE_UP=2048
# CONFIG_RTT_CONSOLE=y
# CONFIG_LOG_BACKEND_RTT=y
CONFIG_CODEC_OPUS=y

# SD Card Support
CONFIG_OFFLINE_STORAGE=y
CONFIG_DISK_ACCESS=y
CONFIG_FILE_SYSTEM=y
CONFIG_FAT_FILESYSTEM_ELM=y
CONFIG_FS_FATFS_MOUNT_MKFS=y
CONFIG_FS_FATFS_EXFAT=y
CONFIG_PRINTK=y
CONFIG_MAIN_STACK_SIZE=5096
CONFIG_DISK_DRIVER_SDMMC=y
CONFIG_SPI=y
CONFIG_HEAP_MEM_POOL_SIZE=3048

# Increase stack and heap sizes
CONFIG_MAIN_STACK_SIZE=8192
CONFIG_HEAP_MEM_POOL_SIZE=4096
```

## prj_xiao_ble_sense_devkitv1.conf
```kconfig
#
# Hardware settings
#

CONFIG_GPIO=y
# CONFIG_NRFX_PDM=y
CONFIG_ADC=y
# DT_HAS_NORDIC_NRF_PDM_ENABLED=y
CONFIG_AUDIO=y
CONFIG_AUDIO_DMIC=y
CONFIG_AUDIO_DMIC_NRFX_PDM=y

# To flash via dev board
#CONFIG_BUILD_OUTPUT_UF2=n
#CONFIG_USE_DT_CODE_PARTITION=n

#
# Bluetooth settings
#

CONFIG_BT=y
CONFIG_BT_PERIPHERAL=y
CONFIG_BT_DEVICE_NAME="Friend"
CONFIG_BT_MAX_CONN=1
CONFIG_BT_MAX_PAIRED=1
CONFIG_BT_DEVICE_APPEARANCE=22
CONFIG_BT_GATT_DYNAMIC_DB=y

# Max transmit power supported by nRF52840
CONFIG_BT_CTLR_TX_PWR_ANTENNA=8
CONFIG_BT_PHY_UPDATE=y

# CONFIG_BT_L2CAP_DYNAMIC_CHANNEL=y
# CONFIG_BT_SMP=y
# CONFIG_BT_LL_SW_SPLIT=y # Alternative implementation

# Battery and Device Information services
CONFIG_BT_BAS=y
CONFIG_BT_DIS=y
CONFIG_BT_DIS_PNP=n
CONFIG_BT_DIS_MODEL="Friend DevKit 1"
CONFIG_BT_DIS_MANUF="Based Hardware"
CONFIG_BT_DIS_FW_REV=y
CONFIG_BT_DIS_HW_REV=y
CONFIG_BT_DIS_FW_REV_STR="1.0.5"
CONFIG_BT_DIS_HW_REV_STR="Seeed Xiao BLE Sense"

# Large packets
CONFIG_BT_L2CAP_TX_MTU=498
CONFIG_BT_L2CAP_TX_BUF_COUNT=10
# CONFIG_BT_ATT_TX_COUNT=10
CONFIG_BT_CONN_TX_MAX=30
CONFIG_BT_BUF_ACL_RX_SIZE=2048
CONFIG_BT_BUF_ACL_TX_SIZE=2048
CONFIG_BT_CTLR_DATA_LENGTH_MAX=251

CONFIG_BT_USER_DATA_LEN_UPDATE=y
CONFIG_BT_AUTO_DATA_LEN_UPDATE=y
CONFIG_BT_USER_PHY_UPDATE=y
CONFIG_BT_AUTO_PHY_UPDATE=y

# Codecs
# CONFIG_LIBLC3=y

# Debug
# Enable the lines below to enable debug logs via UART/USB

CONFIG_DEBUG=y
CONFIG_DEBUG_OPTIMIZATIONS=y
CONFIG_LOG=y
CONFIG_LOG_PRINTK=y
CONFIG_LOG_MODE_IMMEDIATE=y
CONFIG_SERIAL=y
CONFIG_UART_CONSOLE=y
CONFIG_LOG_BACKEND_UART=y
CONFIG_LOG_BACKEND_UART_OUTPUT_TEXT=y
CONFIG_LOG_DEFAULT_LEVEL=3

# Debug (This value breaks some builds)
# CONFIG_ASSERT=y

# Log Levels
# CONFIG_BT_DEBUG_LOG=y
# CONFIG_BT_L2CAP_LOG_LEVEL_DBG=y
# CONFIG_BT_LOG_LEVEL_DBG=y

# CONFIG_LOG_PROCESS_THREAD_STACK_SIZE=4096
# CONFIG_BT_RX_STACK_SIZE=4096
# CONFIG_BT_CTLR_RX_PRIO_STACK_SIZE=4096
# CONFIG_BT_DEBUG_LOG=y
# CONFIG_LOG_BUFFER_SIZE=32000
# CONFIG_LOG_OVERRIDE_LEVEL=4
# CONFIG_LOG_PROCESS_THREAD_STACK_SIZE=4096
# CONFIG_BT_RX_STACK_SIZE=4096
# CONFIG_BT_CTLR_RX_PRIO_STACK_SIZE=4096

CONFIG_LSM6DSL=y
CONFIG_LSM6DSL_ENABLE_TEMP=n
CONFIG_LSM6DSL_TRIGGER_GLOBAL_THREAD=y
CONFIG_SENSOR=y

# RTT
# CONFIG_UART_CONSOLE=n
# CONFIG_SEGGER_RTT_BUFFER_SIZE_UP=2048
# CONFIG_RTT_CONSOLE=y
# CONFIG_LOG_BACKEND_RTT=y
CONFIG_CODEC_OPUS=y
```

## prj_xiao_ble_sense_devkitv2-5340.conf
```kconfig
#
# Hardware settings
#

CONFIG_GPIO=y
CONFIG_NRFX_PDM0=y
CONFIG_ADC=y

# To flash via dev board
#CONFIG_BUILD_OUTPUT_UF2=n
#CONFIG_USE_DT_CODE_PARTITION=n

#
# Bluetooth settings
#

CONFIG_BT=y
CONFIG_BT_PERIPHERAL=y
CONFIG_BT_DEVICE_NAME="Omi Consumer Version 1"
CONFIG_BT_MAX_CONN=1
# CONFIG_BT_EXT_ADV_MAX_ADV_SET=2
CONFIG_BT_MAX_PAIRED=1
CONFIG_BT_DEVICE_APPEARANCE=22
CONFIG_BT_GATT_DYNAMIC_DB=y

#
# Max transmit power supported by nRF52840
#

CONFIG_BT_CTLR_TX_PWR_ANTENNA=8
CONFIG_BT_PHY_UPDATE=y

#
# Battery and Device Information services
#

CONFIG_BT_BAS=y
CONFIG_BT_DIS=y
CONFIG_BT_DIS_PNP=n
CONFIG_BT_DIS_MODEL="Omi Consumer Version 1"
CONFIG_BT_DIS_MANUF="Based Hardware"
CONFIG_BT_DIS_FW_REV=y
CONFIG_BT_DIS_HW_REV=y
CONFIG_BT_DIS_FW_REV_STR="2.0.9"
CONFIG_BT_DIS_HW_REV_STR="Nordic nRF 5340"

#
# Large BLE packets / BLE Buffers 
#
# CONFIG_BT_GATT_CLIENT=y
# CONFIG_BT_THROUGHPUT=y

CONFIG_BT_L2CAP_TX_MTU=498

CONFIG_BT_CTLR_DATA_LENGTH_MAX=251
CONFIG_BT_CTLR_PHY_2M=y
CONFIG_BT_CTLR_PHY_CODED=y
CONFIG_BT_CTLR_SDC_MAX_CONN_EVENT_LEN_DEFAULT=400000
CONFIG_BT_CONN_TX_MAX=20
CONFIG_BT_BUF_ACL_RX_SIZE=1024
CONFIG_BT_L2CAP_TX_BUF_COUNT=10
CONFIG_BT_BUF_ACL_TX_SIZE=2048
# CONFIG_BT_ATT_TX_COUNT=10
# CONFIG_BT_EXT_ADV=y
# CONFIG_BT_PER_ADV=y
# CONFIG_BT_OBSERVER=y
# CONFIG_BT_ATT_PREPARE_COUNT=2
CONFIG_BT_USER_DATA_LEN_UPDATE=y
CONFIG_BT_AUTO_DATA_LEN_UPDATE=y
CONFIG_BT_USER_PHY_UPDATE=y
CONFIG_BT_AUTO_PHY_UPDATE=y

CONFIG_FPU=y
CONFIG_NORDIC_QSPI_NOR=n
# CONFIG_BOARD_ENABLE_DCDC=y
#

#
# Console
#
# Disable the lines to enable console log
CONFIG_CONSOLE=y
CONFIG_PRINTK=y

#
# Logs
#

# Enable the lines below to enable logs via UART/USB
# CONFIG_LOG=y
# CONFIG_LOG_PRINTK=y
# CONFIG_UART_CONSOLE=y
# CONFIG_LOG_MODE_IMMEDIATE=y
# CONFIG_LOG_BACKEND_UART=y
# CONFIG_LOG_BACKEND_UART_OUTPUT_TEXT=y

# Enable the lines below to enable debug logs
# CONFIG_LOG_DEFAULT_LEVEL=4

#
# Log level and buffer size
#

# CONFIG_LOG_OVERRIDE_LEVEL=4
# CONFIG_LOG_BUFFER_SIZE=32000
# CONFIG_LOG_PROCESS_THREAD_STACK_SIZE=4096

#
# Debug
#

# CONFIG_DEBUG=y
# CONFIG_DEBUG_OPTIMIZATIONS=y
# CONFIG_SERIAL=y

#
# Debug (This value breaks some builds)
#

# CONFIG_ASSERT=y

#
# BT log configuration
#

# CONFIG_BT_DEBUG_LOG=y
# CONFIG_BT_L2CAP_LOG_LEVEL_DBG=y
# CONFIG_BT_LOG_LEVEL_DBG=y

# CONFIG_BT_RX_STACK_SIZE=4096
# CONFIG_BT_CTLR_RX_PRIO_STACK_SIZE=4096

#
# SD Card Support (all devices required)
#

CONFIG_DISK_ACCESS=y
CONFIG_FILE_SYSTEM=y
CONFIG_FAT_FILESYSTEM_ELM=y
CONFIG_FS_FATFS_MOUNT_MKFS=y
CONFIG_FS_FATFS_EXFAT=y
CONFIG_MAIN_STACK_SIZE=2048
# CONFIG_DISK_DRIVER_SDMMC=y
# CONFIG_SPI=y
CONFIG_HEAP_MEM_POOL_SIZE=512

#
# Disable unused peripherals
#
CONFIG_I2C=n
# CONFIG_NRFX_TWIM0=n
# CONFIG_NRFX_TWIM1=n

#
# LSM6DSL sensor (accelerometer and gyroscope)
#
CONFIG_LSM6DSL=y
CONFIG_LSM6DSL_ENABLE_TEMP=n
# CONFIG_LSM6DSL_TRIGGER_GLOBAL_THREAD=y
CONFIG_SENSOR=y

#
# Speaker
#
CONFIG_I2S=y
CONFIG_I2S_NRFX=y
CONFIG_SPI_NRFX=y

##
## NFC (in the future)
##
#
## CONFIG_NFC_T2T_NRFXLIB=y
## CONFIG_NFC_NDEF=y
## CONFIG_NFC_NDEF_MSG=y
## CONFIG_NFC_NDEF_RECORD=y
## CONFIG_NFC_NDEF_URI_MSG=y
## CONFIG_NFC_NDEF_URI_REC=y
## CONFIG_HWINFO=y

#
#EVERYTHING ELSE
#

CONFIG_RING_BUFFER=y

CONFIG_PM_DEVICE=y
# CONFIG_NRFX_USBD=y

# CONFIG_FLASH=y

CONFIG_USB_DEVICE_STACK=y

#
# Omi features configuration
#

CONFIG_OMI_CODEC_OPUS=y
CONFIG_OMI_ENABLE_OFFLINE_STORAGE=y
CONFIG_OMI_ENABLE_ACCELEROMETER=y
CONFIG_OMI_ENABLE_BUTTON=y
CONFIG_OMI_ENABLE_SPEAKER=y
CONFIG_OMI_ENABLE_BATTERY=y
CONFIG_OMI_ENABLE_USB=y
CONFIG_OMI_ENABLE_HAPTIC=y

#
# Omi build configuration
#

CONFIG_OMI_USE_LEGACY_SDK=n
CONFIG_OMI_USE_LEGACY_SOC=n
```

## prj_xiao_ble_sense_devkitv2-adafruit.conf
```kconfig
#
# Hardware settings
#

CONFIG_GPIO=y
CONFIG_AUDIO=y
CONFIG_AUDIO_DMIC=y
CONFIG_AUDIO_DMIC_NRFX_PDM=y
CONFIG_ADC=y
CONFIG_NRFX_PDM0=y

# To flash via dev board
#CONFIG_BUILD_OUTPUT_UF2=n
#CONFIG_USE_DT_CODE_PARTITION=n

#
# Bluetooth settings
#

CONFIG_BT=y
CONFIG_BT_PERIPHERAL=y
CONFIG_BT_DEVICE_NAME="Omi DevKit 2"
CONFIG_BT_MAX_CONN=1
# CONFIG_BT_EXT_ADV_MAX_ADV_SET=2
# CONFIG_BT_SHELL=y
CONFIG_BT_MAX_PAIRED=1
CONFIG_BT_DEVICE_APPEARANCE=22
CONFIG_BT_GATT_DYNAMIC_DB=y

#
# Max transmit power supported by nRF52840
#

CONFIG_BT_CTLR_TX_PWR_ANTENNA=8
CONFIG_BT_PHY_UPDATE=y

#
# Battery and Device Information services
#

CONFIG_BT_BAS=y
CONFIG_BT_DIS=y
CONFIG_BT_DIS_PNP=n
CONFIG_BT_DIS_MODEL="Omi DevKit 2"
CONFIG_BT_DIS_MANUF="Based Hardware"
CONFIG_BT_DIS_FW_REV=y
CONFIG_BT_DIS_HW_REV=y
CONFIG_BT_DIS_FW_REV_STR="2.0.9"
CONFIG_BT_DIS_HW_REV_STR="Seeed Xiao BLE Sense"

#
# Large BLE packets / BLE Buffers 
#
# CONFIG_BT_GATT_CLIENT=y
# CONFIG_BT_THROUGHPUT=y

CONFIG_BT_L2CAP_TX_MTU=498

CONFIG_BT_CTLR_DATA_LENGTH_MAX=251
CONFIG_BT_CTLR_PHY_2M=y
CONFIG_BT_CTLR_PHY_CODED=y
# CONFIG_BT_CTLR_SDC_MAX_CONN_EVENT_LEN_DEFAULT=400000
CONFIG_BT_USER_PHY_UPDATE=y
CONFIG_BT_CONN_TX_MAX=20
CONFIG_BT_BUF_ACL_RX_SIZE=1024
CONFIG_BT_L2CAP_TX_BUF_COUNT=10
CONFIG_BT_BUF_ACL_TX_SIZE=2048
# CONFIG_BT_ATT_TX_COUNT=10
# CONFIG_BT_EXT_ADV=y
# CONFIG_BT_PER_ADV=y
# CONFIG_BT_OBSERVER=y
# CONFIG_BT_ATT_PREPARE_COUNT=2
CONFIG_BT_USER_DATA_LEN_UPDATE=y
CONFIG_BT_AUTO_DATA_LEN_UPDATE=y
CONFIG_BT_AUTO_PHY_UPDATE=y

CONFIG_FPU=y
CONFIG_NORDIC_QSPI_NOR=n
# CONFIG_BOARD_ENABLE_DCDC=y
#

#
# Console
#
# Disable the lines to enable console log
CONFIG_CONSOLE=y
CONFIG_PRINTK=y

#
# Logs
#

# Enable the lines below to enable logs via UART/USB
CONFIG_LOG=y
CONFIG_LOG_PRINTK=y
CONFIG_UART_CONSOLE=y
CONFIG_LOG_MODE_IMMEDIATE=y
CONFIG_LOG_BACKEND_UART=y
CONFIG_LOG_BACKEND_UART_OUTPUT_TEXT=y

# Enable the lines below to enable debug logs
CONFIG_LOG_DEFAULT_LEVEL=4

#
# Log level and buffer size
#

# CONFIG_LOG_OVERRIDE_LEVEL=4
# CONFIG_LOG_BUFFER_SIZE=32000
# CONFIG_LOG_PROCESS_THREAD_STACK_SIZE=4096

#
# Debug
#

# CONFIG_DEBUG=y
# CONFIG_DEBUG_OPTIMIZATIONS=y
# CONFIG_SERIAL=y

#
# Debug (This value breaks some builds)
#

# CONFIG_ASSERT=y

#
# BT log configuration
#

# CONFIG_BT_DEBUG_LOG=y
# CONFIG_BT_L2CAP_LOG_LEVEL_DBG=y
# CONFIG_BT_LOG_LEVEL_DBG=y

# CONFIG_BT_RX_STACK_SIZE=4096
# CONFIG_BT_CTLR_RX_PRIO_STACK_SIZE=4096
# CONFIG_BT_DEBUG_LOG=y
# CONFIG_BT_RX_STACK_SIZE=4096
# CONFIG_BT_CTLR_RX_PRIO_STACK_SIZE=4096

#
# SD Card Support (all devices required)
#

CONFIG_DISK_ACCESS=y
CONFIG_FILE_SYSTEM=y
CONFIG_FAT_FILESYSTEM_ELM=y
CONFIG_FS_FATFS_MOUNT_MKFS=y
CONFIG_FS_FATFS_EXFAT=y
#nessessary?
CONFIG_MAIN_STACK_SIZE=2048
# CONFIG_DISK_DRIVER_SDMMC=y
# CONFIG_SPI=y
CONFIG_HEAP_MEM_POOL_SIZE=512

#
# Disable unused peripherals
#
CONFIG_I2C=n
# CONFIG_NRFX_TWIM0=n
# CONFIG_NRFX_TWIM1=n

#
# LSM6DSL sensor (accelerometer and gyroscope)
#
CONFIG_LSM6DSL=y
CONFIG_LSM6DSL_ENABLE_TEMP=n
# CONFIG_LSM6DSL_TRIGGER_GLOBAL_THREAD=y
CONFIG_SENSOR=y

#
# Speaker
#
CONFIG_I2S=y
CONFIG_I2S_NRFX=y
CONFIG_SPI_NRFX=y

#
# NFC (in the future)
#

# CONFIG_NFC_T2T_NRFXLIB=y
# CONFIG_NFC_NDEF=y
# CONFIG_NFC_NDEF_MSG=y
# CONFIG_NFC_NDEF_RECORD=y
# CONFIG_NFC_NDEF_URI_MSG=y
# CONFIG_NFC_NDEF_URI_REC=y
# CONFIG_HWINFO=y

#
#EVERYTHING ELSE
#

CONFIG_RING_BUFFER=y

CONFIG_PM_DEVICE=y
# CONFIG_NRFX_USBD=y

# CONFIG_FLASH=y

#
# Omi features configuration
#

CONFIG_OMI_CODEC_OPUS=y
CONFIG_OMI_ENABLE_OFFLINE_STORAGE=y
CONFIG_OMI_ENABLE_ACCELEROMETER=y
CONFIG_OMI_ENABLE_BUTTON=y
CONFIG_OMI_ENABLE_SPEAKER=y
CONFIG_OMI_ENABLE_BATTERY=y
CONFIG_OMI_ENABLE_USB=y
CONFIG_OMI_ENABLE_HAPTIC=y
```

## prj_xiao_ble_sense_devkitv2-mcuboot.conf
```kconfig
#
# Hardware settings
#

CONFIG_GPIO=y
CONFIG_NRFX_PDM=y
CONFIG_ADC=y

# To flash via dev board
#CONFIG_BUILD_OUTPUT_UF2=n
#CONFIG_USE_DT_CODE_PARTITION=n

#
# Bluetooth settings
#

CONFIG_BT=y
CONFIG_BT_PERIPHERAL=y
CONFIG_BT_DEVICE_NAME="Omi DevKit 2"
CONFIG_BT_MAX_CONN=1
# CONFIG_BT_EXT_ADV_MAX_ADV_SET=2
CONFIG_BT_MAX_PAIRED=1
CONFIG_BT_DEVICE_APPEARANCE=22
CONFIG_BT_GATT_DYNAMIC_DB=y

#
# Max transmit power supported by nRF52840
#

CONFIG_BT_CTLR_TX_PWR_ANTENNA=8
CONFIG_BT_PHY_UPDATE=y

#
# Battery and Device Information services
#

CONFIG_BT_BAS=y
CONFIG_BT_DIS=y
CONFIG_BT_DIS_PNP=n
CONFIG_BT_DIS_MODEL="Omi DevKit 2"
CONFIG_BT_DIS_MANUF="Based Hardware"
CONFIG_BT_DIS_FW_REV=y
CONFIG_BT_DIS_HW_REV=y
CONFIG_BT_DIS_FW_REV_STR="2.0.7"
CONFIG_BT_DIS_HW_REV_STR="Seeed Xiao BLE Sense"

#
# Large BLE packets / BLE Buffers 
#
# CONFIG_BT_GATT_CLIENT=y
# CONFIG_BT_THROUGHPUT=y

CONFIG_BT_L2CAP_TX_MTU=498

CONFIG_BT_CTLR_DATA_LENGTH_MAX=251
CONFIG_BT_CTLR_PHY_2M=y
CONFIG_BT_CTLR_PHY_CODED=y
CONFIG_BT_CTLR_SDC_MAX_CONN_EVENT_LEN_DEFAULT=400000
CONFIG_BT_CONN_TX_MAX=20
CONFIG_BT_BUF_ACL_RX_SIZE=1024
CONFIG_BT_L2CAP_TX_BUF_COUNT=10
CONFIG_BT_BUF_ACL_TX_SIZE=2048
# CONFIG_BT_ATT_TX_COUNT=10
# CONFIG_BT_EXT_ADV=y
# CONFIG_BT_PER_ADV=y
# CONFIG_BT_OBSERVER=y
# CONFIG_BT_ATT_PREPARE_COUNT=2
CONFIG_BT_USER_DATA_LEN_UPDATE=y
CONFIG_BT_AUTO_DATA_LEN_UPDATE=y
CONFIG_BT_USER_PHY_UPDATE=y
CONFIG_BT_AUTO_PHY_UPDATE=y

CONFIG_FPU=y
CONFIG_NORDIC_QSPI_NOR=n
# CONFIG_BOARD_ENABLE_DCDC=y
#

#
# Console
#
# Disable the lines to enable console log
CONFIG_CONSOLE=n

#
# Debug
#
# Enable the lines below to enable debug logs via UART/USB

# CONFIG_DEBUG=y
# CONFIG_LOG=y
# CONFIG_LOG_PRINTK=y
# CONFIG_LOG_MODE_IMMEDIATE=y
# CONFIG_DEBUG_OPTIMIZATIONS=y
# CONFIG_SERIAL=y
# CONFIG_UART_CONSOLE=y
# CONFIG_LOG_BACKEND_UART=y
# CONFIG_LOG_BACKEND_UART_OUTPUT_TEXT=y
# CONFIG_LOG_DEFAULT_LEVEL=3

#
# Debug (This value breaks some builds)
#

# CONFIG_ASSERT=y

#
# Log Levels
#

# CONFIG_BT_DEBUG_LOG=y
# CONFIG_BT_L2CAP_LOG_LEVEL_DBG=y
# CONFIG_BT_LOG_LEVEL_DBG=y

# CONFIG_LOG_PROCESS_THREAD_STACK_SIZE=4096
# CONFIG_BT_RX_STACK_SIZE=4096
# CONFIG_BT_CTLR_RX_PRIO_STACK_SIZE=4096
# CONFIG_BT_DEBUG_LOG=y
# CONFIG_LOG_BUFFER_SIZE=32000
# CONFIG_LOG_OVERRIDE_LEVEL=4
# CONFIG_LOG_PROCESS_THREAD_STACK_SIZE=4096
# CONFIG_BT_RX_STACK_SIZE=4096
# CONFIG_BT_CTLR_RX_PRIO_STACK_SIZE=4096

#
# Codecs
#
CONFIG_CODEC_OPUS=y

#
# SD Card Support (all devices required)
#

CONFIG_OFFLINE_STORAGE=y
CONFIG_DISK_ACCESS=y
CONFIG_FILE_SYSTEM=y
CONFIG_FAT_FILESYSTEM_ELM=y
CONFIG_FS_FATFS_MOUNT_MKFS=y
CONFIG_FS_FATFS_EXFAT=y
# CONFIG_PRINTK=y
#nessessary?
CONFIG_MAIN_STACK_SIZE=2048
# CONFIG_DISK_DRIVER_SDMMC=y
# CONFIG_SPI=y
CONFIG_HEAP_MEM_POOL_SIZE=512

#
# Disable unused peripherals
#
CONFIG_I2C=n
# CONFIG_NRFX_TWIM0=n
# CONFIG_NRFX_TWIM1=n

#
# LSM6DSL sensor (accelerometer and gyroscope)
#
CONFIG_LSM6DSL=y
CONFIG_LSM6DSL_ENABLE_TEMP=n
# CONFIG_LSM6DSL_TRIGGER_GLOBAL_THREAD=y
CONFIG_SENSOR=y

#
# Speaker
#
CONFIG_I2S=y
CONFIG_I2S_NRFX=y
CONFIG_SPI_NRFX=y

#
# NFC (in the future)
#

# CONFIG_NFC_T2T_NRFXLIB=y
# CONFIG_NFC_NDEF=y
# CONFIG_NFC_NDEF_MSG=y
# CONFIG_NFC_NDEF_RECORD=y
# CONFIG_NFC_NDEF_URI_MSG=y
# CONFIG_NFC_NDEF_URI_REC=y
# CONFIG_HWINFO=y

#
#EVERYTHING ELSE
#

CONFIG_RING_BUFFER=y

CONFIG_ACCELEROMETER=y
CONFIG_ENABLE_BUTTON=y
CONFIG_ENABLE_SPEAKER=y

CONFIG_PM_DEVICE=y
# CONFIG_NRFX_USBD=y

# CONFIG_FLASH=y

#
# MCUboot settings
#
CONFIG_BOOTLOADER_MCUBOOT=y
CONFIG_MCUBOOT_SERIAL=y
```

## src/main.c
```c
#include <zephyr/logging/log.h>
#include <zephyr/kernel.h>
#include <helpers/nrfx_reset_reason.h>
#include <nrfx_power.h>
#include "transport.h"
#include "mic.h"
#include "utils.h"
#include "led.h"
#include "config.h"
#include "codec.h"
#include "button.h"
#include "sdcard.h"
#include "storage.h"
#include "speaker.h"
#include "usb.h"
#define BOOT_BLINK_DURATION_MS 600
#define BOOT_PAUSE_DURATION_MS 200
#define VBUS_DETECT (1U << 20)
#define WAKEUP_DETECT (1U << 16)
LOG_MODULE_REGISTER(main, CONFIG_LOG_DEFAULT_LEVEL);

static void codec_handler(uint8_t *data, size_t len)
{
    int err = broadcast_audio_packets(data, len);
    if (err)
    {
        LOG_ERR("Failed to broadcast audio packets: %d", err);
    }
}

static void mic_handler(int16_t *buffer)
{
    int err = codec_receive_pcm(buffer, MIC_BUFFER_SAMPLES);
    if (err)
    {
        LOG_ERR("Failed to process PCM data: %d", err);
    }
}

void bt_ctlr_assert_handle(char *name, int type)
{
    LOG_INF("Bluetooth assert: %s (type %d)", name ? name : "NULL", type);
}


bool is_connected = false;
bool is_charging = false;
extern bool is_off;
extern bool usb_charge;
static void boot_led_sequence(void)
{
    // Red blink
    set_led_red(true);
    k_msleep(BOOT_BLINK_DURATION_MS);
    set_led_red(false);
    k_msleep(BOOT_PAUSE_DURATION_MS);
    // Green blink
    set_led_green(true);
    k_msleep(BOOT_BLINK_DURATION_MS);
    set_led_green(false);
    k_msleep(BOOT_PAUSE_DURATION_MS);
    // Blue blink
    set_led_blue(true);
    k_msleep(BOOT_BLINK_DURATION_MS);
    set_led_blue(false);
    k_msleep(BOOT_PAUSE_DURATION_MS);
    // All LEDs on
    set_led_red(true);
    set_led_green(true);
    set_led_blue(true);
    k_msleep(BOOT_BLINK_DURATION_MS);
    // All LEDs off
    set_led_red(false);
    set_led_green(false);
    set_led_blue(false);
}

void set_led_state()
{
    // Recording and connected state - BLUE

    if(usb_charge)
    {
        is_charging = !is_charging;
        if(is_charging)
        {
            set_led_green(true);
        }
        else
        {
            set_led_green(false);
        }
    }
    else
    {
        set_led_green(false);
    }
    if(is_off)
    {
        set_led_red(false);
        set_led_blue(false);
        return;
    }
    if (is_connected)
    {
        set_led_blue(true);
        set_led_red(false);
        return;
    }

    // Recording but lost connection - RED
    if (!is_connected)
    {
        set_led_red(true);
        set_led_blue(false);
        return;
    }
}

int main(void)
{
	int err;

    // TODO: what does it mean ? disabled from_usb_event for now
    // for system power off, we have no choice but to handle usb detect wakeup events. if off, and this was the reason, initialize, skip lightshow, start not recording
#ifdef CONFIG_OMI_USE_LEGACY_SDK
    // Store reset reason code
    uint32_t reset_reason = NRF_POWER->RESETREAS;

    NRF_POWER->DCDCEN=1;
    NRF_POWER->DCDCEN0=1;
    NRF_POWER->RESETREAS=1;
#else
    uint32_t reset_reason = nrfx_reset_reason_get();

    // DC-DC
#if NRF_POWER_HAS_DCDCEN
	nrf_power_dcdcen_set(NRF_POWER, true);
#endif

#if NRF_POWER_HAS_DCDCEN_VDDH
	nrf_power_dcdcen_vddh_set(NRF_POWER, true);
#endif

#if !NRF_POWER_HAS_DCDCEN && !NRF_POWER_HAS_DCDCEN_VDDH
#pragma message "DC-DC related commands have no effect!"
#endif

    nrfx_reset_reason_clear(1);
#endif

    // bool from_usb_event = (reset_reason & VBUS_DETECT);
    bool from_wakeup =  (reset_reason & WAKEUP_DETECT);
    // if (from_usb_event)
    // {
    //     k_msleep(100);
    //     printf("from reset \n");
    //     is_off = true;

    LOG_INF("Booting...\n");

    LOG_INF("Model: %s", CONFIG_BT_DIS_MODEL);
    LOG_INF("Firmware revision: %s", CONFIG_BT_DIS_FW_REV_STR);
    LOG_INF("Hardware revision: %s", CONFIG_BT_DIS_HW_REV_STR);

    LOG_DBG("Reset reason: %d\n", reset_reason);

    LOG_PRINTK("\n");
    LOG_INF("Initializing LEDs...\n");

    err = led_start();
    if (err)
    {
        LOG_ERR("Failed to initialize LEDs (err %d)", err);
        return err;
    }

    // Run the boot LED sequence
    boot_led_sequence();

    // Enable battery
#ifdef CONFIG_OMI_ENABLE_BATTERY
    err = battery_init();
    if (err)
    {
        LOG_ERR("Battery init failed (err %d)", err);
        return err;
    }

    err == battery_charge_start();
    if (err)
    {
        LOG_ERR("Battery failed to start (err %d)", err);
        return err;
    }
    LOG_INF("Battery initialized");
#endif


    // Enable button
#ifdef CONFIG_OMI_ENABLE_BUTTON
    err = button_init();
    if (err)
    {
        LOG_ERR("Failed to initialize Button (err %d)", err);
        return err;
    }
    LOG_INF("Button initialized");
    activate_button_work();
#endif

    // Enable accelerometer
#ifdef CONFIG_OMI_ENABLE_ACCELEROMETER
    err = accel_start();
    if (err)
    {
        LOG_ERR("Accelerometer failed to activated (err %d)", err);
        return err;
    }
    LOG_INF("Accelerometer initialized");
#endif

    // Enable speaker
#ifdef CONFIG_OMI_ENABLE_SPEAKER
    err = speaker_init();
    if (err)
    {
        LOG_ERR("Speaker failed to start");
        return err;
    }
    LOG_INF("Speaker initialized");
#endif

    // Enable sdcard
#ifdef CONFIG_OMI_ENABLE_OFFLINE_STORAGE
    LOG_PRINTK("\n");
    LOG_INF("Mount SD card...\n");

    err = mount_sd_card();
    if (err)
    {
        LOG_ERR("Failed to mount SD card (err %d)", err);
        return err;
    }

    k_msleep(500);

    LOG_PRINTK("\n");
    LOG_INF("Initializing storage...\n");

    err = storage_init();
    if (err)
    {
        LOG_ERR("Failed to initialize storage (err %d)", err);
    }
#endif

    // Enable haptic
#ifdef CONFIG_OMI_ENABLE_HAPTIC
    LOG_PRINTK("\n");
    LOG_INF("Initializing haptic...\n");

    err = init_haptic_pin();
    if (err)
    {
        LOG_ERR("Failed to initialize haptic pin (err %d)", err);
        return err;
    }
    LOG_INF("Haptic pin initialized");
#endif

    // Enable usb
#ifdef CONFIG_OMI_ENABLE_USB
    LOG_PRINTK("\n");
    LOG_INF("Initializing power supply check...\n");

    err = init_usb();
    if (err)
    {
        LOG_ERR("Failed to initialize power supply (err %d)", err);
        return err;
    }
#endif

    // Indicate transport initialization
    LOG_PRINTK("\n");
    LOG_INF("Initializing transport...\n");

    set_led_green(true);
    set_led_green(false);

    // Start transport
    int transportErr;
    transportErr = transport_start();
    if (transportErr)
    {
        LOG_ERR("Failed to start transport (err %d)", transportErr);
        // TODO: Detect the current core is app core or net core
        // // Blink green LED to indicate error
        // for (int i = 0; i < 5; i++)
        // {
        //     set_led_green(!gpio_pin_get_dt(&led_green));
        //     k_msleep(200);
        // }
        // set_led_green(false);
        // // return err;
        return transportErr;
    }

#ifdef CONFIG_OMI_ENABLE_SPEAKER
#ifndef CONFIG_UART_CONSOLE
    LOG_PRINTK("\n");
    LOG_INF("Play boot sound...\n");

    // This messes up the UART console, so comment out
    // if console logs are enabled
    play_boot_sound();
#else
    LOG_INF("UART console enabled, not playing boot sound");
#endif
#endif

    LOG_PRINTK("\n");
    LOG_INF("Initializing codec...\n");

    set_led_blue(true);

    // Audio codec(opus) callback
    set_codec_callback(codec_handler);
    err = codec_start();
    if (err)
    {
        LOG_ERR("Failed to start codec: %d", err);
        // Blink blue LED to indicate error
        for (int i = 0; i < 5; i++)
        {
            set_led_blue(!gpio_pin_get_dt(&led_blue));
            k_msleep(200);
        }
        set_led_blue(false);
        return err;
    }

#ifdef CONFIG_OMI_ENABLE_HAPTIC
    play_haptic_milli(500);
#endif
    set_led_blue(false);

    // Indicate microphone initialization
    LOG_PRINTK("\n");
    LOG_INF("Initializing microphone...\n");

    set_led_red(true);
    set_led_green(true);

    set_mic_callback(mic_handler);
    err = mic_start();
    if (err)
    {
        LOG_ERR("Failed to start microphone: %d", err);
        // Blink red and green LEDs to indicate error
        for (int i = 0; i < 5; i++)
        {
            set_led_red(!gpio_pin_get_dt(&led_red));
            set_led_green(!gpio_pin_get_dt(&led_green));
            k_msleep(200);
        }
        set_led_red(false);
        set_led_green(false);
        return err;
    }

    set_led_red(false);
    set_led_green(false);

    // Indicate successful initialization
    LOG_PRINTK("\n");
    LOG_INF("Device initialized successfully\n");

    set_led_blue(true);
    k_msleep(1000);
    set_led_blue(false);

    // Main loop
    LOG_PRINTK("\n");
    LOG_INF("Entering main loop...\n");

    while (1)
    {
        set_led_state();
        k_msleep(500);
    }

    // Unreachable
    return 0;
}
```

## src/accel.c
```c
#include <zephyr/kernel.h>
#include <zephyr/drivers/sensor.h>
#include <zephyr/drivers/gpio.h>
#include <zephyr/logging/log.h>
#include "config.h"
#include "accel.h"

LOG_MODULE_REGISTER(accel, CONFIG_LOG_DEFAULT_LEVEL);

static struct device *lsm6dsl_dev;
static struct sensors mega_sensor;

struct gpio_dt_spec accel_gpio_pin = {.port = DEVICE_DT_GET(DT_NODELABEL(gpio1)), .pin=8, .dt_flags = GPIO_INT_DISABLE};

struct sensors *accel_read()
{
    sensor_sample_fetch_chan(lsm6dsl_dev, SENSOR_CHAN_ACCEL_XYZ);
    sensor_channel_get(lsm6dsl_dev, SENSOR_CHAN_ACCEL_X, &mega_sensor.a_x);
    sensor_channel_get(lsm6dsl_dev, SENSOR_CHAN_ACCEL_Y, &mega_sensor.a_y);
    sensor_channel_get(lsm6dsl_dev, SENSOR_CHAN_ACCEL_Z, &mega_sensor.a_z);

    sensor_sample_fetch_chan(lsm6dsl_dev, SENSOR_CHAN_GYRO_XYZ);
    sensor_channel_get(lsm6dsl_dev, SENSOR_CHAN_GYRO_X, &mega_sensor.g_x);
    sensor_channel_get(lsm6dsl_dev, SENSOR_CHAN_GYRO_Y, &mega_sensor.g_y);
    sensor_channel_get(lsm6dsl_dev, SENSOR_CHAN_GYRO_Z, &mega_sensor.g_z);

    return &mega_sensor;
}

int accel_start() 
{
    struct sensor_value odr_attr;
    lsm6dsl_dev = DEVICE_DT_GET_ONE(st_lsm6dsl);
    k_msleep(50);
    if (lsm6dsl_dev == NULL) 
    {
        LOG_ERR("Could not get LSM6DSL device");
        return 0;
    }
    if (!device_is_ready(lsm6dsl_dev)) 
    {
        LOG_ERR("LSM6DSL: not ready");
        return 0;
    }
    odr_attr.val1 = 10;
    odr_attr.val2 = 0;

    if (gpio_is_ready_dt(&accel_gpio_pin)) 
    {
        printk("Accel Pin ready\n");
    }
    else 
    {
        printk("Error setting up accel Pin\n");
        return -1;
    }
    if (gpio_pin_configure_dt(&accel_gpio_pin, GPIO_OUTPUT_INACTIVE) < 0) 
    {
        printk("Error setting up Haptic Pin\n");
        return -1;
    }
    gpio_pin_set_dt(&accel_gpio_pin, 1);
    if (sensor_attr_set(lsm6dsl_dev, SENSOR_CHAN_ACCEL_XYZ,
        SENSOR_ATTR_SAMPLING_FREQUENCY, &odr_attr) < 0) 
    {
        LOG_ERR("Cannot set sampling frequency for Accelerometer.");
        return 0;
    }
    if (sensor_attr_set(lsm6dsl_dev, SENSOR_CHAN_GYRO_XYZ,
        SENSOR_ATTR_SAMPLING_FREQUENCY, &odr_attr) < 0) {
        LOG_ERR("Cannot set sampling frequency for gyro.");
        return 0;
    }
    if (sensor_sample_fetch(lsm6dsl_dev) < 0) 
    {
        LOG_ERR("Sensor sample update error");
        return 0;
    }

    LOG_INF("Accelerometer is ready for use \n");
    
    return 1;
}

void accel_off()
{
    gpio_pin_set_dt(&accel_gpio_pin, 0);
}
```

## src/accel.h
```c
#include <zephyr/drivers/sensor.h>
typedef struct sensors
{
    struct sensor_value a_x;
    struct sensor_value a_y;
    struct sensor_value a_z;
    struct sensor_value g_x;
    struct sensor_value g_y;
    struct sensor_value g_z;
};

int accel_start();
void accel_on();
void accel_off();
struct sensors *accel_read();
```

## src/btutils.h
```c
#include <zephyr/bluetooth/gatt.h>

static const char *phy2str(uint8_t phy)
{
    switch (phy) {
    case 0: return "No packets";
    case BT_GAP_LE_PHY_1M: return "LE 1M";
    case BT_GAP_LE_PHY_2M: return "LE 2M";
    case BT_GAP_LE_PHY_CODED: return "LE Coded";
    default: return "Unknown";
    }
}
```

## src/button.h
```c
#ifndef BUTTON_H
#define BUTTON_H

#include <stdbool.h>

typedef enum {
    IDLE,
    GRACE
} FSM_STATE_T;

int button_init();
void activate_button_work();
void register_button_service();
void turnoff_all();
FSM_STATE_T get_current_button_state();

void force_button_state(FSM_STATE_T state);

extern bool is_off;

#endif
```

## src/button_transport.c
```c
#include <zephyr/kernel.h>
#include <zephyr/bluetooth/bluetooth.h>
#include <zephyr/bluetooth/uuid.h>
#include <zephyr/bluetooth/gatt.h>
#include <zephyr/bluetooth/l2cap.h>
#include <zephyr/bluetooth/services/bas.h>
#include <zephyr/logging/log.h>
#include "button.h"
#include "transport.h"
LOG_MODULE_REGISTER(button_transport, CONFIG_LOG_DEFAULT_LEVEL);

static int final_button_state[2] = {0,0};

static void button_ccc_config_changed_handler(const struct bt_gatt_attr *attr, uint16_t value);
static ssize_t button_data_read_characteristic(struct bt_conn *conn, const struct bt_gatt_attr *attr, void *buf, uint16_t len, uint16_t offset);

static struct bt_uuid_128 button_uuid = BT_UUID_INIT_128(BT_UUID_128_ENCODE(0x23BA7924,0x0000,0x1000,0x7450,0x346EAC492E92));
static struct bt_uuid_128 button_characteristic_data_uuid = BT_UUID_INIT_128(BT_UUID_128_ENCODE(0x23BA7925 ,0x0000,0x1000,0x7450,0x346EAC492E92));

static struct bt_gatt_attr button_service_attr[] = {
    BT_GATT_PRIMARY_SERVICE(&button_uuid),
    BT_GATT_CHARACTERISTIC(&button_characteristic_data_uuid.uuid, BT_GATT_CHRC_READ | BT_GATT_CHRC_NOTIFY, BT_GATT_PERM_READ, button_data_read_characteristic, NULL, NULL),
    BT_GATT_CCC(button_ccc_config_changed_handler, BT_GATT_PERM_READ | BT_GATT_PERM_WRITE),
};

static struct bt_gatt_service button_service = BT_GATT_SERVICE(button_service_attr);

static void button_ccc_config_changed_handler(const struct bt_gatt_attr *attr, uint16_t value) 
{
    if (value == BT_GATT_CCC_NOTIFY)
    {
        LOG_INF("Client subscribed for notifications");
    }
    else if (value == 0)
    {
        LOG_INF("Client unsubscribed from notifications");
    }
    else
    {
        LOG_ERR("Invalid CCC value: %u", value);
    }

}

static ssize_t button_data_read_characteristic(struct bt_conn *conn, const struct bt_gatt_attr *attr, void *buf, uint16_t len, uint16_t offset) 
{
    LOG_INF("button_data_read_characteristic");
    printf("was_pressed: %d\n", final_button_state[0]);
    return bt_gatt_attr_read(conn, attr, buf, len, offset, &final_button_state, sizeof(final_button_state));
}

int notify_gatt(const int attr_idx, const void *data, uint16_t len) {
    LOG_INF("notify_gatt %d", attr_idx);
    struct bt_conn *conn = get_current_connection();
    if (conn != NULL)
    { 
        return bt_gatt_notify(conn, &button_service.attrs[attr_idx], data, len);
    }

    return -1;
}

int notify_gatt_button_state(const int state) 
{
    LOG_INF("notify_gatt_button_state %d", state);
    final_button_state[0] = state; 
    return notify_gatt(1, &final_button_state, sizeof(final_button_state));
}

int register_gatt_service() {
    return bt_gatt_service_register(&button_service);
}
```

## src/button_transport.h
```c
#ifndef BUTTON_TRANSPORT_H
#define BUTTON_TRANSPORT_H

#include <zephyr/bluetooth/bluetooth.h>
#include <zephyr/bluetooth/uuid.h>
#include <zephyr/bluetooth/gatt.h>
#include <zephyr/bluetooth/l2cap.h>
#include <zephyr/bluetooth/services/bas.h>

int notify_gatt(const int attr_idx, const void *data, uint16_t len);

int notify_gatt_button_state(const int state);

int register_gatt_service();

#endif
```

## src/codec.c
```c
#include <zephyr/logging/log.h>
#include <zephyr/sys/ring_buffer.h>
#include "codec.h"
#include "config.h"
#include "utils.h"
#include "transport.h"
#ifdef CODEC_OPUS
#include "lib/opus-1.2.1/opus.h"
#endif

LOG_MODULE_REGISTER(codec, CONFIG_LOG_DEFAULT_LEVEL);

//
// Output
//

static volatile codec_callback _callback = NULL;

void set_codec_callback(codec_callback callback)
{
    _callback = callback;
}

//
// Input
//

uint8_t codec_ring_buffer_data[AUDIO_BUFFER_SAMPLES * 2]; // 2 bytes per sample
struct ring_buf codec_ring_buf;
int codec_receive_pcm(int16_t *data, size_t len) //this gets called after mic data is finished
{

    int written = ring_buf_put(&codec_ring_buf, (uint8_t *)data, len * 2);
    if (written != len * 2)
    {
        LOG_ERR("Failed to write %d bytes to codec ring buffer", len * 2);
        return -1;
    }


    return 0;
}

//
// Thread
//

int16_t codec_input_samples[CODEC_PACKAGE_SAMPLES];
uint8_t codec_output_bytes[CODEC_OUTPUT_MAX_BYTES];
K_THREAD_STACK_DEFINE(codec_stack, 32000);
static struct k_thread codec_thread;
uint16_t execute_codec();

#if CODEC_OPUS
#if (CONFIG_OPUS_MODE == CONFIG_OPUS_MODE_CELT)
#define OPUS_ENCODER_SIZE 7180
#endif
#if (CONFIG_OPUS_MODE == CONFIG_OPUS_MODE_HYBRID)
#define OPUS_ENCODER_SIZE 10916
#endif
__ALIGN(4)
static uint8_t m_opus_encoder[OPUS_ENCODER_SIZE];
static OpusEncoder *const m_opus_state = (OpusEncoder *)m_opus_encoder;
#endif

void codec_entry(void *p1, void *p2, void *p3) {
    uint16_t output_size;
    while (1) {
        if (ring_buf_size_get(&codec_ring_buf) < CODEC_PACKAGE_SAMPLES * 2) {
            k_sleep(K_MSEC(10));
            continue;
        }
        ring_buf_get(&codec_ring_buf, (uint8_t *)codec_input_samples, CODEC_PACKAGE_SAMPLES * 2);
        output_size = execute_codec();
        if (voice_interaction_active) {
            handle_voice_data(codec_output_bytes, output_size);
        } else if (_callback) {
            _callback(codec_output_bytes, output_size);
        }
        k_yield();
    }
}

int codec_start()
{

// OPUS
#if CODEC_OPUS
    ASSERT_TRUE(opus_encoder_get_size(1) == sizeof(m_opus_encoder));
    ASSERT_TRUE(opus_encoder_init(m_opus_state, 16000, 1, CODEC_OPUS_APPLICATION) == OPUS_OK);
    ASSERT_TRUE(opus_encoder_ctl(m_opus_state, OPUS_SET_BITRATE(CODEC_OPUS_BITRATE)) == OPUS_OK);
    ASSERT_TRUE(opus_encoder_ctl(m_opus_state, OPUS_SET_VBR(CODEC_OPUS_VBR)) == OPUS_OK);
    ASSERT_TRUE(opus_encoder_ctl(m_opus_state, OPUS_SET_VBR_CONSTRAINT(0)) == OPUS_OK);
    ASSERT_TRUE(opus_encoder_ctl(m_opus_state, OPUS_SET_COMPLEXITY(CODEC_OPUS_COMPLEXITY)) == OPUS_OK);
    ASSERT_TRUE(opus_encoder_ctl(m_opus_state, OPUS_SET_SIGNAL(OPUS_SIGNAL_VOICE)) == OPUS_OK);
    ASSERT_TRUE(opus_encoder_ctl(m_opus_state, OPUS_SET_LSB_DEPTH(16)) == OPUS_OK);
    ASSERT_TRUE(opus_encoder_ctl(m_opus_state, OPUS_SET_DTX(0)) == OPUS_OK);
    ASSERT_TRUE(opus_encoder_ctl(m_opus_state, OPUS_SET_INBAND_FEC(0)) == OPUS_OK);
    ASSERT_TRUE(opus_encoder_ctl(m_opus_state, OPUS_SET_PACKET_LOSS_PERC(0)) == OPUS_OK);
#endif

    // Thread
    ring_buf_init(&codec_ring_buf, sizeof(codec_ring_buffer_data), codec_ring_buffer_data);
    k_thread_create(&codec_thread, codec_stack, K_THREAD_STACK_SIZEOF(codec_stack), (k_thread_entry_t)codec_entry, NULL, NULL, NULL, K_PRIO_PREEMPT(4), 0, K_NO_WAIT);

    // Success
    return 0;
}

//
// Opus codec
//

#if CODEC_OPUS

uint16_t execute_codec()
{
    opus_int32 size = opus_encode(m_opus_state, codec_input_samples, CODEC_PACKAGE_SAMPLES, codec_output_bytes, sizeof(codec_output_bytes));
    if (size < 0)
    {
        LOG_WRN("Opus encoding failed: %d", size);
        return 0;
    }
    LOG_DBG("Opus encoding success: %i", size);
    return size;
}

#endif
```

## src/codec.h
```c
#ifndef CODEC_H
#define CODEC_H
#include <zephyr/kernel.h>
#include <zephyr/sys/ring_buffer.h>

// Callback
typedef void (*codec_callback)(uint8_t *data, size_t len);
void set_codec_callback(codec_callback callback);

// Integration

int codec_receive_pcm(int16_t *data, size_t len);

/**
 * @brief Initialize the Codec
 *
 * Initializes the codec
 *
 * @return 0 if successful, negative errno code if error
 */
int codec_start();

extern struct ring_buf codec_ring_buf;

#endif
```

## src/config.h
```c
#include <haly/nrfy_gpio.h>

// #define SAMPLE_RATE 16000
#define MIC_GAIN 64
#define MIC_IRC_PRIORITY 7
#define MIC_BUFFER_SAMPLES 1600    // 100ms
#define AUDIO_BUFFER_SAMPLES 16000 // 1s
#define NETWORK_RING_BUF_SIZE 32   // number of frames * CODEC_OUTPUT_MAX_BYTES
#define MINIMAL_PACKET_SIZE 100    // Less than that doesn't make sence to send anything at all

// PIN definitions
// https://github.com/Seeed-Studio/Adafruit_nRF52_Arduino/blob/5aa3573913449410fd60f76b75673c53855ff2ec/variants/Seeed_XIAO_nRF52840_Sense/variant.cpp#L34
#define PDM_DIN_PIN NRF_GPIO_PIN_MAP(0, 16)
#define PDM_CLK_PIN NRF_GPIO_PIN_MAP(1, 0)
#define PDM_PWR_PIN NRF_GPIO_PIN_MAP(1, 10)

// Codecs
#if defined(CONFIG_CODEC_OPUS) || defined(CONFIG_OMI_CODEC_OPUS)
#define CODEC_OPUS 1
#endif

#if CODEC_OPUS
#define CODEC_PACKAGE_SAMPLES 160
#define CODEC_OUTPUT_MAX_BYTES (CODEC_PACKAGE_SAMPLES * 2) // Let's assume that 16bit is enough
#define CODEC_OPUS_APPLICATION OPUS_APPLICATION_RESTRICTED_LOWDELAY
#define CODEC_OPUS_BITRATE 32000
#define CODEC_OPUS_VBR 1 // Or 1
#define CODEC_OPUS_COMPLEXITY 3
#endif
#define CONFIG_OPUS_MODE CONFIG_OPUS_MODE_CELT

// Codec IDs

#ifdef CODEC_OPUS
#define CODEC_ID 20
#endif

// Logs
// #define LOG_DISCARDED
```

## src/deep_sleep.h
```c
#ifndef DEEP_SLEEP_H
#define DEEP_SLEEP_H

void enter_deep_sleep(void);
void configure_button_for_wake_up(void);

#endif // DEEP_SLEEP_H
```
